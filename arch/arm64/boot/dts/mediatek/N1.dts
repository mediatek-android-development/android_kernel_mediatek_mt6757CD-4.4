/dts-v1/;

/ {
	model = "MT6757";
	compatible = "mediatek,MT6757";
	interrupt-parent = <0x1>;
	#address-cells = <0x2>;
	#size-cells = <0x2>;

	chosen {
		bootargs = "console=tty0 console=ttyMT0,921600n1 root=/dev/ram initrd=0x45000000,\n  0x1000000 loglevel=8 androidboot.selinux=permissive androidboot.hardware=mt6757";
		atag,videolfb-fb_base_h = <0x0>;
		atag,videolfb-fb_base_l = "^`P";
		atag,videolfb-islcmfound = <0x1>;
		atag,videolfb-islcm_inited = <0x0>;
		atag,videolfb-fps = <0x1770>;
		atag,videolfb-vramSize = <0x17bb000>;
		atag,videolfb-lcmname = "nt35695_fhd_dsi_cmd_truly_nt50358_drv";
	};

	mtk-msdc.0 {
		compatible = "simple-bus";
		#address-cells = <0x1>;
		#size-cells = <0x1>;
		ranges = <0x0 0x0 0x0 0xffffffff>;

		msdc0@11230000 {
			compatible = "mediatek,mt6757-mmc";
			reg = <0x11230000 0x10000>;
			interrupts = <0x0 0x4f 0x8>;
			clocks = <0x2 0x1f>;
			clock-names = "MSDC0-CLOCK";
			clk_src = [01];
			bus-width = <0x8>;
			max-frequency = <0xbebc200>;
			cap-mmc-highspeed;
			msdc-sys-suspend;
			mmc-ddr-1_8v;
			mmc-hs200-1_8v;
			mmc-hs400-1_8v;
			non-removable;
			pinctl = <0x3>;
			register_setting = <0x4>;
			host_function = [00];
			bootable;
			status = "okay";
			vmmc-supply = <0x5>;
		};

		msdc1@11240000 {
			compatible = "mediatek,mt6757-mmc";
			reg = <0x11240000 0x10000>;
			interrupts = <0x0 0x50 0x8>;
			clocks = <0x2 0x21>;
			clock-names = "MSDC1-CLOCK";
			clk_src = [07];
			bus-width = <0x4>;
			max-frequency = <0xbebc200>;
			msdc-sys-suspend;
			cap-sd-highspeed;
			sd-uhs-sdr12;
			sd-uhs-sdr25;
			sd-uhs-sdr50;
			sd-uhs-sdr104;
			sd-uhs-ddr50;
			pinctl = <0x6>;
			pinctl_sdr104 = <0x7>;
			pinctl_sdr50 = <0x8>;
			pinctl_ddr50 = <0x9>;
			register_setting = <0xa>;
			host_function = [01];
			cd_level = [00];
			cd-gpios = <0xb 0x3 0x0>;
			status = "okay";
			vmmc-supply = <0xc>;
			vqmmc-supply = <0xd>;
		};

		msdc2@11250000 {
			compatible = "mediatek,mt6757-mmc";
			reg = <0x11250000 0x10000>;
			interrupts = <0x0 0x51 0x8>;
			clocks = <0x2 0x22>;
			clock-names = "MSDC2-CLOCK";
			clk_src = [07];
			bus-width = <0x4>;
			max-frequency = <0xbebc200>;
			cap-sd-highspeed;
			sd-uhs-sdr12;
			sd-uhs-sdr25;
			sd-uhs-sdr50;
			sd-uhs-sdr104;
			sd-uhs-ddr50;
			keep-power-in-suspend;
			non-removable;
			pinctl = <0xe>;
			register_setting = <0xf>;
			host_function = [02];
			status = "disable";
		};
	};

	msdc1_ins@0 {
		compatible = "mediatek,mt6757-sdcard-ins";
		interrupt-parent = <0x10>;
		interrupts = <0x3 0x2>;
		debounce = <0x3 0x0>;
		status = "okay";
	};

	atf_logger {
		compatible = "mediatek,atf_logger";
		interrupts = <0x0 0x11e 0x1>;
	};

	mobicore {
		compatible = "trustonic,mobicore";
		interrupts = <0x0 0x124 0x1>;
	};

	psci {
		compatible = "arm,psci-0.2";
		method = "smc";
	};

	utos {
		compatible = "microtrust,utos";
		interrupts = <0x0 0x125 0x1 0x0 0x126 0x1>;
	};

	cpus {
		#address-cells = <0x1>;
		#size-cells = <0x0>;

		cpu@000 {
			device_type = "cpu";
			compatible = "arm,cortex-a53";
			reg = <0x0>;
			enable-method = "psci";
			cpu-idle-states = <0x11 0x12 0x13 0x14 0x15>;
			cpu-release-addr = <0x0 0x40000200>;
			clock-frequency = <0x61a1e580>;
			linux,phandle = <0x16>;
			phandle = <0x16>;
		};

		cpu@001 {
			device_type = "cpu";
			compatible = "arm,cortex-a53";
			reg = <0x1>;
			enable-method = "psci";
			cpu-idle-states = <0x11 0x12 0x13 0x14 0x15>;
			cpu-release-addr = <0x0 0x40000200>;
			clock-frequency = <0x61a1e580>;
			linux,phandle = <0x17>;
			phandle = <0x17>;
		};

		cpu@002 {
			device_type = "cpu";
			compatible = "arm,cortex-a53";
			reg = <0x2>;
			enable-method = "psci";
			cpu-idle-states = <0x11 0x12 0x13 0x14 0x15>;
			cpu-release-addr = <0x0 0x40000200>;
			clock-frequency = <0x61a1e580>;
			linux,phandle = <0x18>;
			phandle = <0x18>;
		};

		cpu@003 {
			device_type = "cpu";
			compatible = "arm,cortex-a53";
			reg = <0x3>;
			enable-method = "psci";
			cpu-idle-states = <0x11 0x12 0x13 0x14 0x15>;
			cpu-release-addr = <0x0 0x40000200>;
			clock-frequency = <0x61a1e580>;
			linux,phandle = <0x19>;
			phandle = <0x19>;
		};

		cpu@100 {
			device_type = "cpu";
			compatible = "arm,cortex-a53";
			reg = <0x100>;
			enable-method = "psci";
			cpu-idle-states = <0x11 0x12 0x13 0x14 0x15>;
			cpu-release-addr = <0x0 0x40000200>;
			clock-frequency = <0x8b799100>;
			linux,phandle = <0x1a>;
			phandle = <0x1a>;
		};

		cpu@101 {
			device_type = "cpu";
			compatible = "arm,cortex-a53";
			reg = <0x101>;
			enable-method = "psci";
			cpu-idle-states = <0x11 0x12 0x13 0x14 0x15>;
			cpu-release-addr = <0x0 0x40000200>;
			clock-frequency = <0x8b799100>;
			linux,phandle = <0x1b>;
			phandle = <0x1b>;
		};

		cpu@102 {
			device_type = "cpu";
			compatible = "arm,cortex-a53";
			reg = <0x102>;
			enable-method = "psci";
			cpu-idle-states = <0x11 0x12 0x13 0x14 0x15>;
			cpu-release-addr = <0x0 0x40000200>;
			clock-frequency = <0x8b799100>;
			linux,phandle = <0x1c>;
			phandle = <0x1c>;
		};

		cpu@103 {
			device_type = "cpu";
			compatible = "arm,cortex-a53";
			reg = <0x103>;
			enable-method = "psci";
			cpu-idle-states = <0x11 0x12 0x13 0x14 0x15>;
			cpu-release-addr = <0x0 0x40000200>;
			clock-frequency = <0x8b799100>;
			linux,phandle = <0x1d>;
			phandle = <0x1d>;
		};

		cpu-map {

			cluster0 {

				core0 {
					cpu = <0x16>;
				};

				core1 {
					cpu = <0x17>;
				};

				core2 {
					cpu = <0x18>;
				};

				core3 {
					cpu = <0x19>;
				};
			};

			cluster1 {

				core0 {
					cpu = <0x1a>;
				};

				core1 {
					cpu = <0x1b>;
				};

				core2 {
					cpu = <0x1c>;
				};

				core3 {
					cpu = <0x1d>;
				};
			};
		};

		idle-states {
			entry-method = "arm,psci";

			mcdi {
				compatible = "arm,idle-state";
				arm,psci-suspend-param = <0x10001>;
				entry-latency-us = <0x258>;
				exit-latency-us = <0x258>;
				min-residency-us = <0x4b0>;
				linux,phandle = <0x11>;
				phandle = <0x11>;
			};

			sodi {
				compatible = "arm,idle-state";
				arm,psci-suspend-param = <0x1010002>;
				entry-latency-us = <0x320>;
				exit-latency-us = <0x3e8>;
				min-residency-us = <0x7d0>;
				linux,phandle = <0x12>;
				phandle = <0x12>;
			};

			sodi3 {
				compatible = "arm,idle-state";
				arm,psci-suspend-param = <0x1010003>;
				entry-latency-us = <0x320>;
				exit-latency-us = <0x3e8>;
				min-residency-us = <0x7d0>;
				linux,phandle = <0x13>;
				phandle = <0x13>;
			};

			dpidle {
				compatible = "arm,idle-state";
				arm,psci-suspend-param = <0x1010004>;
				entry-latency-us = <0x320>;
				exit-latency-us = <0x3e8>;
				min-residency-us = <0x7d0>;
				linux,phandle = <0x14>;
				phandle = <0x14>;
			};

			suspend {
				compatible = "arm,idle-state";
				arm,psci-suspend-param = <0x1010005>;
				entry-latency-us = <0x320>;
				exit-latency-us = <0x3e8>;
				min-residency-us = <0x7d0>;
				linux,phandle = <0x15>;
				phandle = <0x15>;
			};
		};
	};

	memory@40000000 {
		device_type = "memory";
		reg = <0x0 0x40000000 0x0 0x1e605000 0x1 0x0 0x0 0x20000000>;
	};

	reserved-memory {
		#address-cells = <0x2>;
		#size-cells = <0x2>;
		ranges;

		atf-reserved-memory@44600000 {
			compatible = "mediatek,mt6757-atf-reserved-memory";
			no-map;
			reg = <0x0 0x44600000 0x0 0x10000>;
		};

		atf-ramdump-memory@44610000 {
			compatible = "mediatek,mt6757-atf-ramdump-memory";
			no-map;
			reg = <0x0 0x44610000 0x0 0x30000>;
		};

		ram_console-reserved-memory@44400000 {
			compatible = "ram_console-reserve-memory";
			reg = <0x0 0x44400000 0x0 0x10000>;
		};

		pstore-reserved-memory@44410000 {
			compatible = "mediatek,pstore";
			reg = <0x0 0x44410000 0x0 0xe0000>;
		};

		minirdump-reserved-memory@444f0000 {
			compatible = "mediatek,minirdump";
			reg = <0x0 0x444f0000 0x0 0x10000>;
		};

		consys-reserve-memory {
			compatible = "mediatek,consys-reserve-memory";
			#address-cells = <0x2>;
			#size-cells = <0x2>;
			no-map;
			size = <0x0 0x200000>;
			alignment = <0x0 0x200000>;
			alloc-ranges = <0x0 0x40000000 0x0 0x80000000>;
		};

		spm-reserve-memory {
			compatible = "mediatek,spm-reserve-memory";
			no-map;
			size = <0x0 0x38000>;
			alignment = <0x0 0x10000>;
			alloc-ranges = <0x0 0x40000000 0x0 0x80000000>;
		};

		zone-movable-cma-memory {
			compatible = "mediatek,zone_movable_cma";
			size = <0x0 0xffc00000>;
			alignment = <0x0 0x10000000>;
			alloc-ranges = <0x0 0xc0000000 0x1 0x0>;
		};
	};

	plat_sram_flag@0011dbf0 {
		compatible = "mediatek,plat_sram_flag";
		reg = <0x0 0x11dbf0 0x0 0x10>;
	};

	interrupt-controller@0c000000 {
		compatible = "arm,gic-v3";
		#interrupt-cells = <0x3>;
		#address-cells = <0x2>;
		#size-cells = <0x2>;
		#redistributor-regions = <0x1>;
		interrupt-controller;
		reg = <0x0 0xc000000 0x0 0x40000 0x0 0xc200000 0x0 0x200000 0x0 0x10200620 0x0 0x1000 0x0 0x10200690 0x0 0x1000>;
		interrupts = <0x1 0x9 0x4>;
		mediatek,reg_len_pol0 = <0x8>;
		linux,phandle = <0x1>;
		phandle = <0x1>;
	};

	clocks {

		clk_null {
			compatible = "fixed-clock";
			#clock-cells = <0x0>;
			clock-frequency = <0x0>;
		};

		clk26m {
			compatible = "fixed-clock";
			#clock-cells = <0x0>;
			clock-frequency = <0x18cba80>;
			linux,phandle = <0x3a>;
			phandle = <0x3a>;
		};

		clk32k {
			compatible = "fixed-clock";
			#clock-cells = <0x0>;
			clock-frequency = <0x7d00>;
			linux,phandle = <0x30>;
			phandle = <0x30>;
		};
	};

	cpuxgpt@10200000 {
		compatible = "mediatek,cpuxgpt";
		reg = <0x0 0x10200000 0x0 0x1000>;
		interrupts = <0x0 0x40 0x4 0x0 0x41 0x4 0x0 0x42 0x4 0x0 0x43 0x4 0x0 0x44 0x4 0x0 0x45 0x4 0x0 0x46 0x4 0x0 0x47 0x4>;
	};

	pmu {
		compatible = "arm,cortex-a53-pmu";
		interrupts = <0x0 0x8 0x8 0x0 0x9 0x8 0x0 0xa 0x8 0x0 0xb 0x8 0x0 0xc 0x8 0x0 0xd 0x8 0x0 0xe 0x8 0x0 0xf 0x8>;
		interrupt-affinity = <0x16 0x17 0x18 0x19 0x1a 0x1b 0x1c 0x1d>;
	};

	timer {
		compatible = "arm,armv8-timer";
		interrupts = <0x1 0xd 0x8 0x1 0xe 0x8 0x1 0xb 0x8 0x1 0xa 0x8>;
		clock-frequency = <0xc65d40>;
	};

	mtkfb@0 {
		compatible = "mediatek,mtkfb";
		pinctrl-names = "default", "mode_te_gpio", "mode_te_te", "lcm_rst_out0_gpio", "lcm_rst_out1_gpio", "lcd_bias_enp0_gpio", "lcd_bias_enp1_gpio";
		pinctrl-0 = <0x1e>;
		pinctrl-1 = <0x1f>;
		pinctrl-2 = <0x20>;
		pinctrl-3 = <0x21>;
		pinctrl-4 = <0x22>;
		pinctrl-5 = <0x23>;
		pinctrl-6 = <0x24>;
		status = "okay";
	};

	touch {
		compatible = "mediatek,mt6757-touch";
		interrupt-parent = <0x10>;
		interrupts = <0x1 0x2>;
		debounce = <0x1 0x0>;
		status = "okay";
		vtouch-supply = <0x25>;
		tpd-resolution = <0x438 0x780>;
		use-tpd-button = <0x0>;
		tpd-key-num = <0x3>;
		tpd-key-local = <0x8b 0xac 0x9e 0x0>;
		tpd-key-dim-local = <0x5a 0x373 0x64 0x28 0xe6 0x373 0x64 0x28 0x172 0x373 0x64 0x28 0x0 0x0 0x0 0x0>;
		tpd-max-touch-num = <0x5>;
		tpd-filter-enable = <0x1>;
		tpd-filter-pixel-density = <0x92>;
		tpd-filter-custom-prameters = <0x0 0x0 0x0 0x0 0x0 0x0 0x0 0x0 0x0 0x0 0x0 0x0>;
		tpd-filter-custom-speed = <0x0 0x0 0x0>;
		pinctrl-names = "default", "state_eint_as_int", "state_eint_output0", "state_eint_output1", "state_rst_output0", "state_rst_output1";
		pinctrl-0 = <0x26>;
		pinctrl-1 = <0x27>;
		pinctrl-2 = <0x28>;
		pinctrl-3 = <0x29>;
		pinctrl-4 = <0x2a>;
		pinctrl-5 = <0x2b>;
	};

	accdet@ {
		compatible = "mediatek,mt6757-accdet";
		interrupt-parent = <0x10>;
		interrupts = <0x0 0x8>;
		debounce = <0x0 0x3e800>;
		status = "okay";
		accdet-mic-vol = <0x7>;
		headset-mode-setting = <0x500 0x500 0x1 0x1f0 0x800 0x800 0x20>;
		accdet-plugout-debounce = <0x1>;
		accdet-mic-mode = <0x1>;
		headset-eint-level-pol = <0x8>;
		headset-three-key-threshold = <0x0 0x50 0xdc 0x190>;
		headset-three-key-threshold-CDD = <0x0 0x79 0xc0 0x258>;
		headset-four-key-threshold = <0x0 0x3a 0x79 0xc0 0x190>;
		pinctrl-names = "default", "state_eint_as_int";
		pinctrl-0 = <0x2c>;
		pinctrl-1 = <0x2d>;
	};

	bat_notify {
		compatible = "mediatek,bat_notify";
	};

	battery_dts {
		compatible = "mediatek,battery";
	};

	bat_metter {
		compatible = "mediatek,bat_meter";
		stop_charging_in_takling = <0x1>;
		talking_recharge_voltage = <0xed8>;
		talking_sync_time = <0x3c>;
		mtk_temperature_recharge_support = <0x1>;
		max_charge_temperature = <0x32>;
		max_charge_temperature_minus_x_degree = <0x2f>;
		min_charge_temperature = <0x0>;
		min_charge_temperature_plus_x_degree = <0x6>;
		err_charge_temperature = <0xff>;
		v_pre2cc_thres = <0xd48>;
		v_cc2topoff_thres = <0xfd2>;
		recharging_voltage = <0x100e>;
		charging_full_current = <0x64>;
		config_usb_if = <0x0>;
		usb_charger_current_suspend = <0x0>;
		usb_charger_current_unconfigured = <0x1b58>;
		usb_charger_current_configured = <0xc350>;
		usb_charger_current = <0xc350>;
		ac_charger_current = <0x13880>;
		non_std_ac_charger_current = <0xc350>;
		charging_host_charger_current = <0xfde8>;
		apple_0_5a_charger_current = <0xc350>;
		apple_1_0a_charger_current = <0xfde8>;
		apple_2_1a_charger_current = <0x13880>;
		bat_low_temp_protect_enable = <0x0>;
		v_charger_enable = <0x0>;
		v_charger_max = <0x1964>;
		v_charger_min = <0x1130>;
		onehundred_percent_tracking_time = <0xa>;
		npercent_tracking_time = <0x14>;
		sync_to_real_tracking_time = <0x3c>;
		v_0percent_tracking = <0xd7a>;
		high_battery_voltage_support = <0x0>;
		r_bat_sense = <0x4>;
		r_i_sense = <0x4>;
		r_charger_1 = <0x14a>;
		r_charger_2 = <0x27>;
		temperature_t0 = <0x6e>;
		temperature_t1 = <0x0>;
		temperature_t2 = <0x19>;
		temperature_t3 = <0x32>;
		temperature_t = <0xff>;
		fg_meter_resistance = <0x0>;
		q_max_pos_50 = <0xab7>;
		q_max_pos_25 = <0xa93>;
		q_max_pos_0 = <0x348>;
		q_max_neg_10 = <0x327>;
		q_max_pos_50_h_current = <0xa80>;
		q_max_pos_25_h_current = <0xa5d>;
		q_max_pos_0_h_current = <0x337>;
		q_max_neg_10_h_current = <0x317>;
		oam_d5 = <0x1>;
		change_tracking_point = <0x1>;
		cust_tracking_point = <0x0>;
		cust_r_sense = <0x38>;
		cust_hw_cc = <0x0>;
		aging_tuning_value = <0x67>;
		cust_r_fg_offset = <0x0>;
		ocv_board_compesate = <0x0>;
		r_fg_board_base = <0x3e8>;
		r_fg_board_slope = <0x3e8>;
		car_tune_value = <0x76>;
		current_detect_r_fg = <0xa>;
		minerroroffset = <0x3e8>;
		fg_vbat_average_size = <0x12>;
		r_fg_value = <0xa>;
		difference_hwocv_rtc = <0x1e>;
		difference_hwocv_swocv = <0xa>;
		difference_swocv_rtc = <0xa>;
		max_swocv = <0x3>;
		difference_voltage_update = <0x14>;
		aging1_load_soc = <0x46>;
		aging1_update_soc = <0x1e>;
		batterypseudo100 = <0x5f>;
		batterypseudo1 = <0xb>;
		q_max_by_sys = <0x1>;
		q_max_sys_voltage = <0xd16>;
		shutdown_gauge0 = <0x1>;
		shutdown_gauge1_xmins = <0x1>;
		shutdown_gauge1_mins = <0x3c>;
		shutdown_system_voltage = <0xd48>;
		charge_tracking_time = <0x3c>;
		discharge_tracking_time = <0xa>;
		recharge_tolerance = <0xa>;
		sync_ui_soc_imm = <0x0>;
		mtk_enable_aging_algorithm = <0x1>;
		md_sleep_current_check = <0x1>;
		q_max_by_current = <0x0>;
		cust_poweron_delta_capacity_tolrance = <0x28>;
		cust_poweron_low_capacity_tolrance = <0x5>;
		cust_poweron_max_vbat_tolrance = <0x5a>;
		cust_poweron_delta_vbat_tolrance = <0x1e>;
		cust_poweron_delta_hw_sw_ocv_capacity_tolrance = <0xa>;
		fixed_tbat_25 = <0x0>;
		vbat_normal_wakeup = <0xe10>;
		vbat_low_power_wakeup = <0xdac>;
		normal_wakeup_period = <0x1518>;
		low_power_wakeup_period = <0x12c>;
		close_poweroff_wakeup_period = <0x1e>;
		rbat_pull_up_r = <0x5dc0>;
		rbat_pull_up_volt = <0x708>;
		batt_temperature_table_num = <0x11>;
		batt_temperature_table = <0xffffffec 0x10a8d 0xfffffff1 0xd192 0xfffffff6 0xa60a 0xfffffffb 0x8464 0x0 0x6a53 0x5 0x5605 0xa 0x4606 0xf 0x3952 0x14 0x2f31 0x19 0x2710 0x1e 0x207b 0x23 0x1b24 0x28 0x16ca 0x2d 0x1335 0x32 0x1041 0x37 0xdcf 0x3c 0xbc6>;
		battery_profile_t0_num = <0x52>;
		battery_profile_t0 = <0x0 0x10cf 0x6 0x10b9 0xd 0x10a5 0x12 0x1090 0x19 0x1079 0x1f 0x1062 0x26 0x1049 0x2c 0x1031 0x33 0x1015 0x38 0xff8 0x3e 0xfe4 0x45 0xfcf 0x4b 0xfb3 0x52 0xf9d 0x57 0xf8d 0x5e 0xf7f 0x64 0xf74 0x6b 0xf66 0x71 0xf59 0x76 0xf49 0x7d 0xf37 0x80 0xf28 0x87 0xf1d 0x8d 0xf11 0x93 0xf08 0x9a 0xeff 0x9f 0xef6 0xa6 0xeef 0xac 0xeea 0xb3 0xee3 0xb9 0xede 0xc0 0xed8 0xc5 0xed4 0xcb 0xecf 0xd2 0xecb 0xd8 0xec5 0xdf 0xebf 0xe4 0xeba 0xeb 0xeb0 0xf1 0xea8 0xf8 0xe9e 0xfe 0xe93 0x103 0xe89 0x10a 0xe81 0x110 0xe78 0x117 0xe72 0x11d 0xe68 0x124 0xe51 0x129 0xe1d 0x130 0xdc6 0x133 0xd8a 0x136 0xd74 0x139 0xd60 0x139 0xd4c>;
		battery_profile_t1_num = <0x52>;
		battery_profile_t1 = <0x0 0x10dc 0x7 0x10bb 0xc 0x1094 0x14 0x1072 0x16 0x1059 0x1d 0x1044 0x22 0x1030 0x29 0x1020 0x31 0x100d 0x36 0xffd 0x3d 0xff0 0x3f 0xfe5 0x47 0xfcf 0x4e 0xfb7 0x53 0xfa3 0x5a 0xf95 0x5f 0xf89 0x64 0xf7f 0x69 0xf73 0x70 0xf64 0x78 0xf53 0x7c 0xf43 0x84 0xf33 0x8b 0xf25 0x8d 0xf18 0x95 0xf0f 0x9a 0xf06 0xa1 0xefd 0xa6 0xef7 0xad 0xeef 0xb5 0xee7 0xb7 0xee3 0xbe 0xedc 0xc3 0xed7 0xca 0xed2 0xd2 0xece 0xd7 0xec9 0xde 0xec6 0xe0 0xec2 0xe8 0xebd 0xed 0xeb8 0xf4 0xeb1 0xfb 0xea9 0x100 0xe9e 0x105 0xe8f 0x10a 0xe80 0x111 0xe78 0x116 0xe75 0x11d 0xe72 0x125 0xe6c 0x12a 0xe60 0x12e 0xe29 0x133 0xdc8 0x13b 0xd90 0x142 0xd4b 0x144 0xcfb 0x144 0xcc3 0x144 0xc9e 0x147 0xc83 0x147 0xc6c 0x147 0xc55 0x147 0xc45 0x147 0xc34 0x147 0xc25 0x147 0xc18 0x147 0xc0c 0x147 0xc07 0x147 0xbfb 0x147 0xbf2 0x147 0xbe7 0x147 0xbe1 0x147 0xbd8 0x147 0xbd5 0x147 0xbca 0x147 0xbc0 0x147 0xbba 0x147 0xbbb 0x147 0xbb3 0x147 0xba9 0x147 0xba7 0x147 0xba3 0x147 0xb97>;
		battery_profile_t2_num = <0x52>;
		battery_profile_t2 = <0x0 0x10e8 0x2 0x10cf 0x4 0x10bb 0x5 0x10a7 0x7 0x1095 0x9 0x1083 0xb 0x1071 0xd 0x105d 0xe 0x104d 0x10 0x103b 0x13 0x102a 0x15 0x1019 0x16 0x1008 0x18 0xff7 0x1a 0xfe8 0x1c 0xfda 0x1e 0xfc9 0x1f 0xfb9 0x21 0xfab 0x23 0xf9c 0x25 0xf8f 0x27 0xf84 0x28 0xf76 0x2a 0xf69 0x2c 0xf56 0x2e 0xf43 0x30 0xf31 0x31 0xf24 0x34 0xf19 0x36 0xf0e 0x38 0xf06 0x39 0xf00 0x3b 0xef8 0x3d 0xef0 0x3f 0xeea 0x41 0xee5 0x42 0xedd 0x44 0xed9 0x46 0xed2 0x48 0xecd 0x4a 0xec8 0x4b 0xec2 0x4d 0xebc 0x4f 0xeb5 0x51 0xea9 0x54 0xea1 0x55 0xe95 0x57 0xe85 0x59 0xe73 0x5b 0xe6c 0x5c 0xe6b 0x5e 0xe69 0x60 0xe67 0x62 0xe54 0x64 0xe0d 0x65 0xda9 0x67 0xd3f 0x68 0xc55 0x69 0xc01 0x69 0xbce 0x69 0xbb0 0x69 0xb99 0x69 0xb8e 0x69 0xb82 0x69 0xb76 0x69 0xb6d 0x69 0xb61 0x69 0xb5e 0x69 0xb54 0x69 0xb4b 0x69 0xb4b 0x69 0xb4b 0x69 0xb4b 0x69 0xb4b 0x69 0xb4b 0x69 0xb4b 0x69 0xb4b 0x69 0xb4b 0x69 0xb4b 0x69 0xb4b 0x69 0xb4b 0x69 0xb4b>;
		battery_profile_t3_num = <0x52>;
		battery_profile_t3 = <0x0 0x10eb 0x2 0x10d1 0x3 0x10bc 0x5 0x10a9 0x7 0x1094 0xa 0x1081 0xb 0x106e 0xd 0x105c 0xf 0x104a 0x10 0x1039 0x12 0x1027 0x14 0x1017 0x16 0x1006 0x17 0xff5 0x1a 0xfe5 0x1c 0xfd6 0x1d 0xfc6 0x1f 0xfb7 0x21 0xfaa 0x23 0xf9c 0x24 0xf90 0x26 0xf82 0x28 0xf76 0x29 0xf6b 0x2c 0xf5e 0x2e 0xf51 0x2f 0xf40 0x31 0xf2c 0x33 0xf1c 0x35 0xf11 0x36 0xf08 0x38 0xefe 0x3b 0xef8 0x3c 0xef0 0x3e 0xee9 0x40 0xee3 0x42 0xede 0x43 0xed8 0x45 0xed2 0x47 0xece 0x48 0xec8 0x4a 0xec1 0x4d 0xeb3 0x4f 0xeae 0x50 0xea6 0x52 0xe9e 0x54 0xe95 0x55 0xe8b 0x57 0xe7d 0x59 0xe6e 0x5b 0xe5e 0x5d 0xe5c 0x5f 0xe5b 0x61 0xe5a 0x62 0xe55 0x64 0xe29 0x66 0xddb 0x68 0xda7 0x69 0xd82 0x6b 0xd03 0x6d 0xc44 0x6d 0xc06 0x6d 0xbd9 0x6d 0xbb9 0x6d 0xba4 0x6e 0xb90 0x6e 0xb80 0x6e 0xb74 0x6e 0xb69 0x6e 0xb61 0x6e 0xb57 0x6e 0xb53 0x6e 0xb49 0x6e 0xb49 0x6e 0xb49 0x6e 0xb49 0x6e 0xb49 0x6e 0xb49 0x6e 0xb49 0x6e 0xb49 0x6e 0xb49 0x6e 0xb49>;
		r_profile_t0_num = <0x52>;
		r_profile_t0 = <0x198 0x10cf 0x198 0x10b9 0x19f 0x10a5 0x1a9 0x1090 0x1ae 0x1079 0x1b8 0x1062 0x1cf 0x1049 0x1ea 0x1031 0x20d 0x1015 0x23d 0xff8 0x267 0xfe4 0x28a 0xfcf 0x2a3 0xfb3 0x2ad 0xf9d 0x2c1 0xf8d 0x2c9 0xf7f 0x2d0 0xf74 0x2dd 0xf66 0x2d8 0xf59 0x2e2 0xf49 0x2d5 0xf37 0x2df 0xf28 0x2e9 0xf1d 0x2ec 0xf11 0x2f8 0xf08 0x305 0xeff 0x30f 0xef6 0x323 0xeef 0x334 0xeea 0x343 0xee3 0x35f 0xede 0x378 0xed8 0x387 0xed4 0x39d 0xecf 0x3bb 0xecb 0x3cf 0xec5 0x3e8 0xebf 0x40b 0xeba 0x422 0xeb0 0x442 0xea8 0x451 0xe9e 0x46f 0xe93 0x490 0xe89 0x4ba 0xe81 0x4e7 0xe78 0x541 0xe72 0x596 0xe68 0x5ee 0xe51 0x622 0xe1d 0x652 0xdc6 0x684 0xd8a 0x64d 0xd74 0x61b 0xd60 0x5e6 0xd4c 0x5b4 0xd35 0x578 0xd1d 0x535 0xd04 0x503 0xcee 0x4d1 0xcdb 0x4ae 0xcca 0x483 0xcbb 0x468 0xcad 0x445 0xca2 0x433 0xc95 0x41d 0xc8c 0x3ff 0xc84 0x3fa 0xc79 0x3ed 0xc72 0x3d2 0xc6b 0x3c0 0xc60 0x3ac 0xc5a 0x37f 0xc55 0x37a 0xc4f 0x35f 0xc47 0x39d 0xc3d 0x37d 0xc35 0x37d 0xc35 0x37d 0xc35 0x37d 0xc35 0x37d 0xc35 0x37d 0xc35 0x37d 0xc35>;
		r_profile_t1_num = <0x52>;
		r_profile_t1 = <0x102 0x10dc 0x102 0x10bb 0x116 0x1094 0x12f 0x1072 0x14d 0x1059 0x157 0x1044 0x15e 0x1030 0x16d 0x1020 0x172 0x100d 0x172 0xffd 0x17c 0xff0 0x193 0xfe5 0x18b 0xfcf 0x193 0xfb7 0x193 0xfa3 0x19d 0xf95 0x1a2 0xf89 0x1a4 0xf7f 0x1a7 0xf73 0x19f 0xf64 0x19a 0xf53 0x190 0xf43 0x189 0xf33 0x189 0xf25 0x184 0xf18 0x18b 0xf0f 0x193 0xf06 0x195 0xefd 0x19f 0xef7 0x1a9 0xeef 0x1ae 0xee7 0x1bb 0xee3 0x1c2 0xedc 0x1d1 0xed7 0x1db 0xed2 0x1e3 0xece 0x1ea 0xec9 0x1f7 0xec6 0x208 0xec2 0x215 0xebd 0x221 0xeb8 0x233 0xeb1 0x24c 0xea9 0x258 0xe9e 0x260 0xe8f 0x267 0xe80 0x27b 0xe78 0x29e 0xe75 0x2c6 0xe72 0x2fd 0xe6c 0x348 0xe60 0x370 0xe29 0x393 0xdc8 0x438 0xd90 0x52b 0xd4b 0x523 0xcfb 0x49c 0xcc3 0x438 0xc9e 0x3f2 0xc83 0x3be 0xc6c 0x39d 0xc55 0x378 0xc45 0x35c 0xc34 0x32a 0xc25 0x314 0xc18 0x2fd 0xc0c 0x2bc 0xc07 0x2e9 0xbfb 0x2a8 0xbf2 0x2ad 0xbe7 0x28a 0xbe1 0x2ab 0xbd8 0x267 0xbd5 0x283 0xbca 0x294 0xbc0 0x27b 0xbba 0x212 0xbbb 0x280 0xbb3 0x253 0xba9 0x217 0xba7 0x1cf 0xba3 0x258 0xb97>;
		r_profile_t2_num = <0x52>;
		r_profile_t2 = <0x9b 0x10e8 0x9b 0x10cf 0x9b 0x10bb 0x9e 0x10a7 0x9e 0x1095 0xa3 0x1083 0xa5 0x1071 0xa5 0x105d 0xaa 0x104d 0xaa 0x103b 0xad 0x102a 0xad 0x1019 0xad 0x1008 0xb2 0xff7 0xb4 0xfe8 0xb9 0xfda 0xbc 0xfc9 0xbe 0xfb9 0xc8 0xfab 0xc8 0xf9c 0xcd 0xf8f 0xda 0xf84 0xd7 0xf76 0xd7 0xf69 0xc8 0xf56 0xbc 0xf43 0xad 0xf31 0xa8 0xf24 0xa3 0xf19 0xa0 0xf0e 0xa3 0xf06 0xa8 0xf00 0xaa 0xef8 0xaa 0xef0 0xaa 0xeea 0xb2 0xee5 0xaf 0xedd 0xb7 0xed9 0xb4 0xed2 0xb7 0xecd 0xb9 0xec8 0xb7 0xec2 0xb9 0xebc 0xb7 0xeb5 0xad 0xea9 0xad 0xea1 0xad 0xe95 0xad 0xe85 0xad 0xe73 0xaa 0xe6c 0xaf 0xe6b 0xb9 0xe69 0xc6 0xe67 0xcd 0xe54 0xd0 0xe0d 0xf0 0xda9 0x111 0xd3f 0x38c 0xc55 0x2c1 0xc01 0x253 0xbce 0x201 0xbb0 0x1d1 0xb99 0x19d 0xb8e 0x17c 0xb82 0x170 0xb76 0x168 0xb6d 0x14f 0xb61 0x113 0xb5e 0x13b 0xb54 0x11b 0xb4b 0x11b 0xb4b 0x11b 0xb4b 0x11b 0xb4b 0x11b 0xb4b 0x11b 0xb4b 0x11b 0xb4b 0x11b 0xb4b 0x11b 0xb4b 0x11b 0xb4b 0x11b 0xb4b 0x11b 0xb4b 0x11b 0xb4b>;
		r_profile_t3_num = <0x52>;
		r_profile_t3 = <0x7b 0x10eb 0x7b 0x10d1 0x80 0x10bc 0x82 0x10a9 0x82 0x1094 0x82 0x1081 0x80 0x106e 0x7d 0x105c 0x82 0x104a 0x85 0x1039 0x85 0x1027 0x8a 0x1017 0x8a 0x1006 0x8c 0xff5 0x8c 0xfe5 0x8f 0xfd6 0x8c 0xfc6 0x8f 0xfb7 0x94 0xfaa 0x99 0xf9c 0x9b 0xf90 0x9b 0xf82 0xa5 0xf76 0xaf 0xf6b 0xaf 0xf5e 0xb2 0xf51 0xaa 0xf40 0x94 0xf2c 0x87 0xf1c 0x87 0xf11 0x85 0xf08 0x85 0xefe 0x87 0xef8 0x87 0xef0 0x87 0xee9 0x8f 0xee3 0x91 0xede 0x94 0xed8 0x91 0xed2 0x99 0xece 0x96 0xec8 0x96 0xec1 0x85 0xeb3 0x8f 0xeae 0x8c 0xea6 0x8a 0xe9e 0x87 0xe95 0x87 0xe8b 0x85 0xe7d 0x85 0xe6e 0x82 0xe5e 0x82 0xe5c 0x8a 0xe5b 0x94 0xe5a 0xa0 0xe55 0x9e 0xe29 0xaa 0xddb 0xd0 0xda7 0xdc 0xd82 0x109 0xd03 0x357 0xc44 0x2d5 0xc06 0x258 0xbd9 0x210 0xbb9 0x1cc 0xba4 0x190 0xb90 0x17c 0xb80 0x163 0xb74 0x13b 0xb69 0x12f 0xb61 0x134 0xb57 0xff 0xb53 0x111 0xb49 0x111 0xb49 0x111 0xb49 0x111 0xb49 0x111 0xb49 0x111 0xb49 0x111 0xb49 0x111 0xb49 0x111 0xb49 0x111 0xb49>;
	};

	bat_gm30 {
		compatible = "mediatek,bat_gm30";
		DIFFERENCE_FULLOCV_ITH = <0x96>;
		SHUTDOWN_1_TIME = <0x3c>;
		KEEP_100_PERCENT = <0x3>;
		R_FG_VALUE = <0xa>;
		EMBEDDED_SEL = <0x0>;
		PMIC_SHUTDOWN_CURRENT = <0x14>;
		FG_METER_RESISTANCE = <0x32>;
		CAR_TUNE_VALUE = <0x65>;
		TEMPERATURE_T0 = <0x19>;
		TEMPERATURE_T1 = <0xa>;
		TEMPERATURE_T2 = <0x0>;
		TEMPERATURE_T3 = <0xfffffff6>;
		g_FG_PSEUDO100_T0 = <0x62>;
		g_FG_PSEUDO100_T1 = <0x5f>;
		g_FG_PSEUDO100_T2 = <0x5a>;
		g_FG_PSEUDO100_T3 = <0x50>;
		Q_MAX_SYS_VOLTAGE_BAT0 = <0xd48>;
		Q_MAX_SYS_VOLTAGE_BAT1 = <0xd48>;
		Q_MAX_SYS_VOLTAGE_BAT2 = <0xd48>;
		Q_MAX_SYS_VOLTAGE_BAT3 = <0xd48>;
		battery0_profile_t0_num = <0x64>;
		battery0_profile_t0 = <0x0 0xa96a 0x47e 0x133 0xa8b8 0x47e 0x266 0xa818 0x47e 0x398 0xa797 0x47e 0x4cb 0xa717 0x473 0x5fe 0xa698 0x467 0x731 0xa629 0x476 0x863 0xa5b8 0x48d 0x996 0xa543 0x4ab 0xac9 0xa4cf 0x4a3 0xbfc 0xa45c 0x49a 0xd2e 0xa3ed 0x4aa 0xe61 0xa37f 0x4b0 0xf94 0xa310 0x4b0 0x10c7 0xa2a8 0x4bf 0x11fa 0xa23d 0x4c4 0x132c 0xa1cf 0x4b5 0x145f 0xa165 0x4c6 0x1592 0xa0fd 0x4e3 0x16c5 0xa09b 0x4f2 0x17f7 0xa036 0x4fb 0x192a 0x9fce 0x4fb 0x1a5d 0x9f6f 0x52d 0x1b90 0x9f13 0x567 0x1cc2 0x9eb7 0x595 0x1df5 0x9e58 0x5b2 0x1f28 0x9df6 0x5c2 0x205b 0x9d99 0x5df 0x218d 0x9d3d 0x607 0x22c0 0x9ce1 0x644 0x23f3 0x9c89 0x66d 0x2526 0x9c33 0x68b 0x2659 0x9be4 0x69b 0x278b 0x9b94 0x6b0 0x28be 0x9b44 0x6cf 0x29f1 0x9af4 0x6ee 0x2b24 0x9aa6 0x70a 0x2c56 0x9a5c 0x71a 0x2d89 0x9a06 0x709 0x2ebc 0x99a4 0x6db 0x2fef 0x9937 0x685 0x3121 0x98c7 0x61d 0x3254 0x9852 0x593 0x3387 0x97e5 0x539 0x34ba 0x977d 0x4fb 0x35ed 0x9733 0x4cd 0x371f 0x96ee 0x4b6 0x3852 0x96b0 0x4c5 0x3985 0x9678 0x4c9 0x3ab8 0x9641 0x4c9 0x3bea 0x9610 0x4c9 0x3d1d 0x95e2 0x4d8 0x3e50 0x95b7 0x4f6 0x3f83 0x9587 0x4ee 0x40b5 0x9558 0x4e5 0x41e8 0x9533 0x4f5 0x431b 0x950b 0x504 0x444e 0x94e0 0x513 0x4581 0x94bb 0x523 0x46b3 0x9498 0x532 0x47e6 0x9479 0x541 0x4919 0x9456 0x546 0x4a4c 0x9432 0x546 0x4b7e 0x940d 0x546 0x4cb1 0x93e8 0x546 0x4de4 0x93c3 0x546 0x4f17 0x93a3 0x552 0x5049 0x9383 0x55f 0x517c 0x935e 0x55f 0x52af 0x9335 0x55f 0x53e2 0x930a 0x55f 0x5515 0x92da 0x55f 0x5647 0x92a5 0x550 0x577a 0x9267 0x522 0x58ad 0x922e 0x529 0x59e0 0x91f5 0x544 0x5b12 0x919f 0x526 0x5c45 0x9147 0x521 0x5d78 0x90eb 0x540 0x5eab 0x9080 0x521 0x5fdd 0x9020 0x4f8 0x6110 0x9007 0x4e9 0x6243 0x8ff9 0x4fb 0x6376 0x8ff3 0x529 0x64a8 0x8fe7 0x557 0x65db 0x8fd9 0x596 0x670e 0x8fc6 0x601 0x6841 0x8f35 0x627 0x6974 0x8e5a 0x628 0x6aa6 0x8c8e 0x675 0x6bd9 0x8ad9 0x6fd 0x6d0c 0x894a 0x7e3 0x6e3f 0x88a4 0x8e1 0x6f71 0x8847 0x9eb 0x70a4 0x87de 0xb1e 0x71d7 0x86ef 0xc0c 0x730a 0x8579 0xcb5 0x743c 0x8253 0x1102 0x756f 0x7e82 0x1a75 0x76a2 0x75f8 0x170c>;
		battery0_profile_t1_num = <0x64>;
		battery0_profile_t1 = <0x0 0xa9ba 0x4e2 0x133 0xa8fc 0x4e2 0x266 0xa815 0x50f 0x398 0xa6e8 0x58a 0x4cb 0xa5f2 0x682 0x5fe 0xa516 0x796 0x731 0xa473 0x833 0x863 0xa3df 0x897 0x996 0xa358 0x8c5 0xac9 0xa2e6 0x8f3 0xbfc 0xa278 0x919 0xd2e 0xa20a 0x928 0xe61 0xa19f 0x94b 0xf94 0xa137 0x979 0x10c7 0xa0c8 0x979 0x11fa 0xa05e 0x984 0x132c 0x9ffc 0x9a3 0x145f 0x9f9e 0x9c2 0x1592 0x9f44 0x9e2 0x16c5 0x9ef9 0xa11 0x17f7 0x9e9f 0xa30 0x192a 0x9e37 0xa3f 0x1a5d 0x9db9 0xa5c 0x1b90 0x9d3b 0xa7b 0x1cc2 0x9cc7 0xa99 0x1df5 0x9c65 0xaae 0x1f28 0x9c0f 0xabe 0x205b 0x9bcb 0xaeb 0x218d 0x9b87 0xb0f 0x22c0 0x9b43 0xb1e 0x23f3 0x9af5 0xb22 0x2526 0x9aa5 0xb20 0x2659 0x9a4f 0xb11 0x278b 0x99f3 0xaf2 0x28be 0x9991 0xac4 0x29f1 0x9924 0xa6e 0x2b24 0x98b6 0xa15 0x2c56 0x984c 0x9c7 0x2d89 0x97eb 0x98d 0x2ebc 0x978f 0x95f 0x2fef 0x973f 0x931 0x3121 0x96f7 0x91b 0x3254 0x96b9 0x92a 0x3387 0x9680 0x92e 0x34ba 0x964a 0x930 0x35ed 0x9618 0x940 0x371f 0x95e6 0x94f 0x3852 0x95b5 0x95e 0x3985 0x958f 0x989 0x3ab8 0x9569 0x9af 0x3bea 0x953e 0x9be 0x3d1d 0x9513 0x9c4 0x3e50 0x94e8 0x9c4 0x3f83 0x94c9 0x9f3 0x40b5 0x94a7 0xa15 0x41e8 0x9482 0xa25 0x431b 0x9462 0xa34 0x444e 0x9443 0xa48 0x4581 0x9425 0xa76 0x46b3 0x9409 0xa94 0x47e6 0x93f1 0xaa3 0x4919 0x93c7 0xaa5 0x4a4c 0x939d 0xaa1 0x4b7e 0x9378 0xa91 0x4cb1 0x9358 0xaa0 0x4de4 0x9339 0xabe 0x4f17 0x9314 0xace 0x5049 0x92ea 0xad7 0x517c 0x92b9 0xad7 0x52af 0x927f 0xad7 0x53e2 0x923f 0xad9 0x5515 0x91f4 0xae9 0x5647 0x91a0 0xae8 0x577a 0x9144 0xad8 0x58ad 0x90f3 0xad7 0x59e0 0x90af 0xad3 0x5b12 0x908b 0xac3 0x5c45 0x9072 0xaf0 0x5d78 0x9060 0xb3e 0x5eab 0x9053 0xbb9 0x5fdd 0x9042 0xc5a 0x6110 0x9029 0xd35 0x6243 0x8fc2 0xe19 0x6376 0x8f13 0xecb 0x64a8 0x8d5f 0xe7e 0x65db 0x8b73 0xe3a 0x670e 0x8957 0xdfd 0x6841 0x88a0 0xf0e 0x6974 0x880f 0x109f 0x6aa6 0x8782 0x1323 0x6bd9 0x8603 0x15ed 0x6d0c 0x83e1 0x1979 0x6e3f 0x7f66 0x284b 0x6f71 0x7652 0x17d4 0x70a4 0x7652 0x17d4 0x71d7 0x7652 0x17d4 0x730a 0x7652 0x17d4 0x743c 0x7652 0x17d4 0x756f 0x7652 0x17d4 0x76a2 0x7652 0x17d4>;
		battery0_profile_t2_num = <0x64>;
		battery0_profile_t2 = <0x0 0xa9a6 0x721 0x133 0xa925 0x721 0x266 0xa8a9 0x72c 0x398 0xa834 0x74b 0x4cb 0xa7bb 0x75e 0x5fe 0xa73f 0x76f 0x731 0xa6b5 0x78f 0x863 0xa614 0x7a6 0x996 0xa55c 0x7b5 0xac9 0xa468 0x867 0xbfc 0xa377 0x969 0xd2e 0xa2a7 0xb16 0xe61 0xa1f5 0xc81 0xf94 0xa155 0xdc3 0x10c7 0xa0d1 0xe51 0x11fa 0xa056 0xeb8 0x132c 0x9fe8 0xee6 0x145f 0x9f8c 0xf14 0x1592 0x9f37 0xf46 0x16c5 0x9ee7 0xf93 0x17f7 0x9e7c 0xfb9 0x192a 0x9df5 0xfb9 0x1a5d 0x9d66 0xfe2 0x1b90 0x9cdc 0x1008 0x1cc2 0x9c61 0x1018 0x1df5 0x9bfe 0x103b 0x1f28 0x9ba9 0x1069 0x205b 0x9b65 0x1087 0x218d 0x9b1f 0x109a 0x22c0 0x9ad6 0x109a 0x23f3 0x9a86 0x108e 0x2526 0x9a32 0x107a 0x2659 0x99d0 0x104c 0x278b 0x996e 0x101d 0x28be 0x990c 0xfef 0x29f1 0x98a4 0xfb4 0x2b24 0x983f 0xf7f 0x2c56 0x97e3 0xf60 0x2d89 0x978e 0xf4b 0x2ebc 0x973d 0xf3d 0x2fef 0x96f9 0xf4c 0x3121 0x96bb 0xf5b 0x3254 0x9684 0xf6b 0x3387 0x9651 0xf92 0x34ba 0x9620 0xfbe 0x35ed 0x95ef 0xfdc 0x371f 0x95be 0xffb 0x3852 0x958d 0x101a 0x3985 0x9567 0x1038 0x3ab8 0x9540 0x105b 0x3bea 0x9515 0x108a 0x3d1d 0x94e9 0x10af 0x3e50 0x94bf 0x10cd 0x3f83 0x949a 0x10ec 0x40b5 0x9475 0x1111 0x41e8 0x9450 0x113f 0x431b 0x9430 0x116d 0x444e 0x940f 0x1196 0x4581 0x93e4 0x11a6 0x46b3 0x93bf 0x11c6 0x47e6 0x93a0 0x11f4 0x4919 0x9376 0x1206 0x4a4c 0x934b 0x1223 0x4b7e 0x9321 0x1260 0x4cb1 0x92ed 0x1289 0x4de4 0x92b6 0x12a9 0x4f17 0x927e 0x12d7 0x5049 0x9243 0x130d 0x517c 0x9206 0x134a 0x52af 0x91ba 0x1356 0x53e2 0x916d 0x135e 0x5515 0x9130 0x138c 0x5647 0x90fd 0x13cb 0x577a 0x90d2 0x1418 0x58ad 0x90b1 0x149f 0x59e0 0x9094 0x1548 0x5b12 0x907c 0x162e 0x5c45 0x905f 0x175e 0x5d78 0x903c 0x18af 0x5eab 0x8fda 0x19f1 0x5fdd 0x8f26 0x1ade 0x6110 0x8e06 0x1b58 0x6243 0x8c3c 0x1b26 0x6376 0x8a5f 0x1af7 0x64a8 0x88e3 0x1b81 0x65db 0x87da 0x1d9e 0x670e 0x8728 0x20ea 0x6841 0x8528 0x2581 0x6974 0x823a 0x2b52 0x6aa6 0x7c70 0x261e 0x6bd9 0x78b4 0x1ccf 0x6d0c 0x78b4 0x1ccf 0x6e3f 0x78b4 0x1ccf 0x6f71 0x78b4 0x1ccf 0x70a4 0x78b4 0x1ccf 0x71d7 0x78b4 0x1ccf 0x730a 0x78b4 0x1ccf 0x743c 0x78b4 0x1ccf 0x756f 0x78b4 0x1ccf 0x76a2 0x78b4 0x1ccf>;
		battery0_profile_t3_num = <0x64>;
		battery0_profile_t3 = <0x0 0xa956 0xbb8 0x133 0xa8cf 0xbb8 0x266 0xa84d 0xbc3 0x398 0xa7d2 0xbe2 0x4cb 0xa75a 0xbf6 0x5fe 0xa6e4 0xc03 0x731 0xa676 0xc03 0x863 0xa60a 0xc13 0x996 0xa5a2 0xc31 0xac9 0xa53a 0xc5e 0xbfc 0xa4d0 0xc84 0xd2e 0xa462 0xc93 0xe61 0xa3f2 0xcad 0xf94 0xa381 0xccb 0x10c7 0xa313 0xcdb 0x11fa 0xa2ae 0xd15 0x132c 0xa258 0xd8f 0x145f 0xa1e1 0xe16 0x1592 0xa151 0xeae 0x16c5 0xa05b 0xfa4 0x17f7 0x9f66 0x1182 0x192a 0x9e72 0x1442 0x1a5d 0x9da4 0x1694 0x1b90 0x9ce0 0x18a7 0x1cc2 0x9c2e 0x1a36 0x1df5 0x9ba4 0x1b12 0x1f28 0x9b30 0x1b8b 0x205b 0x9ad4 0x1bb9 0x218d 0x9a7c 0x1bfa 0x22c0 0x9a2b 0x1c57 0x23f3 0x99d1 0x1c77 0x2526 0x9973 0x1c7f 0x2659 0x990b 0x1c60 0x278b 0x98a6 0x1c52 0x28be 0x9844 0x1c52 0x29f1 0x97ec 0x1c60 0x2b24 0x9798 0x1c6f 0x2c56 0x9748 0x1c7f 0x2d89 0x9708 0x1cac 0x2ebc 0x96cf 0x1ce9 0x2fef 0x9692 0x1d08 0x3121 0x9657 0x1d3a 0x3254 0x9620 0x1d87 0x3387 0x95f2 0x1dd3 0x34ba 0x95c6 0x1e1e 0x35ed 0x9595 0x1e5b 0x371f 0x9564 0x1ea9 0x3852 0x9532 0x1f07 0x3985 0x9506 0x1f55 0x3ab8 0x94d9 0x1fa2 0x3bea 0x94a8 0x1fef 0x3d1d 0x947b 0x2046 0x3e50 0x9450 0x20a1 0x3f83 0x9412 0x20ee 0x40b5 0x93d7 0x2141 0x41e8 0x939f 0x219f 0x431b 0x9362 0x21fc 0x444e 0x9324 0x2255 0x4581 0x92e0 0x22a2 0x46b3 0x92a0 0x2308 0x47e6 0x9263 0x2382 0x4919 0x9220 0x23e1 0x4a4c 0x91de 0x2459 0x4b7e 0x919f 0x2515 0x4cb1 0x9161 0x25ee 0x4de4 0x9124 0x26d5 0x4f17 0x90ed 0x27ca 0x5049 0x90b6 0x28da 0x517c 0x907f 0x2a0d 0x52af 0x9039 0x2b4c 0x53e2 0x8fe3 0x2c8d 0x5515 0x8f53 0x2dc6 0x5647 0x8e81 0x2ea3 0x577a 0x8d7f 0x2f3c 0x58ad 0x8be1 0x2f53 0x59e0 0x8a33 0x2fba 0x5b12 0x887a 0x30dd 0x5c45 0x86cd 0x3465 0x5d78 0x8513 0x389f 0x5eab 0x8193 0x32bf 0x5fdd 0x7ca6 0x2742 0x6110 0x7ca6 0x2742 0x6243 0x7ca6 0x2742 0x6376 0x7ca6 0x2742 0x64a8 0x7ca6 0x2742 0x65db 0x7ca6 0x2742 0x670e 0x7ca6 0x2742 0x6841 0x7ca6 0x2742 0x6974 0x7ca6 0x2742 0x6aa6 0x7ca6 0x2742 0x6bd9 0x7ca6 0x2742 0x6d0c 0x7ca6 0x2742 0x6e3f 0x7ca6 0x2742 0x6f71 0x7ca6 0x2742 0x70a4 0x7ca6 0x2742 0x71d7 0x7ca6 0x2742 0x730a 0x7ca6 0x2742 0x743c 0x7ca6 0x2742 0x756f 0x7ca6 0x2742 0x76a2 0x7ca6 0x2742>;
	};

	mt_charger {
		compatible = "mediatek,mt-charger";
	};

	swtp {
		compatible = "mediatek, swtp-eint";
	};

	pmic_clock_buffer {
		compatible = "mediatek,pmic_clock_buffer";
		mediatek,clkbuf-quantity = <0x7>;
		mediatek,clkbuf-config = <0x2 0x1 0x1 0x2 0x0 0x0 0x0>;
		mediatek,clkbuf-driving-current = <0x2 0x2 0x2 0x2 0x2 0x2 0x2>;
		status = "okay";
	};

	usbphy@0 {
		compatible = "usb-nop-xceiv";
	};

	chipid@08000000 {
		compatible = "mediatek,chipid";
		reg = <0x0 0x8000000 0x0 0x4 0x0 0x8000004 0x0 0x4 0x0 0x8000008 0x0 0x4 0x0 0x800000c 0x0 0x4>;
	};

	gic500@0c000000 {
		compatible = "mediatek,gic500";
		reg = <0x0 0xc000000 0x0 0x400000>;
	};

	gic_cpu@0c400000 {
		compatible = "mediatek,gic_cpu";
		reg = <0x0 0xc400000 0x0 0x40000>;
	};

	dfd@0c600000 {
		compatible = "mediatek,dfd";
		reg = <0x0 0xc600000 0x0 0x100000>;
		mediatek,enabled = <0x1>;
		mediatek,chain_length = <0x61a8>;
		mediatek,rg_dfd_timeout = <0x2>;
	};

	dbg_etb@0d010000 {
		compatible = "mediatek,dbg_etb";
		reg = <0x0 0xd010000 0x0 0x10000>;
	};

	dbg_cti@0d020000 {
		compatible = "mediatek,dbg_cti";
		reg = <0x0 0xd020000 0x0 0x10000>;
	};

	dbg_etr@0d030000 {
		compatible = "mediatek,dbg_etr";
		reg = <0x0 0xd030000 0x0 0x10000>;
	};

	dbg_funnel@0d040000 {
		compatible = "mediatek,dbg_funnel";
		reg = <0x0 0xd040000 0x0 0x10000>;
	};

	dbg_dem@0d0a0000 {
		compatible = "mediatek,dbg_dem";
		reg = <0x0 0xd0a0000 0x0 0x10000>;
	};

	dbg_mdsys1@0d0c0000 {
		compatible = "mediatek,dbg_mdsys1";
		reg = <0x0 0xd0c0000 0x0 0x40000>;
	};

	dbg_apmcu_mp0@0d400000 {
		compatible = "mediatek,dbg_apmcu_mp0";
		reg = <0x0 0xd400000 0x0 0x400000>;
	};

	dbg_apmcu_mp1@0d800000 {
		compatible = "mediatek,dbg_apmcu_mp1";
		reg = <0x0 0xd800000 0x0 0x400000>;
	};

	cpu_dbgapb {
		compatible = "mediatek,hw_dbg";
		num = <0x8>;
		reg = <0x0 0xd410000 0x0 0x1000 0x0 0xd510000 0x0 0x1000 0x0 0xd610000 0x0 0x1000 0x0 0xd710000 0x0 0x1000 0x0 0xd810000 0x0 0x1000 0x0 0xd910000 0x0 0x1000 0x0 0xda10000 0x0 0x1000 0x0 0xdb10000 0x0 0x1000>;
	};

	topckgen@10000000 {
		compatible = "mediatek,topckgen";
		reg = <0x0 0x10000000 0x0 0x1000>;
		#clock-cells = <0x1>;
		linux,phandle = <0x2f>;
		phandle = <0x2f>;
	};

	usb2jtag@10001000 {
		compatible = "mediatek,usb2jtag_v1";
		reg = <0x0 0x10001000 0x0 0x1000 0x0 0x11290000 0x0 0x1000 0x0 0x11210000 0x0 0x1000>;
	};

	infracfg_ao@10001000 {
		compatible = "mediatek,infracfg_ao";
		reg = <0x0 0x10001000 0x0 0x1000>;
		interrupts = <0x0 0x88 0x1>;
		#clock-cells = <0x1>;
		linux,phandle = <0x2>;
		phandle = <0x2>;
	};

	btcvsd@10001000 {
		compatible = "mediatek,audio_bt_cvsd";
		offset = <0xf00 0x800 0xfd0 0xfd4 0xfd8>;
		reg = <0x0 0x10001000 0x0 0x1000 0x0 0x18000000 0x0 0x10000 0x0 0x18080000 0x0 0x8000>;
		interrupts = <0x0 0x109 0x8>;
	};

	scpsys@10001000 {
		compatible = "mediatek,mt6757-scpsys";
		reg = <0x0 0x10001000 0x0 0x1000 0x0 0x10006000 0x0 0x1000 0x0 0x1020e000 0x0 0x1000 0x0 0x10000000 0x0 0x1000>;
		#clock-cells = <0x1>;
		linux,phandle = <0x31>;
		phandle = <0x31>;
	};

	iocfg_0@10002000 {
		compatible = "mediatek,iocfg_0";
		reg = <0x0 0x10002000 0x0 0x200>;
	};

	syscfg_pctl_a@10002000 {
		compatible = "mediatek,mt6757-pctl-a-syscfg", "syscon";
		reg = <0x0 0x10002000 0x0 0x1000>;
		linux,phandle = <0x2e>;
		phandle = <0x2e>;
	};

	iocfg_1@10002200 {
		compatible = "mediatek,iocfg_1";
		reg = <0x0 0x10002200 0x0 0x200>;
	};

	iocfg_2@10002400 {
		compatible = "mediatek,iocfg_2";
		reg = <0x0 0x10002400 0x0 0x200>;
	};

	iocfg_3@10002600 {
		compatible = "mediatek,iocfg_3";
		reg = <0x0 0x10002600 0x0 0x200>;
	};

	iocfg_4@10002800 {
		compatible = "mediatek,iocfg_4";
		reg = <0x0 0x10002800 0x0 0x200>;
	};

	iocfg_5@10002a00 {
		compatible = "mediatek,iocfg_5";
		reg = <0x0 0x10002a00 0x0 0x200>;
	};

	pericfg@10003000 {
		compatible = "mediatek,pericfg";
		reg = <0x0 0x10003000 0x0 0x1000>;
	};

	pinctrl@10005000 {
		compatible = "mediatek,mt6757-pinctrl";
		reg = <0x0 0x10005000 0x0 0x1000>;
		mediatek,pctl-regmap = <0x2e>;
		pins-are-numbered;
		gpio-controller;
		#gpio-cells = <0x2>;
		linux,phandle = <0xb>;
		phandle = <0xb>;

		mmc0@default {
			linux,phandle = <0x3>;
			phandle = <0x3>;

			pins_cmd {
				drive-strength = [03];
			};

			pins_dat {
				drive-strength = [03];
			};

			pins_clk {
				drive-strength = [03];
			};

			pins_rst {
				drive-strength = [03];
			};

			pins_ds {
				drive-strength = [01];
			};
		};

		mmc0@register_default {
			datrddly = <0x0 0x0>;
			datwrddly = [00];
			cmdrrddly = [00];
			cmdrddly = [00];
			cmd_edge = [01];
			rdata_edge = [01];
			wdata_edge = [01];
			linux,phandle = <0x4>;
			phandle = <0x4>;
		};

		mmc1@default {
			linux,phandle = <0x6>;
			phandle = <0x6>;

			pins_cmd {
				drive-strength = [03];
			};

			pins_dat {
				drive-strength = [03];
			};

			pins_clk {
				drive-strength = [04];
			};
		};

		mmc1@sdr104 {
			linux,phandle = <0x7>;
			phandle = <0x7>;

			pins_cmd {
				drive-strength = [03];
			};

			pins_dat {
				drive-strength = [03];
			};

			pins_clk {
				drive-strength = [03];
			};
		};

		mmc1@sdr50 {
			linux,phandle = <0x8>;
			phandle = <0x8>;

			pins_cmd {
				drive-strength = [03];
			};

			pins_dat {
				drive-strength = [03];
			};

			pins_clk {
				drive-strength = [03];
			};
		};

		mmc1@ddr50 {
			linux,phandle = <0x9>;
			phandle = <0x9>;

			pins_cmd {
				drive-strength = [03];
			};

			pins_dat {
				drive-strength = [03];
			};

			pins_clk {
				drive-strength = [03];
			};
		};

		mmc1@register_default {
			datrddly = <0x0 0x0>;
			datwrddly = [00];
			cmdrrddly = [00];
			cmdrddly = [00];
			cmd_edge = [00];
			rdata_edge = [00];
			wdata_edge = [00];
			linux,phandle = <0xa>;
			phandle = <0xa>;
		};

		mmc2@default {
			linux,phandle = <0xe>;
			phandle = <0xe>;

			pins_cmd {
				drive-strength = [03];
			};

			pins_dat {
				drive-strength = [03];
			};

			pins_clk {
				drive-strength = [03];
			};
		};

		mmc2@register_default {
			datrddly = <0x0 0x0>;
			datwrddly = [00];
			cmdrrddly = [00];
			cmdrddly = [00];
			cmd_edge = [01];
			rdata_edge = [01];
			wdata_edge = [01];
			linux,phandle = <0xf>;
			phandle = <0xf>;
		};

		eint0default {
			linux,phandle = <0x26>;
			phandle = <0x26>;
		};

		eint@0 {
			linux,phandle = <0x27>;
			phandle = <0x27>;

			pins_cmd_dat {
				pins = <0x100>;
				slew-rate = <0x0>;
				bias-disable;
			};
		};

		eintoutput0 {
			linux,phandle = <0x28>;
			phandle = <0x28>;

			pins_cmd_dat {
				pins = <0x100>;
				slew-rate = <0x1>;
				output-low;
			};
		};

		eintoutput1 {
			linux,phandle = <0x29>;
			phandle = <0x29>;

			pins_cmd_dat {
				pins = <0x100>;
				slew-rate = <0x1>;
				output-high;
			};
		};

		rstoutput0 {
			linux,phandle = <0x2a>;
			phandle = <0x2a>;

			pins_cmd_dat {
				pins = <0xa00>;
				slew-rate = <0x1>;
				output-low;
			};
		};

		rstoutput1 {
			linux,phandle = <0x2b>;
			phandle = <0x2b>;

			pins_cmd_dat {
				pins = <0xa00>;
				slew-rate = <0x1>;
				output-high;
			};
		};

		alspspincfg {
			linux,phandle = <0x6f>;
			phandle = <0x6f>;

			pins_cmd_dat {
				pins = <0x600>;
				slew-rate = <0x0>;
				bias-pull-up = <0x0>;
			};
		};

		alspsdefaultcfg {
			linux,phandle = <0x6e>;
			phandle = <0x6e>;
		};

		gyropincfg {
			linux,phandle = <0x71>;
			phandle = <0x71>;

			pins_cmd_dat {
				pins = <0x500>;
				slew-rate = <0x0>;
				bias-pull-down = <0x0>;
			};
		};

		gyrodefaultcfg {
			linux,phandle = <0x70>;
			phandle = <0x70>;
		};

		accdetdefault {
			linux,phandle = <0x2c>;
			phandle = <0x2c>;
		};

		accdet@0 {
			linux,phandle = <0x2d>;
			phandle = <0x2d>;

			pins_cmd_dat {
				pins = <0x0>;
				slew-rate = <0x0>;
				bias-disable;
			};
		};

		default {
			linux,phandle = <0x1e>;
			phandle = <0x1e>;
		};

		gpslna@0 {
			linux,phandle = <0x4c>;
			phandle = <0x4c>;

			pins_cmd_dat {
				pins = <0x7200>;
				slew-rate = <0x0>;
				bias-disable;
				output-low;
			};
		};

		gpslna@1 {
			linux,phandle = <0x4d>;
			phandle = <0x4d>;

			pins_cmd_dat {
				pins = <0x7200>;
				slew-rate = <0x1>;
				output-high;
			};
		};

		gpslna@2 {
			linux,phandle = <0x4e>;
			phandle = <0x4e>;

			pins_cmd_dat {
				pins = <0x7200>;
				slew-rate = <0x1>;
				output-low;
			};
		};

		aud_clk_mosi_off {
			linux,phandle = <0x3b>;
			phandle = <0x3b>;

			pins_cmd0_dat {
				pins = <0x9500>;
			};
		};

		aud_clk_mosi_on {
			linux,phandle = <0x3c>;
			phandle = <0x3c>;

			pins_cmd0_dat {
				pins = <0x9501>;
			};
		};

		aud_dat_mosi_off {
			linux,phandle = <0x3d>;
			phandle = <0x3d>;

			pins_cmd1_dat {
				pins = <0x9600>;
				slew-rate = <0x0>;
				bias-pull-up = <0x0>;
			};
		};

		aud_dat_mosi_on {
			linux,phandle = <0x3e>;
			phandle = <0x3e>;

			pins_cmd1_dat {
				pins = <0x9601>;
			};
		};

		aud_dat_miso_off {
			linux,phandle = <0x3f>;
			phandle = <0x3f>;

			pins_cmd2_dat {
				pins = <0x9700>;
			};
		};

		aud_dat_miso_on {
			linux,phandle = <0x40>;
			phandle = <0x40>;

			pins_cmd2_dat {
				pins = <0x9701>;
			};
		};

		audhpdepophigh {
			linux,phandle = <0x41>;
			phandle = <0x41>;

			pins_cmd_dat {
				pins = <0x1800>;
				slew-rate = <0x1>;
				output-high;
			};
		};

		audhpdepoplow {
			linux,phandle = <0x42>;
			phandle = <0x42>;

			pins_cmd_dat {
				pins = <0x1800>;
				slew-rate = <0x1>;
				output-low;
			};
		};

		aud_pins_smartpa_reset {
			linux,phandle = <0x43>;
			phandle = <0x43>;

			pins_cmd0_dat {
				pins = <0xbe00>;
			};
		};

		aud_pins_smartpa_on {
			linux,phandle = <0x44>;
			phandle = <0x44>;

			pins_cmd0_dat {
				pins = <0x1006>;
			};

			pins_cmd1_dat {
				pins = <0x1a06>;
			};

			pins_cmd2_dat {
				pins = <0x1b06>;
			};

			pins_cmd3_dat {
				pins = <0x1c06>;
			};
		};

		aud_clk_mosi_pull_high {
			linux,phandle = <0x45>;
			phandle = <0x45>;

			pins_cmd_dat {
				pins = <0x9500>;
				slew-rate = <0x1>;
				output-high;
			};
		};

		aud_clk_mosi_pull_low {
			linux,phandle = <0x46>;
			phandle = <0x46>;

			pins_cmd_dat {
				pins = <0x9500>;
				slew-rate = <0x1>;
				output-low;
			};
		};

		aud_extamp_pull_high {
			linux,phandle = <0x47>;
			phandle = <0x47>;

			pins_cmd_dat {
				pins = <0x1400>;
				slew-rate = <0x1>;
				output-high;
			};
		};

		aud_extamp_pull_low {
			linux,phandle = <0x48>;
			phandle = <0x48>;

			pins_cmd_dat {
				pins = <0x1400>;
				slew-rate = <0x1>;
				output-low;
			};
		};

		state_ven_high {
			linux,phandle = <0x67>;
			phandle = <0x67>;

			pins_cmd_dat {
				pins = <0xf00>;
				slew-rate = <0x1>;
				output-high;
			};
		};

		state_ven_low {
			linux,phandle = <0x68>;
			phandle = <0x68>;

			pins_cmd_dat {
				pins = <0xf00>;
				slew-rate = <0x1>;
				output-low;
			};
		};

		state_rst_high {
			linux,phandle = <0x69>;
			phandle = <0x69>;

			pins_cmd_dat {
				pins = <0x1900>;
				slew-rate = <0x1>;
				output-high;
			};
		};

		state_rst_low {
			linux,phandle = <0x6a>;
			phandle = <0x6a>;

			pins_cmd_dat {
				pins = <0x1900>;
				slew-rate = <0x1>;
				output-low;
			};
		};

		state_eint_high {
			linux,phandle = <0x6b>;
			phandle = <0x6b>;

			pins_cmd_dat {
				pins = <0xe00>;
				slew-rate = <0x1>;
				output-high;
			};
		};

		state_eint_low {
			linux,phandle = <0x6c>;
			phandle = <0x6c>;

			pins_cmd_dat {
				pins = <0xe00>;
				slew-rate = <0x1>;
				output-low;
			};
		};

		state_irq_init {
			linux,phandle = <0x6d>;
			phandle = <0x6d>;

			pins_cmd_dat {
				pins = <0xd00>;
				slew-rate = <0x0>;
				bias-pull-down = <0x0>;
			};
		};

		uart0gpiodefault {
		};

		uart0_rx_set@gpio105 {

			pins_cmd_dat {
				pins = <0x6901>;
			};
		};

		uart0_rx_clear@gpio105 {

			pins_cmd_dat {
				pins = <0x6900>;
				slew-rate = <0x1>;
				output-high;
			};
		};

		uart0_tx_set@gpio106 {

			pins_cmd_dat {
				pins = <0x6a01>;
			};
		};

		uart0_tx_clear@gpio106 {

			pins_cmd_dat {
				pins = <0x6a00>;
				slew-rate = <0x1>;
				output-high;
			};
		};

		irtx_gpio_led_def@gpio116 {
			linux,phandle = <0x72>;
			phandle = <0x72>;
		};

		irtx_gpio_led_set@gpio116 {
			linux,phandle = <0x73>;
			phandle = <0x73>;
		};

		irtx_gpio_en_def@gpio104 {
			linux,phandle = <0x74>;
			phandle = <0x74>;

			pins_cmd_dat {
				pins = <0x6800>;
				slew-rate = <0x1>;
				bias-disable;
				output-low;
				input-schmitt-enable = <0x0>;
			};
		};

		irtx_gpio_en_set@gpio104 {
			linux,phandle = <0x75>;
			phandle = <0x75>;

			pins_cmd_dat {
				pins = <0x6800>;
				slew-rate = <0x1>;
				output-high;
			};
		};

		iddig_default {
			linux,phandle = <0x76>;
			phandle = <0x76>;
		};

		iddig_init {
			linux,phandle = <0x77>;
			phandle = <0x77>;

			pins_cmd_dat {
				pins = <0x2a01>;
				input-enable;
				slew-rate = <0x0>;
				bias-pull-up = <0x0>;
			};
		};

		iddig_enable {
			linux,phandle = <0x78>;
			phandle = <0x78>;

			pins_cmd_dat {
				pins = <0x2a01>;
				input-enable;
				slew-rate = <0x0>;
				bias-pull-up = <0x0>;
			};
		};

		iddig_disable {
			linux,phandle = <0x79>;
			phandle = <0x79>;

			pins_cmd_dat {
				pins = <0x2a00>;
				input-disable;
				slew-rate = <0x1>;
				output-low;
			};
		};

		drvvbus_default {
			linux,phandle = <0x49>;
			phandle = <0x49>;
		};

		drvvbus_low {
			linux,phandle = <0x4a>;
			phandle = <0x4a>;

			pins_cmd_dat {
				pins = <0x2b01>;
				slew-rate = <0x1>;
				output-low;
			};
		};

		drvvbus_high {
			linux,phandle = <0x4b>;
			phandle = <0x4b>;

			pins_cmd_dat {
				pins = <0x2b01>;
				slew-rate = <0x1>;
				output-high;
			};
		};

		cam0@0 {
			linux,phandle = <0x55>;
			phandle = <0x55>;

			pins_cmd_dat {
				pins = <0x6e00>;
				slew-rate = <0x1>;
				output-low;
			};
		};

		cam0@1 {
			linux,phandle = <0x56>;
			phandle = <0x56>;

			pins_cmd_dat {
				pins = <0x6e00>;
				slew-rate = <0x1>;
				output-high;
			};
		};

		cam0@2 {
			linux,phandle = <0x57>;
			phandle = <0x57>;

			pins_cmd_dat {
				pins = <0x6b00>;
				slew-rate = <0x1>;
				output-low;
			};
		};

		cam0@3 {
			linux,phandle = <0x58>;
			phandle = <0x58>;

			pins_cmd_dat {
				pins = <0x6b00>;
				slew-rate = <0x1>;
				output-high;
			};
		};

		cam1@0 {
			linux,phandle = <0x59>;
			phandle = <0x59>;

			pins_cmd_dat {
				pins = <0x6f00>;
				slew-rate = <0x1>;
				output-low;
			};
		};

		cam1@1 {
			linux,phandle = <0x5a>;
			phandle = <0x5a>;

			pins_cmd_dat {
				pins = <0x6f00>;
				slew-rate = <0x1>;
				output-high;
			};
		};

		cam1@2 {
			linux,phandle = <0x5b>;
			phandle = <0x5b>;

			pins_cmd_dat {
				pins = <0x6c00>;
				slew-rate = <0x1>;
				output-low;
			};
		};

		cam1@3 {
			linux,phandle = <0x5c>;
			phandle = <0x5c>;

			pins_cmd_dat {
				pins = <0x6c00>;
				slew-rate = <0x1>;
				output-high;
			};
		};

		cam2@0 {
			linux,phandle = <0x5d>;
			phandle = <0x5d>;

			pins_cmd_dat {
				pins = <0x5600>;
				slew-rate = <0x1>;
				output-low;
			};
		};

		cam2@1 {
			linux,phandle = <0x5e>;
			phandle = <0x5e>;

			pins_cmd_dat {
				pins = <0x5600>;
				slew-rate = <0x1>;
				output-high;
			};
		};

		cam2@3 {
			linux,phandle = <0x5f>;
			phandle = <0x5f>;

			pins_cmd_dat {
				pins = <0xe00>;
				slew-rate = <0x1>;
				output-low;
			};
		};

		cam2@4 {
			linux,phandle = <0x60>;
			phandle = <0x60>;

			pins_cmd_dat {
				pins = <0xe00>;
				slew-rate = <0x1>;
				output-high;
			};
		};

		mipi_sel@0 {
			linux,phandle = <0x61>;
			phandle = <0x61>;

			pins_cmd_dat {
				pins = <0xbe00>;
				slew-rate = <0x1>;
				output-low;
			};
		};

		mipi_sel@1 {
			linux,phandle = <0x62>;
			phandle = <0x62>;

			pins_cmd_dat {
				pins = <0xbe00>;
				slew-rate = <0x1>;
				output-high;
			};
		};

		mipi_en@0 {
			linux,phandle = <0x63>;
			phandle = <0x63>;

			pins_cmd_dat {
				pins = <0x1500>;
				slew-rate = <0x1>;
				output-low;
			};
		};

		mipi_en@1 {
			linux,phandle = <0x64>;
			phandle = <0x64>;

			pins_cmd_dat {
				pins = <0x1500>;
				slew-rate = <0x1>;
				output-high;
			};
		};

		cam0@vcamd0 {
			linux,phandle = <0x65>;
			phandle = <0x65>;

			pins_cmd_dat {
				pins = <0x1700>;
				slew-rate = <0x1>;
				output-low;
			};
		};

		cam1@vcamd1 {
			linux,phandle = <0x66>;
			phandle = <0x66>;

			pins_cmd_dat {
				pins = <0x1700>;
				slew-rate = <0x1>;
				output-high;
			};
		};

		camdefault {
			linux,phandle = <0x54>;
			phandle = <0x54>;
		};

		mode_te_gpio {
			linux,phandle = <0x1f>;
			phandle = <0x1f>;

			pins_cmd_dat {
				pins = <0x2c00>;
			};
		};

		mode_te_te {
			linux,phandle = <0x20>;
			phandle = <0x20>;

			pins_cmd_dat {
				pins = <0x2c01>;
			};
		};

		lcm_rst_out0_gpio {
			linux,phandle = <0x21>;
			phandle = <0x21>;

			pins_cmd_dat {
				pins = <0x9e00>;
				slew-rate = <0x1>;
				output-low;
			};
		};

		lcm_rst_out1_gpio {
			linux,phandle = <0x22>;
			phandle = <0x22>;

			pins_cmd_dat {
				pins = <0x9e00>;
				slew-rate = <0x1>;
				output-high;
			};
		};

		lcd_bias_enp0_gpio {
			linux,phandle = <0x23>;
			phandle = <0x23>;

			pins_cmd_dat {
				pins = <0xc00>;
				slew-rate = <0x1>;
				output-low;
			};
		};

		lcd_bias_enp1_gpio {
			linux,phandle = <0x24>;
			phandle = <0x24>;

			pins_cmd_dat {
				pins = <0xc00>;
				slew-rate = <0x1>;
				output-high;
			};
		};

		fp_rst_high {
			linux,phandle = <0x7a>;
			phandle = <0x7a>;

			pins_cmd_dat {
				pins = <0x1100>;
				slew-rate = <0x1>;
				output-high;
			};
		};

		fp_rst_low {
			linux,phandle = <0x7b>;
			phandle = <0x7b>;

			pins_cmd_dat {
				pins = <0x1100>;
				slew-rate = <0x1>;
				output-low;
			};
		};

		eint@9 {
			linux,phandle = <0x7c>;
			phandle = <0x7c>;

			pins_cmd_dat {
				pins = <0x1000>;
				slew-rate = <0x0>;
				bias-disable;
			};
		};

		eint_in_low {
			linux,phandle = <0x7d>;
			phandle = <0x7d>;

			pins_cmd_dat {
				pins = <0x1000>;
				slew-rate = <0x0>;
				bias-pull-down = <0x0>;
			};
		};

		eint_in_high {
			linux,phandle = <0x81>;
			phandle = <0x81>;

			pins_cmd_dat {
				pins = <0x1000>;
				slew-rate = <0x0>;
				bias-pull-up = <0x0>;
			};
		};

		eint_in_float {
			linux,phandle = <0x7e>;
			phandle = <0x7e>;

			pins_cmd_dat {
				pins = <0x1000>;
				slew-rate = <0x0>;
				bias-disable;
			};
		};

		miso_pull_up {
			linux,phandle = <0x7f>;
			phandle = <0x7f>;

			pins_cmd_dat {
				pins = <0x5f01>;
				slew-rate = <0x0>;
				bias-pull-up = <0x0>;
			};
		};

		miso_pull_disable {
			linux,phandle = <0x80>;
			phandle = <0x80>;

			pins_cmd_dat {
				pins = <0x5f01>;
				bias-disable;
			};
		};

		fp_enable_low {
			linux,phandle = <0x82>;
			phandle = <0x82>;

			pins_cmd_dat {
				pins = <0x6001>;
				slew-rate = <0x0>;
				bias-pull-down = <0x0>;
			};
		};

		fp_enable_high {
			linux,phandle = <0x83>;
			phandle = <0x83>;

			pins_cmd_dat {
				pins = <0x6001>;
				slew-rate = <0x0>;
				bias-pull-up = <0x0>;
			};
		};
	};

	gpio {
		compatible = "mediatek,gpio_usage_mapping";
		GPIO_SIM2_SIO = <0x24>;
		GPIO_SIM2_SRST = <0x25>;
		GPIO_SIM2_SCLK = <0x26>;
		GPIO_SIM1_SCLK = <0x27>;
		GPIO_SIM1_SRST = <0x28>;
		GPIO_SIM1_SIO = <0x29>;
		GPIO_SIM1_HOT_PLUG = <0x2e>;
		GPIO_FDD_BAND_SUPPORT_DETECT_1ST_PIN = <0x3c>;
		GPIO_FDD_BAND_SUPPORT_DETECT_2ND_PIN = <0x56>;
	};

	gpio@10005000 {
		compatible = "mediatek,gpio";
		reg = <0x0 0x10005000 0x0 0x1000>;
	};

	sleep@10006000 {
		compatible = "mediatek,sleep";
		reg = <0x0 0x10006000 0x0 0x1000 0x0 0x11cf80 0x0 0x80>;
		interrupts = <0x0 0xa5 0x8 0x0 0xa6 0x8 0x0 0xa7 0x8 0x0 0xa8 0x8 0x0 0xa9 0x8 0x0 0xaa 0x8 0x0 0xab 0x8 0x0 0xac 0x8>;
	};

	toprgu@10007000 {
		compatible = "mediatek,mt6757-toprgu";
		reg = <0x0 0x10007000 0x0 0x1000>;
		interrupts = <0x0 0x82 0x2>;
	};

	apxgpt@10008000 {
		compatible = "mediatek,mt6757-timer", "mediatek,mt6577-timer";
		reg = <0x0 0x10008000 0x0 0x1000>;
		interrupts = <0x0 0x9a 0x8>;
		clocks = <0x2f 0x47 0x30>;
	};

	hacc@1000a000 {
		compatible = "mediatek,hacc";
		reg = <0x0 0x1000a000 0x0 0x1000>;
		interrupts = <0x0 0xad 0x8>;
	};

	eintc@1000b000 {
		compatible = "mediatek,mt-eic";
		reg = <0x0 0x1000b000 0x0 0x1000>;
		interrupts = <0x0 0x9b 0x4>;
		mediatek,max_hw_deb_cnt = <0x10>;
		mediatek,max_deint_cnt = <0x4>;
		mediatek,deint_possible_irq = <0xbf 0xc0 0xc1 0xc2>;
		#interrupt-cells = <0x2>;
		interrupt-controller;
		mediatek,max_eint_num = <0xa0>;
		mediatek,mapping_table_entry = <0x8e>;
		mediatek,debtime_setting_entry = <0xa>;
		mediatek,debtime_setting_array = <0x0 0x80 0x1 0x100 0x2 0x200 0x3 0x400 0x4 0x4000 0x5 0x8000 0x6 0x10000 0x7 0x20000 0x8 0x40000 0x9 0x80000>;
		mediatek,mapping_table = <0x0 0x0 0x1 0x1 0x2 0x2 0x3 0x3 0x4 0x4 0x5 0x5 0x6 0x6 0x7 0x7 0x8 0x8 0x9 0x9 0xa 0xa 0xb 0xb 0xc 0xc 0xd 0xd 0xe 0xe 0xf 0xf 0x10 0x10 0x11 0x11 0x12 0x12 0x13 0x13 0x14 0x14 0x15 0x15 0x16 0x16 0x17 0x17 0x18 0x18 0x19 0x19 0x1a 0x1a 0x1b 0x1b 0x1c 0x1c 0x1d 0x1d 0x1e 0x1e 0x1f 0x1f 0x20 0x20 0x21 0x21 0x22 0x22 0x23 0x23 0x24 0x24 0x25 0x25 0x26 0x26 0x27 0x27 0x28 0x28 0x29 0x29 0x2a 0x2a 0x2b 0x2b 0x2c 0x2c 0x2d 0x2d 0x2e 0x2e 0x2f 0x2f 0x30 0x30 0x31 0x31 0x32 0x32 0x33 0x33 0x34 0x34 0x35 0x35 0x36 0x36 0x37 0x37 0x38 0x38 0x39 0x39 0x3a 0x3a 0x3b 0x3b 0x3c 0x3c 0x3d 0x3d 0x3e 0x3e 0x3f 0x3f 0x40 0x40 0x41 0x41 0x42 0x42 0x43 0x43 0x44 0x44 0x45 0x45 0x4b 0x4b 0x4c 0x4c 0x4d 0x4d 0x4e 0x4e 0x4f 0x4f 0x50 0x50 0x51 0x51 0x52 0x52 0x53 0x53 0x54 0x54 0x55 0x55 0x56 0x56 0x57 0x57 0x58 0x58 0x59 0x59 0x5a 0x5a 0x5b 0x5b 0x5c 0x5c 0x5d 0x5d 0x5e 0x5e 0x5f 0x5f 0x60 0x60 0x61 0x61 0x62 0x62 0x63 0x63 0x64 0x64 0x65 0x65 0x66 0x66 0x67 0x67 0x68 0x68 0x69 0x69 0x6a 0x6a 0x6b 0x6b 0x6c 0x6c 0x6d 0x6d 0x6e 0x6e 0x6f 0x6f 0x70 0x70 0x71 0x71 0x72 0x72 0x73 0x73 0x74 0x74 0x75 0x75 0x76 0x76 0x77 0x77 0x78 0x78 0x79 0x79 0x7a 0x7a 0x83 0x83 0x84 0x84 0x85 0x85 0x86 0x86 0x87 0x87 0x88 0x88 0xd0 0x92 0xd1 0x93 0xc3 0x99 0xc2 0x98 0xc5 0x9b 0xc4 0x9a 0xc7 0x9d 0xc6 0x9c 0xc9 0x9f 0xc8 0x9e 0xcc 0x8d 0xd2 0x94 0xd3 0x95 0xcf 0x91 0xcd 0x8e 0xca 0x8b 0xcb 0x8c 0xce 0x8f>;
		mediatek,builtin_entry = <0xc>;
		mediatek,builtin_mapping = <0x98 0x1 0x96 0x9a 0x2 0x96 0xb 0x2 0x90 0x17 0x2 0x90 0x2d 0x6 0x90 0x2a 0x1 0x90 0x0 0x4 0x90 0x74 0x4 0x90 0x6 0x3 0x90 0x4e 0x2 0x90 0x98 0x2 0x98 0x9a 0x1 0x98>;
		linux,phandle = <0x10>;
		phandle = <0x10>;

		MD1_SIM1_HOT_PLUG_EINT@0 {
			compatible = "mediatek,MD1_SIM1_HOT_PLUG_EINT-eint";
			interrupts = <0x0 0x4>;
			debounce = <0x0 0x186a0>;
			dedicated = <0x0 0x0>;
			src_pin = <0x0 0x1>;
			sockettype = <0x0 0x0>;
			status = "okay";
		};
	};

	apmixed@1000c000 {
		compatible = "mediatek,apmixed";
		reg = <0x0 0x1000c000 0x0 0xf00 0x0 0x10006000 0x0 0x1000>;
		#clock-cells = <0x1>;
		linux,phandle = <0x39>;
		phandle = <0x39>;
	};

	fhctl@1000ce00 {
		compatible = "mediatek,fhctl";
		reg = <0x0 0x1000ce00 0x0 0x100>;
	};

	pwrap@1000d000 {
		compatible = "mediatek,pwrap";
		reg = <0x0 0x1000d000 0x0 0x1000>;
		interrupts = <0x0 0xa3 0x4>;

		mt6351 {
			compatible = "mediatek,mt6351-pmic";
			interrupt-controller;
		};

		mt6355 {
			compatible = "mediatek,mt6355-pmic";
			interrupt-controller;
			interrupt-parent = <0x10>;
			interrupts = <0x98 0x4>;
			debounce = <0x98 0x3e8>;
			status = "okay";
		};
	};

	devapc_ao@1000e000 {
		compatible = "mediatek,devapc_ao";
		reg = <0x0 0x1000e000 0x0 0x1000>;
	};

	keypad@10010000 {
		compatible = "mediatek,mt6757-keypad";
		reg = <0x0 0x10010000 0x0 0x1000>;
		interrupts = <0x0 0xa4 0x2>;
		mediatek,kpd-key-debounce = <0x400>;
		mediatek,kpd-sw-pwrkey = <0x74>;
		mediatek,kpd-hw-pwrkey = <0x8>;
		mediatek,kpd-sw-rstkey = <0x66>;
		mediatek,kpd-hw-rstkey = <0x11>;
		mediatek,kpd-use-extend-type = <0x0>;
		mediatek,kpd-hw-map-num = <0x48>;
		mediatek,kpd-hw-init-map = <0x73 0x72 0x0 0x0 0x0 0x0 0x0 0x0 0x0 0x0 0x0 0x0 0x0 0x0 0x0 0x0 0x0 0x0 0x0 0x0 0x0 0x0 0x0 0x0 0x0 0x0 0x0 0x0 0x0 0x0 0x0 0x0 0x0 0x0 0x0 0x0 0x0 0x0 0x0 0x0 0x0 0x0 0x0 0x0 0x0 0x0 0x0 0x0 0x0 0x0 0x0 0x0 0x0 0x0 0x0 0x0 0x0 0x0 0x0 0x0 0x0 0x0 0x0 0x0 0x0 0x0 0x0 0x0 0x0 0x0 0x0 0x0>;
		mediatek,kpd-pwrkey-eint-gpio = <0x0>;
		mediatek,kpd-pwkey-gpio-din = <0x0>;
		mediatek,kpd-hw-recovery-key = <0x0>;
		mediatek,kpd-hw-factory-key = <0x1>;
		status = "okay";

		mrdump_ext_rst {
			compatible = "mediatek, mrdump_ext_rst-eint";
			status = "okay";
			interrupt-parent = <0x10>;
			interrupts = <0x7 0x8>;
			debounce = <0x7 0x7d000>;
		};
	};

	topmisc@10011000 {
		compatible = "mediatek,topmisc";
		reg = <0x0 0x10011000 0x0 0x1000>;
	};

	mdcldma@10014000 {
		compatible = "mediatek,mdcldma";
		reg = <0x0 0x10014000 0x0 0x1000 0x0 0x10015000 0x0 0x1000 0x0 0x1021b000 0x0 0x1000 0x0 0x1021c000 0x0 0x1000 0x0 0x10209000 0x0 0x1000 0x0 0x1020a000 0x0 0x1000>;
		interrupts = <0x0 0xfb 0x4 0x0 0x8b 0x8 0x0 0xfc 0x2>;
		mediatek,md_id = <0x0>;
		mediatek,cldma_capability = <0x6>;
		clocks = <0x31 0x1 0x2 0x37 0x2 0x2f 0x2 0x32 0x2 0x29 0x2 0x2a 0x2 0x19 0x2 0x1a 0x2 0x1b 0x2 0x1d 0x2 0x20 0x2 0x24>;
		clock-names = "scp-sys-md1-main", "infra-cldma-ap", "infra-ccif-ap", "infra-ccif-md", "infra-ap-c2k-ccif-0", "infra-ap-c2k-ccif-1", "infra-md2md-ccif-0", "infra-md2md-ccif-1", "infra-md2md-ccif-2", "infra-md2md-ccif-3", "infra-md2md-ccif-4", "infra-md2md-ccif-5";
	};

	aes_top0@10016000 {
		compatible = "mediatek,aes_top0";
		reg = <0x0 0x10016000 0x0 0x1000>;
	};

	aes_top1@10017000 {
		compatible = "mediatek,aes_top1";
		reg = <0x0 0x10017000 0x0 0x1000>;
	};

	modem_temp_share@10018000 {
		compatible = "mediatek,modem_temp_share";
		reg = <0x0 0x10018000 0x0 0x1000>;
	};

	dbgapb_base@1011a000 {
		compatible = "mediatek,dbgapb_base";
		reg = <0x0 0x1011a000 0x0 0x100>;
	};

	mcucfg@10200000 {
		compatible = "mediatek,mcucfg";
		reg = <0x0 0x10200000 0x0 0x4000>;
		interrupts = <0x0 0x0 0x8>;
	};

	sys_cirq@10204000 {
		compatible = "mediatek,sys_cirq";
		reg = <0x0 0x10204000 0x0 0x1000>;
		interrupts = <0x0 0x118 0x8>;
		mediatek,cirq_num = <0xd0>;
		mediatek,spi_start_offset = <0x48>;
		mediatek,edge_trig_irqs_for_spm-quantity = <0x5>;
		mediatek,edge_trig_irqs_for_spm = <0xa2 0xc4 0x119 0x11c 0x12c>;
	};

	m4u@10205000 {
		cell-index = <0x0>;
		compatible = "mediatek,m4u";
		reg = <0x0 0x10205000 0x0 0x1000>;
		interrupts = <0x0 0x93 0x8>;
		clocks = <0x32 0x1 0x32 0x2 0x33 0x2 0x34 0x1 0x35 0x1 0x35 0x2 0x32 0x3 0x36 0x7 0x31 0x7 0x31 0x6 0x31 0x5 0x31 0x3 0x31 0xa>;
		clock-names = "m4u_smi_common", "m4u_smi_larb0", "m4u_smi_larb1", "m4u_smi_larb2", "m4u_smi_larb3", "m4u_smi_larb3_2", "m4u_smi_larb4", "m4u_smi_larb5", "m4u_mtcmos_ven", "m4u_mtcmos_vde", "m4u_mtcmos_isp", "m4u_mtcmos_dis", "m4u_mtcmos_cam";
	};

	efusec@10206000 {
		compatible = "mediatek,efusec";
		reg = <0x0 0x10206000 0x0 0x1000>;
	};

	devapc@10207000 {
		compatible = "mediatek,devapc";
		reg = <0x0 0x10207000 0x0 0x1000>;
		interrupts = <0x0 0x85 0x8>;
		clocks = <0x2 0x2d>;
		clock-names = "devapc-main";
	};

	bus_dbg@10208000 {
		compatible = "mediatek,bus_dbg-v2";
		reg = <0x0 0x10208000 0x0 0x1000>;
		interrupts = <0x0 0x84 0x8>;
	};

	ap2c2k_ccif@1020b000 {
		compatible = "mediatek,ap2c2k_ccif";
		reg = <0x0 0x1020b000 0x0 0x1000 0x0 0x10211000 0x0 0x300 0x0 0x10213000 0x0 0x300>;
		interrupts = <0x0 0x8d 0x8 0x0 0xf9 0x2>;
		cell-index = <0x2>;
		ccif,major = <0xa9>;
		ccif,minor_base = <0x0>;
		ccif,capability = <0x2>;
		mediatek,md_smem_size = <0x400000>;
		clocks = <0x31 0xb>;
		clock-names = "scp-sys-c2k-main";
	};

	md_ccif1@1020c000 {
		compatible = "mediatek,md_ccif1";
		reg = <0x0 0x1020c000 0x0 0x1000>;
	};

	infra_mbist@1020d000 {
		compatible = "mediatek,infra_mbist";
		reg = <0x0 0x1020d000 0x0 0x1000>;
	};

	infracfg@1020e000 {
		compatible = "mediatek,infracfg";
		reg = <0x0 0x1020e000 0x0 0x1000>;
	};

	trng@1020f000 {
		compatible = "mediatek,trng";
		reg = <0x0 0x1020f000 0x0 0x1000>;
		interrupts = <0x0 0x8c 0x8>;
	};

	gcpu@10210000 {
		compatible = "mediatek,gcpu";
		reg = <0x0 0x10210000 0x0 0x1000>;
		interrupts = <0x0 0x96 0x8>;
	};

	md2md_md1_ccif0@10211000 {
		compatible = "mediatek,md2md_md1_ccif0";
		reg = <0x0 0x10211000 0x0 0x1000>;
	};

	gce@10212000 {
		compatible = "mediatek,gce";
		reg = <0x0 0x10212000 0x0 0x1000>;
		interrupts = <0x0 0x8f 0x8 0x0 0x90 0x8>;
		g3d_config_base = <0x13000000 0x0 0xffff0000>;
		mmsys_config_base = <0x14000000 0x1 0xffff0000>;
		disp_dither_base = <0x14010000 0x2 0xffff0000>;
		mm_na_base = <0x14020000 0x3 0xffff0000>;
		imgsys_base = <0x15000000 0x4 0xffff0000>;
		vdec_gcon_base = <0x16000000 0x5 0xffff0000>;
		venc_gcon_base = <0x17000000 0x6 0xffff0000>;
		conn_peri_base = <0x18000000 0x7 0xffff0000>;
		topckgen_base = <0x10000000 0x8 0xffff0000>;
		kp_base = <0x10010000 0x9 0xffff0000>;
		scp_sram_base = <0x10020000 0xa 0xffff0000>;
		infra_na3_base = <0x10030000 0xb 0xffff0000>;
		infra_na4_base = <0x10040000 0xc 0xffff0000>;
		scp_base = <0x10050000 0xd 0xffff0000>;
		mcucfg_base = <0x10200000 0xe 0xffff0000>;
		gcpu_base = <0x10210000 0xf 0xffff0000>;
		usb0_base = <0x11200000 0x10 0xffff0000>;
		usb_sif_base = <0x11210000 0x11 0xffff0000>;
		audio_base = <0x11220000 0x12 0xffff0000>;
		msdc0_base = <0x11230000 0x13 0xffff0000>;
		msdc1_base = <0x11240000 0x14 0xffff0000>;
		msdc2_base = <0x11250000 0x15 0xffff0000>;
		msdc3_base = <0x11260000 0x16 0xffff0000>;
		ap_dma_base = <0x11000000 0x17 0xffff0000>;
		smi_larb1_base = <0x16010000 0x18 0xffff0000>;
		vdec_base = <0x16020000 0x19 0xffff0000>;
		imgsys_config = <0x15020000 0x63 0xffff0000>;
		disp_rdma0_sof = <0x0>;
		disp_rdma1_sof = <0x1>;
		mdp_rdma0_sof = <0x3>;
		mdp_rdma1_sof = <0x4>;
		mdp_rsz1_sof = <0x6>;
		mdp_rsz2_sof = <0x7>;
		mdp_tdshp_sof = <0x8>;
		mdp_color_sof = <0x9>;
		mdp_wrot0_sof = <0xb>;
		mdp_wrot1_sof = <0xc>;
		disp_ovl0_sof = <0xd>;
		disp_ovl1_sof = <0xe>;
		disp_2l_ovl0_sof = <0xf>;
		disp_2l_ovl1_sof = <0x10>;
		disp_wdma0_sof = <0x11>;
		disp_wdma1_sof = <0x12>;
		disp_color_sof = <0x13>;
		disp_ccorr_sof = <0x15>;
		disp_aal_sof = <0x17>;
		disp_gamma_sof = <0x19>;
		disp_dither_sof = <0x1c>;
		disp_ufoe_sof = <0x1e>;
		disp_pwm0_sof = <0x20>;
		disp_dsi0_sof = <0x21>;
		disp_dsi1_sof = <0x22>;
		disp_rdma0_frame_done = <0x23>;
		disp_rdma1_frame_done = <0x24>;
		mdp_rdma0_frame_done = <0x26>;
		mdp_rdma1_frame_done = <0x27>;
		mdp_rsz1_frame_done = <0x29>;
		mdp_rsz2_frame_done = <0x2a>;
		mdp_tdshp_frame_done = <0x2b>;
		mdp_color_frame_done = <0x2c>;
		mdp_wrot0_write_frame_done = <0x2e>;
		mdp_wrot0_read_frame_done = <0x2f>;
		mdp_wrot1_write_frame_done = <0x30>;
		mdp_wrot1_read_frame_done = <0x31>;
		disp_ovl0_frame_done = <0x32>;
		disp_ovl1_frame_done = <0x33>;
		disp_2l_ovl0_frame_done = <0x34>;
		disp_2l_ovl1_frame_done = <0x35>;
		disp_wdma0_frame_done = <0x36>;
		disp_wdma1_frame_done = <0x37>;
		disp_color_frame_done = <0x38>;
		disp_ccorr_frame_done = <0x3a>;
		disp_aal_frame_done = <0x3c>;
		disp_gamma_frame_done = <0x3e>;
		disp_dither_frame_done = <0x41>;
		disp_ufoe_frame_done = <0x43>;
		disp_dsi0_frame_done = <0x45>;
		disp_dsi1_frame_done = <0x46>;
		disp_dpi0_frame_done = <0x47>;
		stream_done_0 = <0x82>;
		stream_done_1 = <0x83>;
		stream_done_2 = <0x84>;
		stream_done_3 = <0x85>;
		stream_done_4 = <0x86>;
		stream_done_5 = <0x87>;
		stream_done_6 = <0x88>;
		stream_done_7 = <0x89>;
		stream_done_8 = <0x8a>;
		stream_done_9 = <0x8b>;
		stream_done_10 = <0x8c>;
		stream_done_11 = <0x8d>;
		stream_done_12 = <0x8e>;
		stream_done_13 = <0x8f>;
		stream_done_14 = <0x90>;
		stream_done_15 = <0x91>;
		buf_underrun_event_0 = <0x92>;
		buf_underrun_event_1 = <0x93>;
		dsi0_te_event = <0x97>;
		dsi0_to_gce_mmck0 = <0x98>;
		dsi0_to_gce_mmck1 = <0x99>;
		dsi0_to_gce_mmck2 = <0x9a>;
		dsi0_to_gce_mmck3 = <0x9b>;
		dsi0_to_gce_mmck4 = <0x9c>;
		dsi1_te_event = <0x9d>;
		dsi1_to_gce_mmck0 = <0x9e>;
		dsi1_to_gce_mmck1 = <0x9f>;
		dsi1_to_gce_mmck2 = <0xa0>;
		dsi1_to_gce_mmck3 = <0xa1>;
		dsi1_to_gce_mmck4 = <0xa2>;
		disp_wdma0_rst_done = <0xa3>;
		disp_wdma1_rst_done = <0xa4>;
		mdp_wrot1_rst_done = <0xa5>;
		mdp_wrot0_rst_done = <0xa6>;
		mdp_rdma1_rst_done = <0xa8>;
		mdp_rdma0_rst_done = <0xa9>;
		disp_mutex_all_module_upd0 = <0xab>;
		disp_mutex_all_module_upd1 = <0xac>;
		disp_mutex_all_module_upd2 = <0xad>;
		disp_mutex_all_module_upd3 = <0xae>;
		disp_mutex_all_module_upd4 = <0xaf>;
		disp_mutex_all_module_upd5 = <0xb0>;
		disp_mutex_all_module_upd6 = <0xb1>;
		disp_mutex_all_module_upd7 = <0xb2>;
		disp_mutex_all_module_upd8 = <0xb3>;
		disp_mutex_all_module_upd9 = <0xb4>;
		disp_mutex_all_module_upd10 = <0xb5>;
		disp_mutex_all_module_upd11 = <0xb6>;
		disp_mutex_all_module_upd12 = <0xb7>;
		disp_mutex_all_module_upd13 = <0xb8>;
		disp_mutex_all_module_upd14 = <0xb9>;
		disp_mutex_all_module_upd15 = <0xba>;
		disp_mutex_reg_upd_for_module0 = <0xbb>;
		disp_mutex_reg_upd_for_module1 = <0xbc>;
		disp_mutex_reg_upd_for_module2 = <0xbd>;
		disp_mutex_reg_upd_for_module3 = <0xbe>;
		disp_mutex_reg_upd_for_module4 = <0xbf>;
		disp_mutex_reg_upd_for_module5 = <0xc0>;
		disp_mutex_reg_upd_for_module6 = <0xc1>;
		disp_mutex_reg_upd_for_module7 = <0xc2>;
		disp_mutex_reg_upd_for_module8 = <0xc3>;
		disp_mutex_reg_upd_for_module9 = <0xc4>;
		disp_mutex_reg_upd_for_module10 = <0xc5>;
		disp_mutex_reg_upd_for_module11 = <0xc6>;
		disp_mutex_reg_upd_for_module12 = <0xc7>;
		disp_mutex_reg_upd_for_module13 = <0xc8>;
		disp_mutex_reg_upd_for_module14 = <0xc9>;
		disp_mutex_reg_upd_for_module15 = <0xca>;
		disp_mutex_reg_upd_for_module16 = <0xcb>;
		disp_mutex_reg_upd_for_module17 = <0xcc>;
		disp_mutex_reg_upd_for_module18 = <0xcd>;
		disp_mutex_reg_upd_for_module19 = <0xce>;
		disp_mutex_reg_upd_for_module20 = <0xcf>;
		disp_mutex_reg_upd_for_module21 = <0xd0>;
		disp_mutex_reg_upd_for_module22 = <0xd1>;
		disp_mutex_reg_upd_for_module23 = <0xd2>;
		disp_mutex_reg_upd_for_module24 = <0xd3>;
		disp_mutex_reg_upd_for_module25 = <0xd4>;
		disp_mutex_reg_upd_for_module26 = <0xd5>;
		disp_mutex_reg_upd_for_module27 = <0xd6>;
		disp_mutex_reg_upd_for_module28 = <0xd7>;
		disp_mutex_reg_upd_for_module29 = <0xd8>;
		disp_mutex_reg_upd_for_module30 = <0xd9>;
		disp_mutex_reg_upd_for_module31 = <0xda>;
		disp_mutex_reg_upd_for_module32 = <0xdb>;
		disp_mutex_reg_upd_for_module33 = <0xdc>;
		disp_mutex_reg_upd_for_module34 = <0xdd>;
		dip_cq_thread0_frame_done = <0x101>;
		dip_cq_thread1_frame_done = <0x102>;
		dip_cq_thread2_frame_done = <0x103>;
		dip_cq_thread3_frame_done = <0x104>;
		dip_cq_thread4_frame_done = <0x105>;
		dip_cq_thread5_frame_done = <0x106>;
		dip_cq_thread6_frame_done = <0x107>;
		dip_cq_thread7_frame_done = <0x108>;
		dip_cq_thread8_frame_done = <0x109>;
		dip_cq_thread9_frame_done = <0x10a>;
		dip_cq_thread10_frame_done = <0x10b>;
		dip_cq_thread11_frame_done = <0x10c>;
		dip_cq_thread12_frame_done = <0x10d>;
		dip_cq_thread13_frame_done = <0x10e>;
		dip_cq_thread14_frame_done = <0x10f>;
		dve_frame_done = <0x110>;
		wmf_frame_done = <0x111>;
		gepf_frame_done = <0x112>;
		gepf_temp_frame_done = <0x113>;
		gepf_bypass_frame_done = <0x114>;
		rsc_frame_done = <0x115>;
		venc_done = <0x121>;
		jpgdec_done = <0x122>;
		jpgenc_done = <0x123>;
		venc_mb_done = <0x124>;
		venc_128byte_cnt_done = <0x125>;
		isp_frame_done_a = <0x141>;
		isp_frame_done_b = <0x142>;
		camsv_0_pass1_done = <0x143>;
		camsv_1_pass1_done = <0x144>;
		camsv_2_pass1_done = <0x145>;
		tsf_done = <0x146>;
		seninf_0_fifo_full = <0x147>;
		seninf_1_fifo_full = <0x148>;
		seninf_2_fifo_full = <0x149>;
		seninf_3_fifo_full = <0x14a>;
		seninf_4_fifo_full = <0x14b>;
		seninf_5_fifo_full = <0x14c>;
		seninf_6_fifo_full = <0x14d>;
		seninf_7_fifo_full = <0x14e>;
		max_prefetch_cnt = <0x4>;
		prefetch_size = <0xa0 0x20 0x20 0x20>;
		sram_share_cnt = <0x2>;
		sram_share_engine = <0xb 0xc>;
		sram_share_event = <0x1cc 0x1cd>;
		clocks = <0x2 0x9>;
		clock-names = "GCE";
		mmsys_dummy_reg_offset = <0x8ac>;
	};

	cqdma@10212c00 {
		compatible = "mediatek,mt-cqdma-v1";
		reg = <0x0 0x10212c00 0x0 0x100 0x0 0x10212d00 0x0 0x100>;
		interrupts = <0x0 0x71 0x8 0x0 0x72 0x8>;
		nr_channel = <0x2>;
		clocks = <0x2 0x9>;
		clock-names = "cqdma";
	};

	md2md_md2_ccif0@10213000 {
		compatible = "mediatek,md2md_md2_ccif0";
		reg = <0x0 0x10213000 0x0 0x1000>;
	};

	sramrom@10214000 {
		compatible = "mediatek,sramrom";
		reg = <0x0 0x10214000 0x0 0x1000>;
	};

	mipi_tx0@10215000 {
		compatible = "mediatek,mipi_tx0";
		reg = <0x0 0x10215000 0x0 0x1000>;
	};

	mipi_tx1@10216000 {
		compatible = "mediatek,mipi_tx1";
		reg = <0x0 0x10216000 0x0 0x1000>;
	};

	mipi_rx_ana_csi0@10217000 {
		compatible = "mediatek,mipi_rx_ana_csi0";
		reg = <0x0 0x10217000 0x0 0x1000>;
	};

	mipi_rx_ana_csi1@10218000 {
		compatible = "mediatek,mipi_rx_ana_csi1";
		reg = <0x0 0x10218000 0x0 0x1000>;
	};

	emi@10219000 {
		compatible = "mediatek,emi";
		reg = <0x0 0x10219000 0x0 0x1000>;
		interrupts = <0x0 0x87 0x4>;
	};

	gcpu_rsa@1021a000 {
		compatible = "mediatek,gcpu_rsa";
		reg = <0x0 0x1021a000 0x0 0x1000>;
	};

	infra_md@1021d000 {
		compatible = "mediatek,infra_md";
		reg = <0x0 0x1021d000 0x0 0x1000>;
	};

	bpi_bsi_slv0@1021e000 {
		compatible = "mediatek,bpi_bsi_slv0";
		reg = <0x0 0x1021e000 0x0 0x1000>;
	};

	bpi_bsi_slv1@1021f000 {
		compatible = "mediatek,bpi_bsi_slv1";
		reg = <0x0 0x1021f000 0x0 0x6000>;
	};

	bpi_bsi_slv2@10225000 {
		compatible = "mediatek,bpi_bsi_slv2";
		reg = <0x0 0x10225000 0x0 0x1000>;
	};

	emi_mpu@10226000 {
		compatible = "mediatek,emi_mpu";
		reg = <0x0 0x10226000 0x0 0x1000>;
		interrupts = <0x0 0x75 0x4>;
	};

	dvfsp@10227000 {
		compatible = "mediatek,mt6757-dvfsp";
		reg = <0x0 0x10227000 0x0 0x1000 0x0 0x11c000 0x0 0xf80>;
		interrupts = <0x0 0x98 0x8>;
		clocks = <0x2 0xe>;
		clock-names = "i2c";
	};

	dramc_ch0_top0@10228000 {
		compatible = "mediatek,dramc_ch0_top0";
		reg = <0x0 0x10228000 0x0 0x2000>;
	};

	dramc_ch0_top1@1022a000 {
		compatible = "mediatek,dramc_ch0_top1";
		reg = <0x0 0x1022a000 0x0 0x2000>;
	};

	dramc_ch0_top2@1022c000 {
		compatible = "mediatek,dramc_ch0_top2";
		reg = <0x0 0x1022c000 0x0 0x1000>;
	};

	dramc_ch0_top3@1022d000 {
		compatible = "mediatek,dramc_ch0_top3";
		reg = <0x0 0x1022d000 0x0 0x1000>;
	};

	dramc_ch0_rsv@1022e000 {
		compatible = "mediatek,dramc_ch0_rsv";
		reg = <0x0 0x1022e000 0x0 0x2000>;
	};

	dramc_ch1_top0@10230000 {
		compatible = "mediatek,dramc_ch1_top0";
		reg = <0x0 0x10230000 0x0 0x2000>;
	};

	dramc_ch1_top1@10232000 {
		compatible = "mediatek,dramc_ch1_top1";
		reg = <0x0 0x10232000 0x0 0x2000>;
	};

	dramc_ch1_top2@10234000 {
		compatible = "mediatek,dramc_ch1_top2";
		reg = <0x0 0x10234000 0x0 0x1000>;
	};

	dramc_ch1_top3@10235000 {
		compatible = "mediatek,dramc_ch1_top3";
		reg = <0x0 0x10235000 0x0 0x1000>;
	};

	dramc_ch1_rsv@10236000 {
		compatible = "mediatek,dramc_ch1_rsv";
		reg = <0x0 0x10236000 0x0 0x2000>;
	};

	fmem_smi_dvfsp@10238000 {
		compatible = "mediatek,fmem_smi_dvfsp";
		reg = <0x0 0x10238000 0x0 0x1000>;
	};

	cci400@10390000 {
		compatible = "mediatek,cci400";
		reg = <0x0 0x10390000 0x0 0x10000>;
	};

	ap_dma@11000000 {
		compatible = "mediatek,ap_dma";
		reg = <0x0 0x11000000 0x0 0x1000>;
		interrupts = <0x0 0x52 0x8>;
	};

	btif_tx@11000980 {
		compatible = "mediatek,btif_tx";
		#address-cells = <0x2>;
		#size-cells = <0x2>;
		reg = <0x0 0x11000980 0x0 0x80>;
		interrupts = <0x0 0x60 0x8>;
	};

	btif_rx@11000a00 {
		compatible = "mediatek,btif_rx";
		#address-cells = <0x2>;
		#size-cells = <0x2>;
		reg = <0x0 0x11000a00 0x0 0x80>;
		interrupts = <0x0 0x7c 0x8>;
	};

	auxadc@11001000 {
		compatible = "mediatek,mt6757-auxadc";
		reg = <0x0 0x11001000 0x0 0x1000>;
		interrupts = <0x0 0x4a 0x2>;
		clocks = <0x2 0x27>;
		clock-names = "auxadc-main";

		adc_channel@ {
			compatible = "mediatek,adc_channel";
			mediatek,temperature0 = <0x0>;
			mediatek,temperature1 = <0x1>;
			mediatek,adc_fdd_rf_params_dynamic_custom_ch = <0x2>;
			status = "okay";
		};
	};

	apuart0@11002000 {
		cell-index = <0x0>;
		compatible = "mediatek,mt6755-uart";
		reg = <0x0 0x11002000 0x0 0x1000 0x0 0x11000580 0x0 0x1000 0x0 0x11000600 0x0 0x80>;
		interrupts = <0x0 0x5b 0x8 0x0 0x6b 0x8 0x0 0x6c 0x8>;
		clock-frequency = <0x18cba80>;
		clock-div = <0x1>;
		clocks = <0x2 0x15 0x2 0x2b>;
		clock-names = "uart0-main", "uart-apdma";
	};

	apuart1@11003000 {
		cell-index = <0x1>;
		compatible = "mediatek,mt6755-uart";
		reg = <0x0 0x11003000 0x0 0x1000 0x0 0x11000680 0x0 0x80 0x0 0x11000700 0x0 0x80>;
		interrupts = <0x0 0x5c 0x8 0x0 0x6d 0x8 0x0 0x6e 0x8>;
		clock-frequency = <0x18cba80>;
		clock-div = <0x1>;
		clocks = <0x2 0x16>;
		clock-names = "uart1-main";
	};

	pwm@11006000 {
		compatible = "mediatek,pwm";
		reg = <0x0 0x11006000 0x0 0x1000>;
		interrupts = <0x0 0x4d 0x8>;
		clocks = <0x2 0x10 0x2 0x11 0x2 0x12 0x2 0x13 0x2 0xf 0x2 0x14>;
		clock-names = "PWM1-main", "PWM2-main", "PWM3-main", "PWM4-main", "PWM-HCLK-main", "PWM-main";
	};

	i2c@11007000 {
		compatible = "mediatek,mt6757-i2c";
		id = <0x0>;
		reg = <0x0 0x11007000 0x0 0x1000 0x0 0x11000100 0x0 0x80>;
		interrupts = <0x0 0x54 0x8>;
		clocks = <0x2 0xb 0x2 0x2b>;
		clock-names = "main", "dma";
		clock-div = <0x5>;
		#address-cells = <0x1>;
		#size-cells = <0x0>;
		clock-frequency = <0x61a80>;
		mediatek,use-open-drain;

		cap_touch@5d {
			compatible = "mediatek,cap_touch";
			reg = <0x5d>;
			status = "okay";
		};

		synaptics_touch@70 {
			compatible = "mediatek,synaptics_touch";
			reg = <0x70>;
			status = "okay";
		};

		nvt_touch@62 {
			compatible = "mediatek,nvt_touch";
			reg = <0x62>;
			status = "okay";
		};
	};

	i2c@11008000 {
		compatible = "mediatek,mt6757-i2c";
		id = <0x6>;
		reg = <0x0 0x11008000 0x0 0x1000 0x0 0x11000180 0x0 0x80>;
		interrupts = <0x0 0x55 0x8>;
		clocks = <0x2 0xc 0x2 0x2b 0x2 0x41>;
		clock-names = "main", "dma", "arb";
		clock-div = <0x5>;
		mediatek,buffermode_used;
		#address-cells = <0x1>;
		#size-cells = <0x0>;
		clock-frequency = <0x61a80>;
		mediatek,use-open-drain;
	};

	i2c@11009000 {
		compatible = "mediatek,mt6757-i2c";
		id = <0x7>;
		reg = <0x0 0x11009000 0x0 0x1000 0x0 0x11000200 0x0 0x80>;
		interrupts = <0x0 0x56 0x8>;
		clocks = <0x2 0xd 0x2 0x2b 0x2 0x43>;
		clock-names = "main", "dma", "arb";
		clock-div = <0x5>;
		mediatek,buffermode_used;
		#address-cells = <0x1>;
		#size-cells = <0x0>;
		clock-frequency = <0x61a80>;
		mediatek,use-open-drain;

		ccu_sensor_i2c_main_hw@33 {
			compatible = "mediatek,ccu_sensor_i2c_main_hw";
			reg = <0x33>;
			status = "okay";
		};
	};

	spi@1100a000 {
		compatible = "mediatek,mt6757-spi";
		cell-index = <0x0>;
		spi-padmacro = <0x0>;
		reg = <0x0 0x1100a000 0x0 0x1000>;
		interrupts = <0x0 0x76 0x8>;
		clocks = <0x2 0x1e>;
		clock-names = "main";
		clock-frequency = <0x67f3540>;
		clock-div = <0x1>;
	};

	therm_ctrl@1100b000 {
		compatible = "mediatek,mt6757-therm_ctrl";
		reg = <0x0 0x1100b000 0x0 0x1000>;
		interrupts = <0x0 0x4e 0x8>;
		clocks = <0x2 0xa 0x2 0x27>;
		clock-names = "therm-main", "therm-auxadc";
	};

	eem_fsm@1100b000 {
		compatible = "mediatek,mt6757-eem_fsm";
		reg = <0x0 0x1100b000 0x0 0x1000>;
		interrupts = <0x0 0x7d 0x8>;
		clocks = <0x37 0x1 0x31 0x4 0x2 0xa>;
		clock-names = "mfg-main", "mtcmos-mfg", "therm-eem";
	};

	btif@1100c000 {
		compatible = "mediatek,btif";
		#address-cells = <0x2>;
		#size-cells = <0x2>;
		reg = <0x0 0x1100c000 0x0 0x1000>;
		interrupts = <0x0 0x70 0x8>;
		clocks = <0x2 0x1c 0x2 0x2b>;
		clock-names = "btifc", "apdmac";
	};

	irtx@1100d000 {
		compatible = "mediatek,irtx";
		reg = <0x0 0x1100d000 0x0 0x1000>;
		interrupts = <0x0 0x7f 0x8>;
	};

	disp_pwm@1100e000 {
		compatible = "mediatek,disp_pwm";
		reg = <0x0 0x1100e000 0x0 0x1000>;
	};

	i2c@1100f000 {
		compatible = "mediatek,mt6757-i2c";
		id = <0x3>;
		reg = <0x0 0x11011000 0x0 0x1000 0x0 0x11000300 0x0 0x80>;
		interrupts = <0x0 0x58 0x8>;
		clocks = <0x2 0x3a 0x2 0x2b>;
		clock-names = "main", "dma";
		clock-div = <0x5>;
		#address-cells = <0x1>;
		#size-cells = <0x0>;
		clock-frequency = <0x61a80>;
		mediatek,use-open-drain;

		biosensor@37 {
			compatible = "mediatek,biosensor";
			reg = <0x37>;
			status = "okay";
		};

		nfc@28 {
			compatible = "mediatek,nfc";
			reg = <0x28>;
			status = "okay";
		};
	};

	spi@11010000 {
		compatible = "mediatek,mt6757-spi";
		cell-index = <0x1>;
		spi-padmacro = <0x0>;
		reg = <0x0 0x11010000 0x0 0x1000>;
		interrupts = <0x0 0x7a 0x8>;
		clocks = <0x2 0x39>;
		clock-names = "main";
		clock-frequency = <0x67f3540>;
		clock-div = <0x1>;
	};

	i2c@11011000 {
		compatible = "mediatek,mt6757-i2c";
		id = <0x5>;
		reg = <0x0 0x1100f000 0x0 0x1000 0x0 0x11000280 0x0 0x80>;
		interrupts = <0x0 0x57 0x8>;
		clocks = <0x2 0xe 0x2 0x2b>;
		clock-names = "main", "dma";
		clock-div = <0x5>;
		mediatek,appm_used;
		#address-cells = <0x1>;
		#size-cells = <0x0>;
		clock-frequency = <0x33e140>;
		mediatek,use-push-pull;

		rt5081_pmu@34 {
			compatible = "mediatek,rt5081_pmu";
			reg = <0x34>;
			status = "okay";
		};

		usb_type_c@4e {
			compatible = "mediatek,usb_type_c";
			reg = <0x4e>;
			status = "okay";
		};
	};

	spi@11012000 {
		compatible = "mediatek,mt6757-spi";
		cell-index = <0x2>;
		spi-padmacro = <0x0>;
		reg = <0x0 0x11012000 0x0 0x1000>;
		interrupts = <0x0 0x80 0x8>;
		clocks = <0x2 0x3c>;
		clock-names = "main";
		clock-frequency = <0x67f3540>;
		clock-div = <0x1>;
	};

	spi@11013000 {
		compatible = "mediatek,mt6757-spi";
		cell-index = <0x3>;
		spi-padmacro = <0x0>;
		reg = <0x0 0x11013000 0x0 0x1000>;
		interrupts = <0x0 0x81 0x8>;
		clocks = <0x2 0x3d>;
		clock-names = "main";
		clock-frequency = <0x67f3540>;
		clock-div = <0x1>;
	};

	i2c@11014000 {
		compatible = "mediatek,mt6757-i2c";
		id = <0x1>;
		reg = <0x0 0x11014000 0x0 0x1000 0x0 0x11000380 0x0 0x80>;
		interrupts = <0x0 0x10e 0x8>;
		clocks = <0x2 0x42 0x2 0x2b 0x2 0x41>;
		clock-names = "main", "dma", "arb";
		clock-div = <0x5>;
		#address-cells = <0x1>;
		#size-cells = <0x0>;
		clock-frequency = <0x61a80>;
		mediatek,use-open-drain;

		msensor@0d {
			compatible = "mediatek,msensor";
			reg = <0xd>;
			status = "okay";
		};

		gsensor@6a {
			compatible = "mediatek,gsensor";
			reg = <0x6a>;
			status = "okay";
		};

		barometer@77 {
			compatible = "mediatek,barometer";
			reg = <0x77>;
			status = "okay";
		};

		alsps@51 {
			compatible = "mediatek,alsps";
			reg = <0x51>;
			status = "okay";
		};

		speaker_amp@34 {
			compatible = "mediatek,speaker_amp";
			reg = <0x34>;
			status = "okay";
		};

		gyro@69 {
			compatible = "mediatek,gyro";
			reg = <0x69>;
			status = "okay";
		};

		ext_buck_vmd1@50 {
			compatible = "mediatek,ext_buck_vmd1";
			reg = <0x50>;
			status = "okay";
		};
	};

	i2c@11015000 {
		compatible = "mediatek,mt6757-i2c";
		id = <0x2>;
		reg = <0x0 0x11015000 0x0 0x1000 0x0 0x11000400 0x0 0x80>;
		interrupts = <0x0 0x10f 0x8>;
		clocks = <0x2 0x44 0x2 0x2b 0x2 0x43>;
		clock-names = "main", "dma", "arb";
		clock-div = <0x5>;
		#address-cells = <0x1>;
		#size-cells = <0x0>;
		clock-frequency = <0x61a80>;
		mediatek,use-open-drain;

		camera_main@1a {
			compatible = "mediatek,camera_main";
			reg = <0x1a>;
			status = "okay";
		};

		camera_main_af@72 {
			compatible = "mediatek,camera_main_af";
			reg = <0x72>;
			status = "okay";
		};
	};

	i2c@11016000 {
		compatible = "mediatek,mt6757-i2c";
		id = <0x8>;
		reg = <0x0 0x11016000 0x0 0x1000 0x0 0x11000480 0x0 0x80>;
		interrupts = <0x0 0x10d 0x8>;
		clocks = <0x2 0x3e 0x2 0x2b 0x2 0x3f>;
		clock-names = "main", "dma", "arb";
		clock-div = <0x5>;
		mediatek,buffermode_used;
		#address-cells = <0x1>;
		#size-cells = <0x0>;
		clock-frequency = <0x61a80>;
		mediatek,use-open-drain;

		ccu_sensor_i2c_sub_hw@43 {
			compatible = "mediatek,ccu_sensor_i2c_sub_hw";
			reg = <0x43>;
			status = "okay";
		};
	};

	i2c@11017000 {
		compatible = "mediatek,mt6757-i2c";
		id = <0x4>;
		reg = <0x0 0x11017000 0x0 0x1000 0x0 0x11000500 0x0 0x80>;
		interrupts = <0x0 0x110 0x8>;
		clocks = <0x2 0x40 0x2 0x2b 0x2 0x3f>;
		clock-names = "main", "dma", "arb";
		clock-div = <0x5>;
		#address-cells = <0x1>;
		#size-cells = <0x0>;
		clock-frequency = <0x61a80>;
		mediatek,use-open-drain;

		camera_sub@10 {
			compatible = "mediatek,camera_sub";
			reg = <0x10>;
			status = "okay";
		};

		camera_sub_af@0c {
			compatible = "mediatek,camera_sub_af";
			reg = <0xc>;
			status = "okay";
		};

		camera_main_two@1a {
			compatible = "mediatek,camera_main_two";
			reg = <0x1a>;
			status = "okay";
		};

		camera_main_two_af@72 {
			compatible = "mediatek,camera_main_two_af";
			reg = <0x72>;
			status = "okay";
		};
	};

	spi@11018000 {
		compatible = "mediatek,mt6757-spi";
		cell-index = <0x4>;
		spi-padmacro = <0x0>;
		reg = <0x0 0x11018000 0x0 0x1000>;
		interrupts = <0x0 0x111 0x8>;
		clocks = <0x2 0x45>;
		clock-names = "main";
		clock-frequency = <0x67f3540>;
		clock-div = <0x1>;
	};

	spi@11019000 {
		compatible = "mediatek,mt6757-spi";
		cell-index = <0x5>;
		spi-padmacro = <0x0>;
		reg = <0x0 0x11019000 0x0 0x1000>;
		interrupts = <0x0 0x112 0x8>;
		clocks = <0x2 0x46>;
		clock-names = "main";
		clock-frequency = <0x67f3540>;
		clock-div = <0x1>;
	};

	usb0@11200000 {
		compatible = "mediatek,usb0";
		cell-index = <0x0>;
		reg = <0x0 0x11200000 0x0 0x10000 0x0 0x11210000 0x0 0x10000>;
		interrupts = <0x0 0x49 0x8>;
		mode = <0x2>;
		multipoint = <0x1>;
		dyn_fifo = <0x1>;
		soft_con = <0x1>;
		dma = <0x1>;
		num_eps = <0x10>;
		dma_channels = <0x8>;
		drvvbus_gpio = <0x53 0x2>;
	};

	usb1@11210000 {
		compatible = "mediatek,usb1";
		reg = <0x0 0x11210000 0x0 0x10000>;
		interrupts = <0x0 0x49 0x8>;
	};

	audio@11220000 {
		compatible = "mediatek,audio";
		reg = <0x0 0x11220000 0x0 0x1000>;
		interrupts = <0x0 0x8e 0x8>;
		#clock-cells = <0x1>;
		linux,phandle = <0x38>;
		phandle = <0x38>;
	};

	mt_soc_dl1_pcm@11220000 {
		compatible = "mediatek,mt_soc_pcm_dl1";
		reg = <0x0 0x11220000 0x0 0x1000>;
		interrupts = <0x0 0x8e 0x8>;
		clocks = <0x38 0xa 0x38 0x9 0x38 0x3 0x38 0x2 0x38 0x4 0x38 0x8 0x38 0x7 0x38 0x5 0x38 0x6 0x38 0x1 0x31 0x9 0x2 0x31 0x2 0x38 0x2f 0x15 0x2f 0x16 0x2f 0x45 0x2f 0x46 0x2f 0x10 0x2f 0x26 0x39 0xa 0x39 0xb 0x3a>;
		clock-names = "aud_afe_clk", "aud_i2s_clk", "aud_dac_clk", "aud_dac_predis_clk", "aud_adc_clk", "aud_apll22m_clk", "aud_apll24m_clk", "aud_apll1_tuner_clk", "aud_apll2_tuner_clk", "aud_tml_clk", "scp_sys_aud", "aud_infra_clk", "aud_peri_26m_clk", "aud_mux1_clk", "aud_mux2_clk", "top_ad_apll1_clk", "top_ad_apll2_clk", "top_mux_audio_int", "top_sys_pll1_d4", "apmixed_apll1_clk", "apmixed_apll2_clk", "top_clk26m_clk";
		pinctrl-names = "aud_clk_mosi_off", "aud_clk_mosi_on", "aud_dat_mosi_off", "aud_dat_mosi_on", "aud_dat_miso_off", "aud_dat_miso_on", "hpdepop-pullhigh", "hpdepop-pulllow", "aud_smartpa_reset", "aud_smartpa_on", "aud_clk_mosi_pull_high", "aud_clk_mosi_pull_low", "extamp-pullhigh", "extamp-pulllow";
		pinctrl-0 = <0x3b>;
		pinctrl-1 = <0x3c>;
		pinctrl-2 = <0x3d>;
		pinctrl-3 = <0x3e>;
		pinctrl-4 = <0x3f>;
		pinctrl-5 = <0x40>;
		pinctrl-6 = <0x41>;
		pinctrl-7 = <0x42>;
		pinctrl-8 = <0x43>;
		pinctrl-9 = <0x44>;
		pinctrl-10 = <0x45>;
		pinctrl-11 = <0x46>;
		pinctrl-12 = <0x47>;
		pinctrl-13 = <0x48>;
		status = "okay";
	};

	audio_sram@11221000 {
		compatible = "mediatek,audio_sram";
		reg = <0x0 0x11221000 0x0 0xb400>;
	};

	usb3@11270000 {
		compatible = "mediatek,usb3";
		reg = <0x0 0x11270000 0x0 0x10000 0x0 0x11280000 0x0 0x10000 0x0 0x11290000 0x0 0x10000>;
		reg-names = "ssusb_base", "ssusb_sif", "ssusb_sif2";
		interrupts = <0x0 0x48 0x8 0x0 0x49 0x8>;
		interrupt-names = "musb-hdrc", "xhci";
	};

	usb3_xhci@11270000 {
		compatible = "mediatek,mt67xx-xhci";
		reg = <0x0 0x11270000 0x0 0x1000 0x0 0x11280700 0x0 0x100>;
		reg-names = "ssusb_base", "ssusb_sif";
		interrupts = <0x0 0x7b 0x8>;
		interrupt-names = "xhci";
		pinctrl-names = "drvvbus_default", "drvvbus_low", "drvvbus_high";
		pinctrl-0 = <0x49>;
		pinctrl-1 = <0x4a>;
		pinctrl-2 = <0x4b>;
		status = "okay";
	};

	g3d_config@13000000 {
		compatible = "mediatek,g3d_config";
		reg = <0x0 0x13000000 0x0 0x1000>;
		#clock-cells = <0x1>;
		linux,phandle = <0x37>;
		phandle = <0x37>;
	};

	vad_gpu@13001000 {
		compatible = "mediatek,vad_gpu";
		reg = <0x0 0x13001000 0x0 0x1000>;
	};

	vad_sc0@13002000 {
		compatible = "mediatek,vad_sc0";
		reg = <0x0 0x13002000 0x0 0x1000>;
	};

	vad_sc1@13003000 {
		compatible = "mediatek,vad_sc1";
		reg = <0x0 0x13003000 0x0 0x1000>;
	};

	dfp@13020000 {
		compatible = "mediatek,dfp";
		reg = <0x0 0x13020000 0x0 0x1000>;
	};

	met_mali@13040000 {
		compatible = "arm,malit860", "arm,mali-t86x", "arm,malit8xx", "arm,mali-midgard";
		reg = <0x0 0x13040000 0x0 0x4000>;
		interrupts = <0x0 0xf7 0x8 0x0 0xf6 0x8 0x0 0xf5 0x8>;
		interrupt-names = "JOB", "MMU", "GPU";
		clock-frequency = <0x29b92700>;
		clocks = <0x37 0x1 0x2f 0x1f 0x31 0x8 0x31 0x4 0x31 0xe 0x31 0xd>;
		clock-names = "mfg-main", "mfg-f52m-sel", "mtcmos-mfg-async", "mtcmos-mfg", "mtcmos-mfg-core0", "mtcmos-mfg-core1";
	};

	mali@13040000 {
		compatible = "arm,malit860", "arm,mali-t86x", "arm,malit8xx", "arm,mali-midgard";
		reg = <0x0 0x13040000 0x0 0x4000>;
		interrupts = <0x0 0xf7 0x8 0x0 0xf6 0x8 0x0 0xf5 0x8>;
		interrupt-names = "JOB", "MMU", "GPU";
		clock-frequency = <0x29b92700>;
		clocks = <0x37 0x1 0x2f 0x1f 0x31 0x8 0x31 0x4 0x31 0xe 0x31 0xd>;
		clock-names = "mfg-main", "mfg-f52m-sel", "mtcmos-mfg-async", "mtcmos-mfg", "mtcmos-mfg-core0", "mtcmos-mfg-core1";
	};

	mmsys_config@14000000 {
		compatible = "mediatek,mmsys_config";
		reg = <0x0 0x14000000 0x0 0x1000>;
		interrupts = <0x0 0xd5 0x8>;
		#clock-cells = <0x1>;
		clocks = <0x32 0x4>;
		clock-names = "CAM_MDP";
		linux,phandle = <0x32>;
		phandle = <0x32>;
	};

	dispsys@14000000 {
		compatible = "mediatek,dispsys";
		reg = <0x0 0x14000000 0x0 0x1000 0x0 0x1400b000 0x0 0x1000 0x0 0x1400c000 0x0 0x1000 0x0 0x1400d000 0x0 0x1000 0x0 0x1400e000 0x0 0x1000 0x0 0x1400f000 0x0 0x1000 0x0 0x14010000 0x0 0x1000 0x0 0x14011000 0x0 0x1000 0x0 0x14012000 0x0 0x1000 0x0 0x14013000 0x0 0x1000 0x0 0x14014000 0x0 0x1000 0x0 0x14015000 0x0 0x1000 0x0 0x14016000 0x0 0x1000 0x0 0x14017000 0x0 0x1000 0x0 0x14018000 0x0 0x1000 0x0 0x14019000 0x0 0x1000 0x0 0x1401a000 0x0 0x1000 0x0 0x1401b000 0x0 0x1000 0x0 0x1401c000 0x0 0x1000 0x0 0x1401d000 0x0 0x1000 0x0 0x1401e000 0x0 0x1000 0x0 0x1401f000 0x0 0x1000 0x0 0x14020000 0x0 0x1000 0x0 0x14021000 0x0 0x1000 0x0 0x14022000 0x0 0x1000 0x0 0x14023000 0x0 0x1000 0x0 0x14024000 0x0 0x1000 0x0 0x1100e000 0x0 0x1000 0x0 0x14025000 0x0 0x1000 0x0 0x14026000 0x0 0x1000 0x0 0x14027000 0x0 0x1000 0x0 0x14028000 0x0 0x1000 0x0 0x10215000 0x0 0x10000 0x0 0x10216000 0x0 0x10000 0x0 0x1100e000 0x0 0x10000>;
		interrupts = <0x0 0x0 0x8 0x0 0xbc 0x8 0x0 0xbd 0x8 0x0 0xbe 0x8 0x0 0xbf 0x8 0x0 0xc0 0x8 0x0 0xc1 0x8 0x0 0xc2 0x8 0x0 0xc3 0x8 0x0 0xc4 0x8 0x0 0xc5 0x8 0x0 0xc6 0x8 0x0 0xc7 0x8 0x0 0xc8 0x8 0x0 0xc9 0x8 0x0 0xca 0x8 0x0 0xcb 0x8 0x0 0xcc 0x8 0x0 0xcd 0x8 0x0 0xce 0x8 0x0 0xcf 0x8 0x0 0x0 0x8 0x0 0x0 0x8 0x0 0x0 0x8 0x0 0xd2 0x8 0x0 0xd3 0x8 0x0 0xd4 0x8 0x0 0x0 0x8 0x0 0xb1 0x8 0x0 0xd6 0x8 0x0 0xd1 0x8 0x0 0x0 0x8 0x0 0x0 0x8 0x0 0x0 0x8>;
		clocks = <0x32 0x1 0x32 0x2 0x32 0x3 0x32 0xf 0x32 0x10 0x32 0x11 0x32 0x12 0x32 0x13 0x32 0x14 0x32 0x15 0x32 0x16 0x32 0x17 0x32 0x18 0x32 0x19 0x32 0x1a 0x32 0x1b 0x32 0x1c 0x32 0x1d 0x32 0x1e 0x32 0x1f 0x32 0x20 0x32 0x21 0x32 0x22 0x32 0x23 0x32 0x24 0x32 0x25 0x32 0x26 0x32 0x27 0x32 0x28 0x32 0x29 0x32 0x2a 0x32 0x2b 0x32 0x2c 0x2 0x36 0x31 0x3 0x2f 0x13 0x2f 0x48 0x2f 0x49 0x2f 0x4a 0x2f 0x4b 0x2f 0x47 0x2f 0x17 0x3a 0x2f 0x3b 0x2f 0x53 0x2f 0x54 0x2f 0x2 0x2f 0x55 0x2f 0x2a>;
		clock-names = "DISP0_SMI_COMMON", "DISP0_SMI_LARB0", "DISP0_SMI_LARB4", "DISP0_DISP_OVL0", "DISP0_DISP_OVL1", "DISP0_DISP_OVL0_2L", "DISP0_DISP_OVL1_2L", "DISP0_DISP_RDMA0", "DISP0_DISP_RDMA1", "DISP0_DISP_RDMA2", "DISP0_DISP_WDMA0", "DISP0_DISP_WDMA1", "DISP0_DISP_COLOR", "DISP0_DISP_COLOR1", "DISP0_DISP_CCORR", "DISP0_DISP_CCORR1", "DISP0_DISP_AAL", "DISP0_DISP_AAL1", "DISP0_DISP_GAMMA", "DISP0_DISP_GAMMA1", "DISP0_DISP_OD", "DISP0_DISP_DITHER", "DISP0_DISP_DITHER1", "DISP0_DISP_UFOE", "DISP0_DISP_DSC", "DISP0_DISP_SPLIT", "DISP1_DSI0_MM_CLOCK", "DISP1_DSI0_INTERFACE_CLOCK", "DISP1_DSI1_MM_CLOCK", "DISP1_DSI1_INTERFACE_CLOCK", "DISP1_DPI_MM_CLOCK", "DISP1_DPI_INTERFACE_CLOCK", "DISP1_DISP_OVL0_MOUT", "DISP_PWM", "DISP_MTCMOS_CLK", "MUX_DPI0", "TVDPLL_D2", "TVDPLL_D4", "TVDPLL_D8", "TVDPLL_D16", "DPI_CK", "MUX_PWM", "CLK26M", "UNIVPLL2_D4", "ULPOSC_D4", "ULPOSC_D8", "MUX_MM", "MM_VENCPLL", "SYSPLL2_D2";
	};

	mhl@0 {
		compatible = "mediatek,extd_dev";
	};

	mdp_rdma0@14001000 {
		compatible = "mediatek,mdp_rdma0";
		reg = <0x0 0x14001000 0x0 0x1000>;
		interrupts = <0x0 0xb2 0x8>;
		clocks = <0x32 0x5>;
		clock-names = "MDP_RDMA0";
	};

	mdp_rdma1@14002000 {
		compatible = "mediatek,mdp_rdma1";
		reg = <0x0 0x14002000 0x0 0x1000>;
		interrupts = <0x0 0xb3 0x8>;
		clocks = <0x32 0x6>;
		clock-names = "MDP_RDMA1";
	};

	mdp_rsz0@14003000 {
		compatible = "mediatek,mdp_rsz0";
		reg = <0x0 0x14003000 0x0 0x1000>;
		interrupts = <0x0 0xb4 0x8>;
		clocks = <0x32 0x7>;
		clock-names = "MDP_RSZ0";
	};

	mdp_rsz1@14004000 {
		compatible = "mediatek,mdp_rsz1";
		reg = <0x0 0x14004000 0x0 0x1000>;
		interrupts = <0x0 0xb5 0x8>;
		clocks = <0x32 0x8>;
		clock-names = "MDP_RSZ1";
	};

	mdp_rsz2@14005000 {
		compatible = "mediatek,mdp_rsz2";
		reg = <0x0 0x14005000 0x0 0x1000>;
		interrupts = <0x0 0xb6 0x8>;
		clocks = <0x32 0x9>;
		clock-names = "MDP_RSZ2";
	};

	mdp_wdma@14006000 {
		compatible = "mediatek,mdp_wdma";
		reg = <0x0 0x14006000 0x0 0x1000>;
		interrupts = <0x0 0xb9 0x8>;
		clocks = <0x32 0xc>;
		clock-names = "MDP_WDMA";
	};

	mdp_wrot0@14007000 {
		compatible = "mediatek,mdp_wrot0";
		reg = <0x0 0x14007000 0x0 0x1000>;
		interrupts = <0x0 0xba 0x8>;
		clocks = <0x32 0xd>;
		clock-names = "MDP_WROT0";
	};

	mdp_wrot1@14008000 {
		compatible = "mediatek,mdp_wrot1";
		reg = <0x0 0x14008000 0x0 0x1000>;
		interrupts = <0x0 0xbb 0x8>;
		clocks = <0x32 0xe>;
		clock-names = "MDP_WROT1";
	};

	mdp_tdshp@14009000 {
		compatible = "mediatek,mdp_tdshp";
		reg = <0x0 0x14009000 0x0 0x1000>;
		interrupts = <0x0 0xb7 0x8>;
		clocks = <0x32 0xa>;
		clock-names = "MDP_TDSHP";
	};

	mdp_color@1400a000 {
		compatible = "mediatek,mdp_color";
		reg = <0x0 0x1400a000 0x0 0x1000>;
		interrupts = <0x0 0xb8 0x8>;
		clocks = <0x32 0xb>;
		clock-names = "MDP_COLOR";
	};

	disp_ovl0@1400b000 {
		compatible = "mediatek,disp_ovl0";
		reg = <0x0 0x1400b000 0x0 0x1000>;
		interrupts = <0x0 0xbc 0x8>;
	};

	disp_ovl1@1400c000 {
		compatible = "mediatek,disp_ovl1";
		reg = <0x0 0x1400c000 0x0 0x1000>;
		interrupts = <0x0 0xbd 0x8>;
	};

	disp_ovl0_2l@1400d000 {
		compatible = "mediatek,disp_ovl0_2l";
		reg = <0x0 0x1400d000 0x0 0x1000>;
		interrupts = <0x0 0xbe 0x8>;
	};

	disp_ovl1_2l@1400e000 {
		compatible = "mediatek,disp_ovl1_2l";
		reg = <0x0 0x1400e000 0x0 0x1000>;
		interrupts = <0x0 0xbf 0x8>;
	};

	disp_rdma0@1400f000 {
		compatible = "mediatek,disp_rdma0";
		reg = <0x0 0x1400f000 0x0 0x1000>;
		interrupts = <0x0 0xc0 0x8>;
	};

	disp_rdma1@14010000 {
		compatible = "mediatek,disp_rdma1";
		reg = <0x0 0x14010000 0x0 0x1000>;
		interrupts = <0x0 0xc1 0x8>;
	};

	disp_rdma2@14011000 {
		compatible = "mediatek,disp_rdma2";
		reg = <0x0 0x14011000 0x0 0x1000>;
		interrupts = <0x0 0xc2 0x8>;
	};

	disp_wdma0@14012000 {
		compatible = "mediatek,disp_wdma0";
		reg = <0x0 0x14012000 0x0 0x1000>;
		interrupts = <0x0 0xc3 0x8>;
	};

	disp_wdma1@14013000 {
		compatible = "mediatek,disp_wdma1";
		reg = <0x0 0x14013000 0x0 0x1000>;
		interrupts = <0x0 0xc4 0x8>;
	};

	disp_color0@14014000 {
		compatible = "mediatek,disp_color0";
		reg = <0x0 0x14014000 0x0 0x1000>;
		interrupts = <0x0 0xc5 0x8>;
	};

	disp_color1@14015000 {
		compatible = "mediatek,disp_color1";
		reg = <0x0 0x14015000 0x0 0x1000>;
		interrupts = <0x0 0xc6 0x8>;
	};

	disp_ccorr0@14016000 {
		compatible = "mediatek,disp_ccorr0";
		reg = <0x0 0x14016000 0x0 0x1000>;
		interrupts = <0x0 0xc7 0x8>;
	};

	disp_ccorr1@14017000 {
		compatible = "mediatek,disp_ccorr1";
		reg = <0x0 0x14017000 0x0 0x1000>;
		interrupts = <0x0 0xc8 0x8>;
	};

	disp_aal0@14018000 {
		compatible = "mediatek,disp_aal0";
		reg = <0x0 0x14018000 0x0 0x1000>;
		interrupts = <0x0 0xc9 0x8>;
	};

	disp_aal1@14019000 {
		compatible = "mediatek,disp_aal1";
		reg = <0x0 0x14019000 0x0 0x1000>;
		interrupts = <0x0 0xca 0x8>;
	};

	disp_gamma0@1401a000 {
		compatible = "mediatek,disp_gamma0";
		reg = <0x0 0x1401a000 0x0 0x1000>;
		interrupts = <0x0 0xcb 0x8>;
	};

	disp_gamma1@1401b000 {
		compatible = "mediatek,disp_gamma1";
		reg = <0x0 0x1401b000 0x0 0x1000>;
		interrupts = <0x0 0xcc 0x8>;
	};

	disp_od@1401c000 {
		compatible = "mediatek,disp_od";
		reg = <0x0 0x1401c000 0x0 0x400>;
		interrupts = <0x0 0xcd 0x8>;
	};

	disp_dither0@1401d000 {
		compatible = "mediatek,disp_dither0";
		reg = <0x0 0x1401d000 0x0 0x1000>;
		interrupts = <0x0 0xce 0x8>;
	};

	disp_dither1@1401e000 {
		compatible = "mediatek,disp_dither1";
		reg = <0x0 0x1401e000 0x0 0x1000>;
		interrupts = <0x0 0xcf 0x8>;
	};

	dsi_ufoe@1401f000 {
		compatible = "mediatek,dsi_ufoe";
		reg = <0x0 0x1401f000 0x0 0x1000>;
	};

	disp_dsc@14020000 {
		compatible = "mediatek,disp_dsc";
		reg = <0x0 0x14020000 0x0 0x1000>;
	};

	dsi_split@14021000 {
		compatible = "mediatek,dsi_split";
		reg = <0x0 0x14021000 0x0 0x1000>;
	};

	dsi0@14022000 {
		compatible = "mediatek,dsi0";
		reg = <0x0 0x14022000 0x0 0x1000>;
		interrupts = <0x0 0xd2 0x8>;
	};

	dsi1@14023000 {
		compatible = "mediatek,dsi1";
		reg = <0x0 0x14023000 0x0 0x1000>;
		interrupts = <0x0 0xd3 0x8>;
	};

	dpi0@14024000 {
		compatible = "mediatek,dpi0";
		reg = <0x0 0x14024000 0x0 0x1000>;
		interrupts = <0x0 0xd4 0x8>;
	};

	mm_mutex@14025000 {
		compatible = "mediatek,mm_mutex";
		reg = <0x0 0x14025000 0x0 0x1000>;
	};

	smi_larb0@14026000 {
		compatible = "mediatek,smi_larb0";
		reg = <0x0 0x14026000 0x0 0x1000>;
		interrupts = <0x0 0xd6 0x8>;
	};

	smi_larb4@14027000 {
		compatible = "mediatek,smi_larb4";
		reg = <0x0 0x14027000 0x0 0x1000>;
		interrupts = <0x0 0xd1 0x8>;
	};

	smi_common@14028000 {
		compatible = "mediatek,smi_common";
		reg = <0x0 0x14028000 0x0 0x1000 0x0 0x14026000 0x0 0x1000 0x0 0x16010000 0x0 0x1000 0x0 0x1a001000 0x0 0x1000 0x0 0x17001000 0x0 0x1000 0x0 0x14027000 0x0 0x1000 0x0 0x15021000 0x0 0x1000>;
		clocks = <0x32 0x1 0x32 0x2 0x33 0x2 0x34 0x1 0x35 0x1 0x35 0x2 0x32 0x3 0x36 0x7 0x31 0x7 0x31 0x6 0x31 0x5 0x31 0x3 0x31 0xa>;
		clock-names = "smi-common", "smi-larb0", "smi-larb1", "smi-larb2", "smi-larb3", "smi-larb3-2", "smi-larb4", "smi-larb5", "mtcmos-ven", "mtcmos-vde", "mtcmos-isp", "mtcmos-dis", "mtcmos-cam";
	};

	met_smi@14028000 {
		compatible = "mediatek,met_smi";
		reg = <0x0 0x14028000 0x0 0x1000 0x0 0x14026000 0x0 0x1000 0x0 0x16010000 0x0 0x1000 0x0 0x1a001000 0x0 0x1000 0x0 0x17001000 0x0 0x1000 0x0 0x14027000 0x0 0x1000 0x0 0x15021000 0x0 0x1000>;
		clocks = <0x32 0x1 0x32 0x2 0x33 0x2 0x34 0x1 0x35 0x1 0x35 0x2 0x32 0x3 0x36 0x7 0x31 0x7 0x31 0x6 0x31 0x5 0x31 0x3 0x31 0xa>;
		clock-names = "smi-common", "smi-larb0", "smi-larb1", "smi-larb2", "smi-larb3", "smi-larb3-2", "smi-larb4", "smi-larb5", "mtcmos-ven", "mtcmos-vde", "mtcmos-isp", "mtcmos-dis", "mtcmos-cam";
	};

	mmsys_vad@14029000 {
		compatible = "mediatek,mmsys_vad";
		reg = <0x0 0x14029000 0x0 0x1000>;
	};

	mmsys_dfp@1402a000 {
		compatible = "mediatek,mmsys_dfp";
		reg = <0x0 0x1402a000 0x0 0x1000>;
	};

	imgsys_config@15020000 {
		compatible = "mediatek,imgsys_config";
		reg = <0x0 0x15020000 0x0 0x1000>;
		#clock-cells = <0x1>;
		clocks = <0x31 0x3 0x32 0x1 0x31 0x5 0x31 0xa 0x36 0x7 0x36 0x5 0x36 0x1 0x34 0x1 0x34 0x2 0x34 0x3 0x34 0x4 0x34 0x5 0x34 0x6 0x34 0x7 0x34 0x8>;
		clock-names = "ISP_SCP_SYS_DIS", "ISP_MMSYS_SMI_COMMON", "ISP_SCP_SYS_ISP", "ISP_SCP_SYS_CAM", "ISP_IMG_LARB5", "ISP_IMG_DIP", "ISP_IMG_RSC", "ISP_CAMSYS_LARB2_CGPDN", "ISP_CAMSYS_CAMSYS_CGPDN", "ISP_CAMSYS_CAMTG_CGPDN", "ISP_CAMSYS_SENINF_CGPDN", "ISP_CAMSYS_CAMSV0_CGPDN", "ISP_CAMSYS_CAMSV1_CGPDN", "ISP_CAMSYS_CAMSV2_CGPDN", "ISP_CAMSYS_TSF_CGPDN";
		linux,phandle = <0x36>;
		phandle = <0x36>;
	};

	smi_larb5@15021000 {
		compatible = "mediatek,smi_larb5";
		reg = <0x0 0x15021000 0x0 0x1000>;
		interrupts = <0x0 0xed 0x8>;
	};

	dip_a@15022000 {
		compatible = "mediatek,dip_a";
		reg = <0x0 0x15022000 0x0 0x2800>;
		interrupts = <0x0 0xee 0x8>;
	};

	dip_a0@15022000 {
		compatible = "mediatek,dip_a0";
		reg = <0x0 0x15022000 0x0 0x1000>;
		interrupts = <0x0 0xee 0x8>;
	};

	dip_a1@15023000 {
		compatible = "mediatek,dip_a1";
		reg = <0x0 0x15023000 0x0 0x1000>;
	};

	dip_a2@15024000 {
		compatible = "mediatek,dip_a2";
		reg = <0x0 0x15024000 0x0 0x1000>;
	};

	img_vad@15027000 {
		compatible = "mediatek,img_vad";
		reg = <0x0 0x15027000 0x0 0x1000>;
	};

	dpe@15028000 {
		compatible = "mediatek,dpe";
		reg = <0x0 0x15028000 0x0 0x1000>;
		interrupts = <0x0 0xf0 0x8>;
		clocks = <0x31 0x3 0x32 0x1 0x31 0x5 0x36 0x7 0x36 0x4>;
		clock-names = "DPE_CG_SCP_SYS_DIS", "DPE_CG_MM_SMI_COMMON", "DPE_CG_SCP_SYS_ISP", "DPE_CG_IMG_LARB5", "DPE_CG_IMG_DPE";
	};

	rsc@15029000 {
		compatible = "mediatek,rsc";
		reg = <0x0 0x15029000 0x0 0x1000>;
		interrupts = <0x0 0xf2 0x8>;
	};

	fd@1502b000 {
		compatible = "mediatek,fd";
		reg = <0x0 0x1502b000 0x0 0x1000>;
		interrupts = <0x0 0xef 0x8>;
		clocks = <0x31 0x3 0x32 0x1 0x31 0x5 0x36 0x7 0x36 0x3>;
		clock-names = "FD_CG_SCP_SYS_DIS", "FD_CG_MM_SMI_COMMON", "FD_CG_SCP_SYS_ISP", "FD_CG_IMG_LARB5", "FD_CG_IMG_FD";
	};

	gepf@1502c000 {
		compatible = "mediatek,gepf";
		reg = <0x0 0x1502c000 0x0 0x1000>;
		interrupts = <0x0 0xf1 0x8>;
	};

	img_dfp@1502e000 {
		compatible = "mediatek,img_dfp";
		reg = <0x0 0x1502e000 0x0 0x1000>;
	};

	vdec_gcon@16000000 {
		compatible = "mediatek,vdec_gcon";
		reg = <0x0 0x16000000 0x0 0x10000>;
		clocks = <0x32 0x1 0x33 0x1 0x33 0x2 0x35 0x2 0x35 0x1 0x2f 0x3 0x2f 0x25 0x2f 0x26 0x31 0x6 0x31 0x7 0x31 0x3>;
		clock-names = "MT_CG_DISP0_SMI_COMMON", "MT_CG_VDEC0_VDEC", "MT_CG_VDEC1_LARB", "MT_CG_VENC_VENC", "MT_CG_VENC_LARB", "MT_CG_TOP_MUX_VDEC", "MT_CG_TOP_SYSPLL1_D2", "MT_CG_TOP_SYSPLL1_D4", "MT_SCP_SYS_VDE", "MT_SCP_SYS_VEN", "MT_SCP_SYS_DIS";
		#clock-cells = <0x1>;
		linux,phandle = <0x33>;
		phandle = <0x33>;
	};

	smi_larb1@16010000 {
		compatible = "mediatek,smi_larb1";
		reg = <0x0 0x16010000 0x0 0x10000>;
		interrupts = <0x0 0xdc 0x8>;
	};

	vdec@16020000 {
		compatible = "mediatek,vdec";
		reg = <0x0 0x16020000 0x0 0x10000>;
		interrupts = <0x0 0xdb 0x8>;
	};

	venc_gcon@17000000 {
		compatible = "mediatek,venc_gcon";
		reg = <0x0 0x17000000 0x0 0x1000>;
		#clock-cells = <0x1>;
		linux,phandle = <0x35>;
		phandle = <0x35>;
	};

	smi_larb3@17001000 {
		compatible = "mediatek,smi_larb3";
		reg = <0x0 0x17001000 0x0 0x1000>;
		interrupts = <0x0 0xd8 0x8>;
	};

	venc@17002000 {
		compatible = "mediatek,venc";
		reg = <0x0 0x17002000 0x0 0x1000>;
		interrupts = <0x0 0xd7 0x8>;
	};

	jpgenc@17003000 {
		compatible = "mediatek,jpgenc";
		reg = <0x0 0x17003000 0x0 0x1000>;
		interrupts = <0x0 0xd9 0x8>;
		clocks = <0x31 0x3 0x32 0x1 0x31 0x7 0x35 0x1 0x35 0x3>;
		clock-names = "disp-mtcmos", "disp-smi", "venc-mtcmos", "venc-larb", "venc-jpgenc";
	};

	jpgdec@17004000 {
		compatible = "mediatek,jpgdec";
		reg = <0x0 0x17004000 0x0 0x1000>;
		interrupts = <0x0 0xda 0x8>;
		clocks = <0x31 0x3 0x32 0x1 0x31 0x7 0x35 0x1 0x35 0x4>;
		clock-names = "disp-mtcmos", "disp-smi", "venc-mtcmos", "venc-larb", "venc-jpgdec";
	};

	consys@18070000 {
		compatible = "mediatek,mt6757-consys";
		#address-cells = <0x2>;
		#size-cells = <0x2>;
		reg = <0x0 0x18070000 0x0 0x200 0x0 0x10007000 0x0 0x100 0x0 0x10000000 0x0 0x2000 0x0 0x10006000 0x0 0x1000>;
		interrupts = <0x0 0x10a 0x8 0x0 0x10c 0x8>;
		clocks = <0x31 0x2>;
		clock-names = "conn";
		pinctrl-names = "default", "gps_lna_state_init", "gps_lna_state_oh", "gps_lna_state_ol";
		pinctrl-0 = <0x1e>;
		pinctrl-1 = <0x4c>;
		pinctrl-2 = <0x4d>;
		pinctrl-3 = <0x4e>;
		status = "okay";
	};

	wifi@180f0000 {
		compatible = "mediatek,wifi";
		reg = <0x0 0x180f0000 0x0 0x5c>;
		interrupts = <0x0 0x10b 0x8>;
		clocks = <0x2 0x2b>;
		clock-names = "wifi-dma";
	};

	camsys_config@1a000000 {
		compatible = "mediatek,camsys_config";
		reg = <0x0 0x1a000000 0x0 0x1000>;
		#clock-cells = <0x1>;
		linux,phandle = <0x34>;
		phandle = <0x34>;
	};

	smi_larb2@1a001000 {
		compatible = "mediatek,smi_larb2";
		reg = <0x0 0x1a001000 0x0 0x1000>;
		interrupts = <0x0 0xe9 0x8>;
	};

	cam@1a003000 {
		compatible = "mediatek,cam";
		reg = <0x0 0x1a003000 0x0 0x1000>;
		interrupts = <0x0 0xde 0x8>;
	};

	cama@1a004000 {
		compatible = "mediatek,cama";
		reg = <0x0 0x1a004000 0x0 0x1000>;
		interrupts = <0x0 0xdf 0x8>;
	};

	camb@1a005000 {
		compatible = "mediatek,camb";
		reg = <0x0 0x1a005000 0x0 0x1000>;
		interrupts = <0x0 0xe0 0x8>;
	};

	cam_set@1a00b000 {
		compatible = "mediatek,cam_set";
		reg = <0x0 0x1a00b000 0x0 0x1000>;
	};

	cama_set@1a00c000 {
		compatible = "mediatek,cama_set";
		reg = <0x0 0x1a00c000 0x0 0x1000>;
	};

	camb_set@1a00d000 {
		compatible = "mediatek,camb_set";
		reg = <0x0 0x1a00d000 0x0 0x1000>;
	};

	cam_inner@1a013000 {
		compatible = "mediatek,cam_inner";
		reg = <0x0 0x1a013000 0x0 0x1000>;
	};

	cama_inner@1a014000 {
		compatible = "mediatek,cama_inner";
		reg = <0x0 0x1a014000 0x0 0x1000>;
	};

	camb_inner@1a015000 {
		compatible = "mediatek,camb_inner";
		reg = <0x0 0x1a015000 0x0 0x1000>;
	};

	cam_clear@1a01b000 {
		compatible = "mediatek,cam_clear";
		reg = <0x0 0x1a01b000 0x0 0x1000>;
	};

	cama_clear@1a01c000 {
		compatible = "mediatek,cama_clear";
		reg = <0x0 0x1a01c000 0x0 0x1000>;
	};

	camb_clear@1a01d000 {
		compatible = "mediatek,camb_clear";
		reg = <0x0 0x1a01d000 0x0 0x1000>;
	};

	kd_camera_hw1@1a040000 {
		compatible = "mediatek,camera_hw";
		reg = <0x0 0x1a040000 0x0 0x1000>;
		clocks = <0x2f 0x6 0x2f 0x14 0x2f 0x44 0x2f 0x3a>;
		clock-names = "TOP_CAMTG_SEL", "TOP_MUX_SCAM", "TOP_UNIVPLL_192M_D4", "TOP_UNIVPLL2_D2";
		vcama-supply = <0x4f>;
		vcamd-supply = <0x50>;
		vcamio-supply = <0x51>;
		vcama_main2-supply = <0x52>;
		vcama_sub-supply = <0x52>;
		vcamd_main2-supply = <0x53>;
		vcamd_sub-supply = <0x53>;
		vcamio_main2-supply = <0x51>;
		vcamio_sub-supply = <0x51>;
		vcamaf-supply = <0x25>;
		vcamaf_main2-supply = <0x25>;
		vcamaf_sub-supply = <0x25>;
		status = "okay";
		pinctrl-names = "default", "cam0_rst0", "cam0_rst1", "cam0_pnd0", "cam0_pnd1", "cam1_rst0", "cam1_rst1", "cam1_pnd0", "cam1_pnd1", "cam2_rst0", "cam2_rst1", "cam2_pnd0", "cam2_pnd1", "cam_mipi_switch_sel_0", "cam_mipi_switch_sel_1", "cam_mipi_switch_en_0", "cam_mipi_switch_en_1", "cam_ldo_vcamd_0", "cam_ldo_vcamd_1";
		pinctrl-0 = <0x54>;
		pinctrl-1 = <0x55>;
		pinctrl-2 = <0x56>;
		pinctrl-3 = <0x57>;
		pinctrl-4 = <0x58>;
		pinctrl-5 = <0x59>;
		pinctrl-6 = <0x5a>;
		pinctrl-7 = <0x5b>;
		pinctrl-8 = <0x5c>;
		pinctrl-9 = <0x5d>;
		pinctrl-10 = <0x5e>;
		pinctrl-11 = <0x5f>;
		pinctrl-12 = <0x60>;
		pinctrl-13 = <0x61>;
		pinctrl-14 = <0x62>;
		pinctrl-15 = <0x63>;
		pinctrl-16 = <0x64>;
		pinctrl-17 = <0x65>;
		pinctrl-18 = <0x66>;
	};

	kd_camera_hw2@1a040000 {
		compatible = "mediatek,camera_hw2";
		reg = <0x0 0x1a040000 0x0 0x1000>;
	};

	seiinfa@1a040000 {
		compatible = "mediatek,seiinfa";
		reg = <0x0 0x1a040000 0x0 0x1000>;
	};

	seiinfb@1a041000 {
		compatible = "mediatek,seiinfb";
		reg = <0x0 0x1a041000 0x0 0x1000>;
	};

	camsva@1a050000 {
		compatible = "mediatek,camsva";
		reg = <0x0 0x1a050000 0x0 0x1000>;
		interrupts = <0x0 0xe4 0x8>;
	};

	camsvb@1a051000 {
		compatible = "mediatek,camsvb";
		reg = <0x0 0x1a051000 0x0 0x1000>;
		interrupts = <0x0 0xe3 0x8>;
	};

	camsvc@1a052000 {
		compatible = "mediatek,camsvc";
		reg = <0x0 0x1a052000 0x0 0x1000>;
		interrupts = <0x0 0xe6 0x8>;
	};

	camsvd@1a053000 {
		compatible = "mediatek,camsvd";
		reg = <0x0 0x1a053000 0x0 0x1000>;
		interrupts = <0x0 0xe5 0x8>;
	};

	camsve@1a054000 {
		compatible = "mediatek,camsve";
		reg = <0x0 0x1a054000 0x0 0x1000>;
		interrupts = <0x0 0xe8 0x8>;
	};

	camsvf@1a055000 {
		compatible = "mediatek,camsvf";
		reg = <0x0 0x1a055000 0x0 0x1000>;
		interrupts = <0x0 0xe7 0x8>;
	};

	tsf@1a057000 {
		compatible = "mediatek,tsf";
		reg = <0x0 0x1a057000 0x0 0x1000>;
		interrupts = <0x0 0xea 0x8>;
		clocks = <0x31 0x3 0x32 0x1 0x31 0xa 0x34 0x1 0x34 0x8>;
		clock-names = "TSF_SCP_SYS_DIS", "TSF_MMSYS_SMI_COMMON", "TSF_SCP_SYS_CAM", "TSF_CAMSYS_LARB2_CGPDN", "TSF_CAMSYS_TSF_CGPDN";
	};

	ccu@1A057400 {
		compatible = "mediatek,ccu";
		reg = <0x0 0x1a057400 0x0 0x1000>;
		interrupts = <0x0 0xeb 0x8>;
		ccu_hw_offset = <0x400>;
		ccu_pmem_base = <0x1a0a0000>;
		ccu_pmem_size = <0x5000>;
		ccu_dmem_base = <0x1a080000>;
		ccu_dmem_size = <0x3000>;
		ccu_dmem_offset = <0x1680>;
		ccu_log_base = <0x500>;
		ccu_log_size = <0x200>;
		ccu_hw_dump_size = <0x3c0>;
		ccu_camsys_base = <0x1a000000>;
		ccu_camsys_size = <0x1000>;
		ccu_n3d_a_base = <0x1a03ffc0>;
		ccu_n3d_a_size = <0x1000>;
		ccu_sensor_pm_size = <0x800>;
		ccu_sensor_dm_size = <0x600>;
		clocks = <0x34 0x8>;
		clock-names = "CCU_CLK_CAM_CCU";
	};

	gpufreq {
		compatible = "mediatek,mt6757-gpufreq";
		clocks = <0x2f 0x5 0x2f 0x57 0x2f 0x29>;
		clock-names = "clk_mux", "clk_main_parent", "clk_sub_parent";
	};

	usb_c_pinctrl@0 {
		compatible = "mediatek,usb_c_pinctrl";
	};

	usb3_phy {
		compatible = "mediatek,usb3_phy";
		clocks = <0x2 0x35>;
		clock-names = "sssub_clk";
	};

	mt_soc_btcvsd_rx_pcm {
		compatible = "mediatek,mt_soc_btcvsd_rx_pcm";
	};

	mt_soc_btcvsd_tx_pcm {
		compatible = "mediatek,mt_soc_btcvsd_tx_pcm";
	};

	mt_soc_ul1_pcm {
		compatible = "mediatek,mt_soc_pcm_capture";
	};

	mt_soc_voice_md1 {
		compatible = "mediatek,mt_soc_pcm_voice_md1";
	};

	mt_soc_hdmi_pcm {
		compatible = "mediatek,mt_soc_pcm_hdmi";
	};

	mt_soc_uldlloopback_pcm {
		compatible = "mediatek,mt_soc_pcm_uldlloopback";
	};

	mt_soc_i2s0_pcm {
		compatible = "mediatek,mt_soc_pcm_dl1_i2s0";
	};

	mt_soc_mrgrx_pcm {
		compatible = "mediatek,mt_soc_pcm_mrgrx";
	};

	mt_soc_mrgrx_awb_pcm {
		compatible = "mediatek,mt_soc_pcm_mrgrx_awb";
	};

	mt_soc_fm_i2s_pcm {
		compatible = "mediatek,mt_soc_pcm_fm_i2s";
	};

	mt_soc_fm_i2s_awb_pcm {
		compatible = "mediatek,mt_soc_pcm_fm_i2s_awb";
	};

	mt_soc_i2s0dl1_pcm {
		compatible = "mediatek,mt_soc_pcm_dl1_i2s0dl1";
	};

	mt_soc_dl1_awb_pcm {
		compatible = "mediatek,mt_soc_pcm_dl1_awb";
	};

	mt_soc_voice_md1_bt {
		compatible = "mediatek,mt_soc_pcm_voice_md1_bt";
	};

	mt_soc_voip_bt_out {
		compatible = "mediatek,mt_soc_pcm_dl1_bt";
	};

	mt_soc_voip_bt_in {
		compatible = "mediatek,mt_soc_pcm_bt_dai";
	};

	mt_soc_tdmrx_pcm {
		compatible = "mediatek,mt_soc_tdm_capture";
	};

	mt_soc_fm_mrgtx_pcm {
		compatible = "mediatek,mt_soc_pcm_fmtx";
	};

	mt_soc_ul2_pcm {
		compatible = "mediatek,mt_soc_pcm_capture2";
	};

	mt_soc_i2s0_awb_pcm {
		compatible = "mediatek,mt_soc_pcm_i2s0_awb";
	};

	mt_soc_voice_md2 {
		compatible = "mediatek,mt_soc_pcm_voice_md2";
	};

	mt_soc_routing_pcm {
		compatible = "mediatek,mt_soc_pcm_routing";
	};

	mt_soc_voice_md2_bt {
		compatible = "mediatek,mt_soc_pcm_voice_md2_bt";
	};

	mt_soc_hp_impedance_pcm {
		compatible = "mediatek,mt_soc_pcm_hp_impedance";
	};

	mt_soc_codec_name {
		compatible = "mediatek,mt_soc_codec_63xx";
		use_hp_depop_flow = <0x0>;
		use_ul_260k = <0x0>;
	};

	mt_soc_dummy_pcm {
		compatible = "mediatek,mt_soc_pcm_dummy";
	};

	mt_soc_codec_dummy_name {
		compatible = "mediatek,mt_soc_codec_dummy";
	};

	mt_soc_routing_dai_name {
		compatible = "mediatek,mt_soc_dai_routing";
	};

	mt_soc_dai_name {
		compatible = "mediatek,mt_soc_dai_stub";
	};

	mt_soc_dl2_pcm {
		compatible = "mediatek,mt_soc_pcm_dl2";
	};

	mt_soc_anc_pcm {
		compatible = "mediatek,mt_soc_pcm_anc";
	};

	mt_soc_pcm_voice_ultra {
		compatible = "mediatek,mt_soc_pcm_voice_ultra";
	};

	mt_soc_pcm_voice_usb {
		compatible = "mediatek,mt_soc_pcm_voice_usb";
	};

	mt_soc_pcm_voice_usb_echoref {
		compatible = "mediatek,mt_soc_pcm_voice_usb_echoref";
	};

	nfc@0 {
		compatible = "mediatek,nfc-gpio-v2";
		gpio-ven = <0xb 0xf 0x0>;
		gpio-rst = <0xb 0x19 0x0>;
		gpio-eint = <0xb 0xe 0x0>;
		gpio-irq = <0xb 0xd 0x0>;
		gpio-osc = <0xb 0x63 0x0>;
		pinctrl-names = "default", "ven_high", "ven_low", "rst_high", "rst_low", "eint_high", "eint_low", "irq_init";
		pinctrl-0 = <0x1e>;
		pinctrl-1 = <0x67>;
		pinctrl-2 = <0x68>;
		pinctrl-3 = <0x69>;
		pinctrl-4 = <0x6a>;
		pinctrl-5 = <0x6b>;
		pinctrl-6 = <0x6c>;
		pinctrl-7 = <0x6d>;
		status = "okay";
	};

	gps {
		compatible = "mediatek,gps";
	};

	flashlight_core {
		compatible = "mediatek,flashlight_core";
	};

	flashlights_lm3643 {
		compatible = "mediatek,flashlights_lm3643";
	};

	flashlights_rt5081 {
		compatible = "mediatek,flashlights_rt5081";
	};

	flashlights_pwm {
		compatible = "mediatek,flashlights_pwm";
	};

	gsensor@0 {
		compatible = "mediatek,gsensor";
	};

	als_ps@0 {
		compatible = "mediatek,als_ps";
		pinctrl-names = "pin_default", "pin_cfg";
		pinctrl-0 = <0x6e>;
		pinctrl-1 = <0x6f>;
		status = "okay";
	};

	rgbw@0 {
		compatible = "mediatek,rgbw";
	};

	gyroscope@0 {
		compatible = "mediatek,gyroscope";
		pinctrl-names = "pin_default", "pin_cfg";
		pinctrl-0 = <0x70>;
		pinctrl-1 = <0x71>;
		status = "okay";
	};

	barometer@0 {
		compatible = "mediatek,barometer";
	};

	m_baro_pl@0 {
		compatible = "mediatek,m_baro_pl";
	};

	msensor@0 {
		compatible = "mediatek,msensor";
	};

	irq_nfc@ {
		compatible = "mediatek, irq_nfc-eint";
		interrupt-parent = <0x10>;
		interrupts = <0x1a 0x4>;
		debounce = <0x1a 0x0>;
		status = "okay";
	};

	dsi_te {
		compatible = "mediatek, dsi_te-eint";
		status = "okay";
		interrupt-parent = <0x10>;
		interrupts = <0x2c 0x1>;
		debounce = <0x2c 0x0>;
	};

	dsi_te_1 {
		compatible = "mediatek, dsi_te_1-eint";
		status = "disabled";
	};

	rf_clock_buffer {
		compatible = "mediatek,rf_clock_buffer";
		mediatek,clkbuf-quantity = <0x4>;
		mediatek,clkbuf-config = <0x2 0x0 0x1 0x1>;
		mediatek,clkbuf-driving-current = <0x2 0x2 0x2 0x2>;
		status = "okay";
	};

	irtx_pwm {
		compatible = "mediatek,irtx-pwm";
		pwm_ch = <0x2>;
		pwm_data_invert = <0x0>;
		pinctrl-names = "irtx_gpio_led_default", "irtx_gpio_led_set", "irtx_gpio_en_default", "irtx_gpio_en_set";
		pinctrl-0 = <0x72>;
		pinctrl-1 = <0x73>;
		pinctrl-2 = <0x74>;
		pinctrl-3 = <0x75>;
		status = "okay";
	};

	otg_iddig {
		compatible = "mediatek,usb_iddig_bi_eint";
		pinctrl-names = "iddig_default", "iddig_init", "iddig_enable", "iddig_disable";
		pinctrl-0 = <0x76>;
		pinctrl-1 = <0x77>;
		pinctrl-2 = <0x78>;
		pinctrl-3 = <0x79>;
		status = "okay";
	};

	usb_boost_manager {
		compatible = "mediatek,usb_boost_manager";
	};

	ssusb_ip_sleep {
		compatible = "mediatek,usb_ipsleep";
		interrupt-parent = <0x10>;
		interrupts = <0xd1 0x8>;
		debounce = <0xd1 0x0>;
		status = "okay";
	};

	fan53528_buck_info {
		regulator-name = "ext_buck_lp4";
		regulator-min-microvolt = <0x55730>;
		regulator-max-microvolt = <0x1173c6>;
		regulator-ramp-delay = <0x7d00>;
		regulator-always-on;
	};

	ext_buck_oc {
		compatible = "mediatek, ext_buck_oc-eint";
		status = "disabled";
	};

	als {
		compatible = "mediatek, als-eint";
		interrupt-parent = <0x10>;
		interrupts = <0x6 0x8>;
		debounce = <0x6 0x0>;
		status = "okay";
	};

	gyro {
		compatible = "mediatek, gyro-eint";
		status = "disabled";
	};

	fingerprint@ {
		compatible = "mediatek,fingerprint";
		interrupt-parent = <0x10>;
		interrupts = <0x10 0x1>;
		debounce = <0x10 0x0>;
		status = "okay";
		pinctrl-names = "fp_default", "fp_rst_high", "fp_rst_low", "eint_as_int", "eint_in_low", "eint_in_float", "miso_pull_up", "miso_pull_disable", "eint_in_high", "fp_enable_low", "fp_enable_high";
		pinctrl-0 = <0x1e>;
		pinctrl-1 = <0x7a>;
		pinctrl-2 = <0x7b>;
		pinctrl-3 = <0x7c>;
		pinctrl-4 = <0x7d>;
		pinctrl-5 = <0x7e>;
		pinctrl-6 = <0x7f>;
		pinctrl-7 = <0x80>;
		pinctrl-8 = <0x81>;
		pinctrl-9 = <0x82>;
		pinctrl-10 = <0x83>;
	};

	hall {
		compatible = "mediatek, hall-eint";
		interrupt-parent = <0x10>;
		interrupts = <0x2 0x8>;
		debounce = <0x2 0x0>;
		status = "okay";
	};

	mse {
		compatible = "mediatek, mse-eint";
		status = "disabled";
	};

	eint_fusb300_det_in {
		compatible = "mediatek,fusb300-eint";
	};

	smart_pa {
		compatible = "mediatek, smart_pa-eint";
		status = "disabled";
	};

	chr_stat {
		compatible = "mediatek, chr_stat-eint";
	};

	rt-pd-manager {
		compatible = "mediatek,rt-pd-manager";
		rt,pd_vconn_gpio = <0xb 0x2a 0x0>;
		rt,pd_vconn_gpio_x = <0x2a>;
	};

	cam_cal_drv {
		compatible = "mediatek,cam_cal_drv";
		main_bus = <0x2>;
		sub_bus = <0x4>;
		main2_bus = <0x4>;
	};

	charger {
		compatible = "mediatek,charger";
		algorithm_name = "SwitchCharging";
		enable_pe_plus;
		enable_pe_2;
		enable_pe_3;
		battery_cv = <0x426030>;
		max_charger_voltage = <0x632ea0>;
		usb_charger_current_suspend = <0x0>;
		usb_charger_current_unconfigured = <0x11170>;
		usb_charger_current_configured = <0x7a120>;
		usb_charger_current = <0x7a120>;
		ac_charger_current = <0x1f47d0>;
		ac_charger_input_current = <0x30d400>;
		non_std_ac_charger_current = <0x7a120>;
		charging_host_charger_current = <0x7a120>;
		ta_ac_charger_current = <0x2dc6c0>;
		jeita_temp_above_t4_cv_voltage = <0x40b280>;
		jeita_temp_t3_to_t4_cv_voltage = <0x40b280>;
		jeita_temp_t2_to_t3_cv_voltage = <0x423920>;
		jeita_temp_t1_to_t2_cv_voltage = <0x40b280>;
		jeita_temp_t0_to_t1_cv_voltage = <0x3da540>;
		jeita_temp_below_t0_cv_voltage = <0x3da540>;
		temp_t4_threshold = <0x32>;
		temp_t4_thres_minus_x_degree = <0x2f>;
		temp_t3_threshold = <0x2d>;
		temp_t3_thres_minus_x_degree = <0x27>;
		temp_t2_threshold = <0xa>;
		temp_t2_thres_plus_x_degree = <0x10>;
		temp_t1_threshold = <0x0>;
		temp_t1_thres_plus_x_degree = <0x6>;
		temp_t0_threshold = <0x0>;
		temp_t0_thres_plus_x_degree = <0x0>;
		temp_neg_10_threshold = <0x0>;
		enable_min_charge_temperature;
		min_charge_temperature = <0x0>;
		min_charge_temperature_plus_x_degree = <0x6>;
		max_charge_temperature = <0x32>;
		max_charge_temperature_minus_x_degree = <0x2f>;
		pe20_ichg_level_threshold = <0x3e8>;
		ta_start_battery_soc = <0x0>;
		ta_stop_battery_soc = <0x55>;
		chg1_ta_ac_charger_current = <0x16e360>;
		chg2_ta_ac_charger_current = <0x16e360>;
		cable_imp_threshold = <0x2bb>;
		vbat_cable_imp_threshold = <0xf3c>;
		bif_threshold1 = <0x40d990>;
		bif_threshold2 = <0x419ce0>;
		bif_cv_under_threshold2 = <0x43e6d0>;
	};

	rt5081_pmu_eint {
		interrupt-parent = <0x10>;
		interrupts = <0x65 0x8>;
		debounce = <0x65 0x0>;
		status = "okay";
	};

	rt5081_pd_eint {
		interrupt-parent = <0x10>;
		interrupts = <0x8 0x2>;
		debounce = <0x8 0x0>;
		status = "okay";
	};

	rt1711h_pd_eint {
	};

	mt_pmic_regulator {
		compatible = "mediatek,mt_pmic";

		buck_regulators {
			compatible = "mediatek,mt_pmic_buck_regulators";

			buck_vdram2 {
				regulator-name = "vdram2";
				regulator-min-microvolt = <0x61a80>;
				regulator-max-microvolt = <0x123716>;
				regulator-ramp-delay = <0x186a>;
				regulator-enable-ramp-delay = <0x3e8>;
			};

			buck_vs1 {
				regulator-name = "vs1";
				regulator-min-microvolt = <0x124f80>;
				regulator-max-microvolt = <0x2a88ac>;
				regulator-ramp-delay = <0x30d4>;
				regulator-enable-ramp-delay = <0x1f4>;
			};

			buck_vdram1 {
				regulator-name = "vdram1";
				regulator-min-microvolt = <0x7ea5e>;
				regulator-max-microvolt = <0x1406f4>;
				regulator-ramp-delay = <0x186a>;
				regulator-enable-ramp-delay = <0x3e8>;
			};

			buck_vmodem {
				regulator-name = "vmodem";
				regulator-min-microvolt = <0x61a80>;
				regulator-max-microvolt = <0x123716>;
				regulator-ramp-delay = <0x186a>;
				regulator-enable-ramp-delay = <0x3e8>;
			};

			buck_vcore {
				regulator-name = "vcore";
				regulator-min-microvolt = <0x632ea>;
				regulator-max-microvolt = <0x124f80>;
				regulator-ramp-delay = <0x186a>;
				regulator-enable-ramp-delay = <0x3e8>;
			};

			buck_vs2 {
				regulator-name = "vs2";
				regulator-min-microvolt = <0x124f80>;
				regulator-max-microvolt = <0x2a88ac>;
				regulator-ramp-delay = <0x30d4>;
				regulator-enable-ramp-delay = <0x1f4>;
			};

			buck_vpa {
				regulator-name = "vpa";
				regulator-min-microvolt = <0x7a120>;
				regulator-max-microvolt = <0x37b1d0>;
				regulator-ramp-delay = <0xc350>;
				regulator-enable-ramp-delay = <0x3e8>;
			};

			buck_vproc12 {
				regulator-name = "vproc12";
				regulator-min-microvolt = <0x632ea>;
				regulator-max-microvolt = <0x124f80>;
				regulator-ramp-delay = <0x186a>;
				regulator-enable-ramp-delay = <0x3e8>;
			};

			buck_vgpu {
				regulator-name = "vgpu";
				regulator-min-microvolt = <0x632ea>;
				regulator-max-microvolt = <0x124f80>;
				regulator-ramp-delay = <0x186a>;
				regulator-enable-ramp-delay = <0x3e8>;
			};

			buck_vproc11 {
				regulator-name = "vproc11";
				regulator-min-microvolt = <0x632ea>;
				regulator-max-microvolt = <0x124f80>;
				regulator-ramp-delay = <0x186a>;
				regulator-enable-ramp-delay = <0x3e8>;
			};
		};

		ldo_regulators {
			compatible = "mediatek,mt_pmic_ldo_regulators";

			ldo_vcamd1 {
				regulator-name = "vcamd1";
				regulator-min-microvolt = <0xdbba0>;
				regulator-max-microvolt = <0x124f80>;
				regulator-enable-ramp-delay = <0x108>;
				regulator-default-on = <0x0>;
				status = "okay";
				linux,phandle = <0x50>;
				phandle = <0x50>;
			};

			ldo_vsim1 {
				regulator-name = "vsim1";
				regulator-min-microvolt = <0x19f0a0>;
				regulator-max-microvolt = <0x2f4d60>;
				regulator-enable-ramp-delay = <0x108>;
				regulator-default-on = <0x0>;
				status = "okay";
			};

			ldo_vgp {
				regulator-name = "vgp";
				regulator-min-microvolt = <0x16e360>;
				regulator-max-microvolt = <0x325aa0>;
				regulator-enable-ramp-delay = <0x108>;
			};

			ldo_vusb33 {
				compatible = "regulator-fixed";
				regulator-name = "vusb33";
				regulator-min-microvolt = <0x2dc6c0>;
				regulator-max-microvolt = <0x2dc6c0>;
				regulator-enable-ramp-delay = <0x108>;
			};

			ldo_vrf12 {
				compatible = "regulator-fixed";
				regulator-name = "vrf12";
				regulator-min-microvolt = <0x124f80>;
				regulator-max-microvolt = <0x124f80>;
				regulator-enable-ramp-delay = <0x6e>;
			};

			ldo_vcamio {
				compatible = "regulator-fixed";
				regulator-name = "vcamio";
				regulator-min-microvolt = <0x1b7740>;
				regulator-max-microvolt = <0x1b7740>;
				regulator-enable-ramp-delay = <0x108>;
				regulator-default-on = <0x0>;
				status = "okay";
				linux,phandle = <0x51>;
				phandle = <0x51>;
			};

			ldo_vcn18 {
				compatible = "regulator-fixed";
				regulator-name = "vcn18";
				regulator-min-microvolt = <0x1b7740>;
				regulator-max-microvolt = <0x1b7740>;
				regulator-enable-ramp-delay = <0x108>;
			};

			ldo_vfe28 {
				compatible = "regulator-fixed";
				regulator-name = "vfe28";
				regulator-min-microvolt = <0x2ab980>;
				regulator-max-microvolt = <0x2ab980>;
				regulator-enable-ramp-delay = <0x108>;
			};

			ldo_vrf18_2 {
				compatible = "regulator-fixed";
				regulator-name = "vrf18_2";
				regulator-min-microvolt = <0x1b9e50>;
				regulator-max-microvolt = <0x1b9e50>;
				regulator-enable-ramp-delay = <0x6e>;
			};

			ldo_va18 {
				compatible = "regulator-fixed";
				regulator-name = "va18";
				regulator-min-microvolt = <0x1b7740>;
				regulator-max-microvolt = <0x1b7740>;
				regulator-enable-ramp-delay = <0x108>;
			};

			ldo_vcn28 {
				compatible = "regulator-fixed";
				regulator-name = "vcn28";
				regulator-min-microvolt = <0x2ab980>;
				regulator-max-microvolt = <0x2ab980>;
				regulator-enable-ramp-delay = <0x108>;
			};

			ldo_vmipi {
				regulator-name = "vmipi";
				regulator-min-microvolt = <0x19f0a0>;
				regulator-max-microvolt = <0x200b20>;
				regulator-enable-ramp-delay = <0x108>;
			};

			ldo_vsram_gpu {
				regulator-name = "vsram_gpu";
				regulator-min-microvolt = <0x7ea5e>;
				regulator-max-microvolt = <0x1406f4>;
				regulator-ramp-delay = <0x186a>;
				regulator-enable-ramp-delay = <0x6e>;
			};

			ldo_vsram_core {
				regulator-name = "vsram_core";
				regulator-min-microvolt = <0x7ea5e>;
				regulator-max-microvolt = <0x1406f4>;
				regulator-ramp-delay = <0x186a>;
				regulator-enable-ramp-delay = <0x6e>;
			};

			ldo_vsram_proc {
				regulator-name = "vsram_proc";
				regulator-min-microvolt = <0x7ea5e>;
				regulator-max-microvolt = <0x1406f4>;
				regulator-ramp-delay = <0x186a>;
				regulator-enable-ramp-delay = <0x6e>;
			};

			ldo_vxo22 {
				regulator-name = "vxo22";
				regulator-min-microvolt = <0x2191c0>;
				regulator-max-microvolt = <0x231860>;
				regulator-enable-ramp-delay = <0x6e>;
			};

			ldo_vrf18_1 {
				compatible = "regulator-fixed";
				regulator-name = "vrf18_1";
				regulator-min-microvolt = <0x1b9e50>;
				regulator-max-microvolt = <0x1b9e50>;
				regulator-enable-ramp-delay = <0x6e>;
			};

			ldo_vcamd2 {
				regulator-name = "vcamd2";
				regulator-min-microvolt = <0xdbba0>;
				regulator-max-microvolt = <0x1b7740>;
				regulator-enable-ramp-delay = <0x108>;
				regulator-default-on = <0x0>;
				status = "okay";
				linux,phandle = <0x53>;
				phandle = <0x53>;
			};

			ldo_vmch {
				regulator-name = "vmch";
				regulator-min-microvolt = <0x2c4020>;
				regulator-max-microvolt = <0x325aa0>;
				regulator-enable-ramp-delay = <0x24>;
				linux,phandle = <0xc>;
				phandle = <0xc>;
			};

			ldo_vcama1 {
				regulator-name = "vcama1";
				regulator-min-microvolt = <0x1b7740>;
				regulator-max-microvolt = <0x2dc6c0>;
				regulator-enable-ramp-delay = <0x108>;
				regulator-default-on = <0x0>;
				status = "okay";
				linux,phandle = <0x4f>;
				phandle = <0x4f>;
			};

			ldo_vtcxo24 {
				compatible = "regulator-fixed";
				regulator-name = "vtcxo24";
				regulator-min-microvolt = <0x231860>;
				regulator-max-microvolt = <0x231860>;
				regulator-enable-ramp-delay = <0x6e>;
			};

			ldo_vio28 {
				compatible = "regulator-fixed";
				regulator-name = "vio28";
				regulator-min-microvolt = <0x2ab980>;
				regulator-max-microvolt = <0x2ab980>;
				regulator-enable-ramp-delay = <0x108>;
			};

			ldo_vemc {
				regulator-name = "vemc";
				regulator-min-microvolt = <0x2c4020>;
				regulator-max-microvolt = <0x325aa0>;
				regulator-enable-ramp-delay = <0x24>;
				linux,phandle = <0x5>;
				phandle = <0x5>;
			};

			ldo_va12 {
				compatible = "regulator-fixed";
				regulator-name = "va12";
				regulator-min-microvolt = <0x124f80>;
				regulator-max-microvolt = <0x124f80>;
				regulator-enable-ramp-delay = <0x108>;
			};

			ldo_va10 {
				regulator-name = "va10";
				regulator-min-microvolt = <0x927c0>;
				regulator-max-microvolt = <0x200b20>;
				regulator-enable-ramp-delay = <0x108>;
			};

			ldo_vgp2 {
				regulator-name = "vgp2";
				regulator-min-microvolt = <0x124f80>;
				regulator-max-microvolt = <0x325aa0>;
				regulator-enable-ramp-delay = <0x24>;
			};

			ldo_vio18 {
				compatible = "regulator-fixed";
				regulator-name = "vio18";
				regulator-min-microvolt = <0x1b7740>;
				regulator-max-microvolt = <0x1b7740>;
				regulator-enable-ramp-delay = <0x108>;
			};

			ldo_vcn33_bt {
				regulator-name = "vcn33_bt";
				regulator-min-microvolt = <0x325aa0>;
				regulator-max-microvolt = <0x3567e0>;
				regulator-enable-ramp-delay = <0x108>;
			};

			ldo_vcn33_wifi {
				regulator-name = "vcn33_wifi";
				regulator-min-microvolt = <0x325aa0>;
				regulator-max-microvolt = <0x3567e0>;
				regulator-enable-ramp-delay = <0x108>;
			};

			ldo_vsram_md {
				regulator-name = "vsram_md";
				regulator-min-microvolt = <0x7ea5e>;
				regulator-max-microvolt = <0x1406f4>;
				regulator-ramp-delay = <0x186a>;
				regulator-enable-ramp-delay = <0x6e>;
			};

			ldo_vbif28 {
				compatible = "regulator-fixed";
				regulator-name = "vbif28";
				regulator-min-microvolt = <0x2ab980>;
				regulator-max-microvolt = <0x2ab980>;
				regulator-enable-ramp-delay = <0x108>;
			};

			ldo_vufs18 {
				compatible = "regulator-fixed";
				regulator-name = "vufs18";
				regulator-min-microvolt = <0x1b7740>;
				regulator-max-microvolt = <0x1b7740>;
				regulator-enable-ramp-delay = <0x108>;
			};

			ldo_vcama2 {
				regulator-name = "vcama2";
				regulator-min-microvolt = <0x1b7740>;
				regulator-max-microvolt = <0x2dc6c0>;
				regulator-enable-ramp-delay = <0x108>;
				regulator-default-on = <0x0>;
				status = "okay";
				linux,phandle = <0x52>;
				phandle = <0x52>;
			};

			ldo_vmc {
				regulator-name = "vmc";
				regulator-min-microvolt = <0x1b7740>;
				regulator-max-microvolt = <0x325aa0>;
				regulator-enable-ramp-delay = <0x24>;
				linux,phandle = <0xd>;
				phandle = <0xd>;
			};

			ldo_vldo28 {
				regulator-name = "vldo28";
				regulator-min-microvolt = <0x2ab980>;
				regulator-max-microvolt = <0x2dc6c0>;
				regulator-enable-ramp-delay = <0x108>;
				regulator-default-on = <0x0>;
				status = "okay";
				linux,phandle = <0x25>;
				phandle = <0x25>;
			};

			ldo_vldo28_tp {
				regulator-name = "vldo28_tp";
				regulator-min-microvolt = <0x2ab980>;
				regulator-max-microvolt = <0x2dc6c0>;
				regulator-enable-ramp-delay = <0x108>;
			};

			ldo_vxo18 {
				compatible = "regulator-fixed";
				regulator-name = "vxo18";
				regulator-min-microvolt = <0x1b9e50>;
				regulator-max-microvolt = <0x1b9e50>;
				regulator-enable-ramp-delay = <0x6e>;
			};

			ldo_vsim2 {
				regulator-name = "vsim2";
				regulator-min-microvolt = <0x19f0a0>;
				regulator-max-microvolt = <0x2f4d60>;
				regulator-enable-ramp-delay = <0x108>;
				regulator-default-on = <0x0>;
				status = "okay";
			};
		};
	};

	rt5081_pmu_dts {
		interrupt-controller;
		#interrupt-cells = <0x1>;
		rt,intr_gpio_num = <0x65>;
		rt,intr_gpio = <0xb 0x65 0x0>;

		core {
			compatible = "richtek,rt5081_pmu_core";
			interrupt-names = "otp", "vdda_ovp", "vdda_uv";
			i2cstmr_rst_tmr = <0x0>;
			mrstb_en;
			mrstb_tmr = <0x3>;
			int_wdt = <0x0>;
			int_deg = <0x0>;
		};

		charger {
			compatible = "richtek,rt5081_pmu_charger";
			interrupt-names = "adc_donei", "chg_mivr", "chg_aiclmeasi", "pumpx_donei", "attachi", "ovpctrl_uvp_d_evt", "chg_wdtmri", "chg_vbusov", "chg_tmri", "chg_treg";
			charger_name = "primary_chg";
			load_switch_name = "primary_load_switch";
			ichg = <0x1e8480>;
			aicr = <0x7a120>;
			mivr = <0x432380>;
			cv = <0x426030>;
			ieoc = <0x249f0>;
			safety_timer = <0xc>;
			dc_wdt = <0x3d0900>;
			ircmp_resistor = <0x61a8>;
			ircmp_vclamp = <0x7d00>;
			enable_te;
			enable_wdt;
		};

		rt5081_pmu_fled1 {
			compatible = "richtek,rt5081_pmu_fled1";
			interrupt-names = "fled_lvf", "fled2_short", "fled1_short";
			fled_enable = <0x1>;
			torch_cur = <0x493e0>;
			strobe_cur = <0x124f80>;
			strobe_timeout = <0x960>;
		};

		rt5081_pmu_fled2 {
			compatible = "richtek,rt5081_pmu_fled2";
			fled_enable = <0x1>;
			torch_cur = <0x30d40>;
			strobe_cur = <0xf4240>;
			strobe_timeout = <0x4b0>;
		};

		ldo {
			compatible = "richtek,rt5081_pmu_ldo";
			interrupt-names = "ldo_oc";
			ldo_oms = <0x1>;
			ldo_vrc_lt = <0x1>;

			rt5081_ldo {
				regulator-name = "rt5081_ldo";
				regulator-min-microvolt = <0x186a00>;
				regulator-max-microvolt = <0x3d0900>;
			};
		};

		rgbled {
			compatible = "richtek,rt5081_pmu_rgbled";
			interrupt-names = "isink4_short", "isink3_short", "isink2_short", "isink1_short", "isink4_open", "isink3_open", "isink2_open", "isink1_open";
			rt,led_name = "red", "green", "rt5081_pmu_led3", "rt5081_pmu_led4";
			rt,led_default_trigger = "cc_mode", "cc_mode", "cc_mode", "none";
		};

		bled {
			compatible = "richtek,rt5081_pmu_bled";
			interrupt-names = "bled_ocp";
			rt,bled_name = "rt5081_pmu_bled";
			rt,chan_en = <0xf>;
			rt,map_linear;
			rt,bl_ovp_level = <0x3>;
			rt,bl_ocp_level = <0x2>;
			rt,use_pwm;
			rt,pwm_fsample = <0x2>;
			rt,pwm_deglitch = <0x1>;
			rt,pwm_avg_cycle = <0x0>;
			rt,bled_ramptime = <0x3>;
			rt,bled_flash_ramp = <0x1>;
			rt,max_bled_brightness = <0x2aa>;
		};

		dsv {
			compatible = "richtek,rt5081_pmu_dsv";
			interrupt-names = "dsv_vneg_ocp", "dsv_vpos_ocp", "dsv_bst_ocp", "dsv_vneg_scp", "dsv_vpos_scp";
			db_ext_en = <0x0>;
			db_periodic_fix = <0x0>;
			db_single_pin = <0x0>;
			db_freq_pm = <0x0>;
			db_periodic_mode = <0x0>;
			db_startup = <0x0>;
			db_vneg_20ms = <0x1>;
			db_vneg_disc = <0x0>;
			db_vpos_20ms = <0x1>;
			db_vpos_disc = <0x0>;
			db_delay = <0x3>;
			db_vbst = <0x1644>;
			db_vpos_slew = <0x1>;
			db_vneg_slew = <0x1>;

			rt5081_dsvp {
				regulator-name = "dsv_pos";
				regulator-min-microvolt = <0x3d0900>;
				regulator-max-microvolt = <0x5b8d80>;
			};

			rt5081_dsvn {
				regulator-name = "dsv_neg";
				regulator-min-microvolt = <0x3d0900>;
				regulator-max-microvolt = <0x5b8d80>;
			};
		};
	};

	led@0 {
		compatible = "mediatek,red";
		led_mode = <0x0>;
		data = <0x1>;
		pwm_config = <0x0 0x0 0x0 0x0 0x0>;
	};

	led@1 {
		compatible = "mediatek,green";
		led_mode = <0x0>;
		data = <0x1>;
		pwm_config = <0x0 0x0 0x0 0x0 0x0>;
	};

	led@2 {
		compatible = "mediatek,blue";
		led_mode = <0x0>;
		data = <0x1>;
		pwm_config = <0x0 0x0 0x0 0x0 0x0>;
	};

	led@3 {
		compatible = "mediatek,jogball-backlight";
		led_mode = <0x0>;
		data = <0x1>;
		pwm_config = <0x0 0x0 0x0 0x0 0x0>;
	};

	led@4 {
		compatible = "mediatek,keyboard-backlight";
		led_mode = <0x0>;
		data = <0x1>;
		pwm_config = <0x0 0x0 0x0 0x0 0x0>;
	};

	led@5 {
		compatible = "mediatek,button-backlight";
		led_mode = <0x0>;
		data = <0x1>;
		pwm_config = <0x0 0x0 0x0 0x0 0x0>;
	};

	led@6 {
		compatible = "mediatek,lcd-backlight";
		led_mode = <0x5>;
		data = <0x1>;
		pwm_config = <0x0 0x0 0x0 0x0 0x0>;
	};

	vibrator@0 {
		compatible = "mediatek,vibrator";
		vib_timer = <0x19>;
		vib_limit = <0x9>;
		vib_vol = <0x9>;
	};

	type_c_port0 {
		rt-dual,supported_modes = <0x0>;
		rt-tcpc,name = "type_c_port0";
		rt-tcpc,role_def = <0x4>;
		rt-tcpc,rp_level = <0x0>;
		rt-tcpc,notifier_supply_num = <0x2>;
		rt5081pd,intr_gpio_num = <0x8>;

		pd-data {
			pd,source-pdo-size = <0x1>;
			pd,source-pdo-data = <0x19032>;
			pd,sink-pdo-size = <0x2>;
			pd,sink-pdo-data = <0x190c8 0x190c8>;
			pd,id-vdo-size = <0x3>;
			pd,id-vdo-data = <0xd40029cf 0x0 0x10000>;
		};

		dpm_caps {
			local_dr_power;
			local_dr_data;
			local_usb_comm;
			local_vconn_supply;
			attemp_enter_dp_mode;
			attemp_discover_cable;
			attemp_discover_id;
			pr_check = <0x0>;
			pr_check_gp_source;
			dr_check = <0x0>;
			nk_prefer_low_voltage;
			snk_ignore_mismatch_current;
		};
	};

	cust_accel@0 {
		compatible = "mediatek,lsm6ds3hg";
		i2c_num = <0x1>;
		direction = <0x4>;
		power_id = <0xffff>;
		power_vol = <0x0>;
		firlen = <0x10>;
		is_batch_supported = <0x1>;
	};

	cust_alsps@0 {
		compatible = "mediatek,stk3x1x";
		i2c_num = <0x1>;
		i2c_addr = <0x48 0x0 0x0 0x0>;
		polling_mode_ps = <0x0>;
		polling_mode_als = <0x1>;
		power_id = <0xffff>;
		power_vol = <0x0>;
		als_level = <0xa 0x14 0x24 0x3b 0x50 0x78 0xb4 0x104 0x1c2 0x34d 0x470 0x609 0x93c 0x122f 0x1b46>;
		als_value = <0x0 0xa 0x28 0x41 0x5a 0x91 0xe1 0x12c 0x226 0x3a2 0x4e2 0x6a4 0xa28 0x1400 0x1e00 0x2800>;
		state_val = <0x0>;
		psctrl_val = <0x71>;
		alsctrl_val = <0x39>;
		ledctrl_val = <0xff>;
		wait_val = <0x7>;
		ps_high_thd_val = <0x6a4>;
		ps_low_thd_val = <0x5dc>;
		ps_threshold_high = <0x1a>;
		ps_threshold_low = <0x15>;
		is_batch_supported_ps = <0x0>;
		is_batch_supported_als = <0x0>;
	};

	cust_mag@0 {
		compatible = "mediatek,qmcX983";
		i2c_num = <0x1>;
		i2c_addr = <0x2c 0x0 0x0 0x0>;
		direction = <0x0>;
		power_id = <0xffff>;
		power_vol = <0x0>;
		is_batch_supported = <0x0>;
	};

	cust_gyro@0 {
		compatible = "mediatek,lsm6ds3hgy";
		i2c_num = <0x1>;
		direction = <0x4>;
		power_id = <0xffff>;
		power_vol = <0x0>;
		firlen = <0x0>;
		is_batch_supported = <0x0>;
	};

	cust_baro@0 {
		compatible = "mediatek,bmp280new";
		i2c_num = <0x1>;
		direction = <0x0>;
		power_id = <0xffff>;
		power_vol = <0x0>;
		firlen = <0x20>;
		is_batch_supported = <0x0>;
	};
};
