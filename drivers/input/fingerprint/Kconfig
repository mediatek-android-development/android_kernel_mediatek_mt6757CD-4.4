## drivers/input/fingerprint/Kconfig
```kconfig
#
#Fingerprint
#
menu "Fingerprint support"
	depends on INPUT

config MTK_FINGERPRINT_SUPPORT
	bool "Mediatek Fingerprint"
	default n
	---help---
	Fingerprint mtk driver enable/disable in the kernel.
	Say Y here if you want to use mediatek fingerprint driver,
	fingerprint driver will support fingerprint function

if MTK_FINGERPRINT_SUPPORT
config MTK_FINGERPRINT_SELECT
	string "sensor type"
	default "SW9651"        # [liguanxiong] defalut is sw9651


if MTK_FINGERPRINT_SELECT = "FPC1145"
config FPC_FINGERPRINT
	bool "FPC Fingerprint"
	default y
	---help---
	FPC fingerprint FPC's 102x/104x device.
endif

if MTK_FINGERPRINT_SELECT = "GF318M"
config GOODIX_FINGERPRINT
	bool "Goodix Fingerprint"
	default y
	---help---
	Goodix Fingerprint chip GF316M/GF318M/GF3118M/GF518M/GF5118M/GF516M/GF816M/GF3208/GF5216 TEE driver

config GOODIX_SENSOR_TYPE
	string "SENSOR_TYPE"
	default "GF318M"
	---help---
	Must input sensor type, or default is GF316M GF318M GF3118M GF518M GF5118M GF516M GF816M GF3208 GF5216
endif
# [liguanxiong start] Add for secondary fingerprint module sunwave sw9251
if MTK_FINGERPRINT_SELECT = "SW9251" || MTK_FINGERPRINT_SELECT = "tplink_mult_sensor"
config SUNWAVE_FINGERPRINT_SW9251
	bool "Sunwave Fingerprint SW9251"
	default y
	---help---
	Sunwave Fingerprint chip SW9251 REE driver
endif
if MTK_FINGERPRINT_SELECT = "SW9651"
config SUNWAVE_FINGERPRINT_SW9651
	bool "Sunwave Fingerprint SW9651"
	default y
	---help---
	Sunwave Fingerprint chip SW9651 TEE driver
endif
# [liguanxiong end]
endif
endmenu
```

## drivers/input/fingerprint/gx556/Kconfig
```kconfig
config FINGERPRINT_GT556
	bool "gt556(goodix fingerprint sensor)  for dewav"
	default n
```

## drivers/input/touchscreen/mediatek/Kconfig
```kconfig
#
# Touchscreen driver configuration
#
menuconfig INPUT_TOUCHSCREEN
	bool "Touchscreens"
	help
	  Say Y here, and a list of supported touchscreens will be displayed.
	  This option doesn't affect the kernel.

	  If unsure, say Y.

if INPUT_TOUCHSCREEN

config TOUCHSCREEN_MTK
	bool "MediaTek Touch Panel Driver"
	help
	  Say Y here if you have MediaTek touch panel.

	  If unsure, say N.

	  To compile this dirver as a module, choose M here: the
	  module will be called.

config TOUCHSCREEN_MTK_GT1151
	bool "GT1151 for Mediatek package"
	default n
	help
	  Say Y here if you have GT1151 touch panel.

	  If unsure, say N.

	  To compile this dirver as a module, choose M here: the
	  module will be called.

source "drivers/input/touchscreen/mediatek/GT1151/Kconfig"

config TOUCHSCREEN_MTK_FT8716
	bool "FT8716 for Mediatek package"
	default n
	help
	  Say Y here if you have FT8716 touch panel.

	  If unsure, say N.

	  To compile this dirver as a module, choose M here: the
	  module will be called.
source "drivers/input/touchscreen/mediatek/FT8716/Kconfig"

source "drivers/input/touchscreen/mediatek/gn_nt36xxx/Kconfig"

config TOUCHSCREEN_MTK_SYNAPTICS
	tristate "synaptics_dsx"
	depends on I2C
	help
	  Say Y here if you have a synaptics_dsx
	  connected to your system.

	  If unsure, say N.

	  To compile this driver as a module, choose M here: the
	  module will be called synaptics_dsx.

source "drivers/input/touchscreen/mediatek/synaptics_dsx/Kconfig"

endif
```

## drivers/misc/mediatek/accelerometer/lsm6ds3-acc/Kconfig
```kconfig
config MTK_LSM6DS3_ACC
	bool "STMicroelectronics LSM6DS3 accelerometer for MediaTek package"
	default y
```

## drivers/misc/mediatek/gyroscope/bmi160_gyro/Kconfig
```kconfig
config MTK_BMI160_GYRO
        bool "bmi160_gyro for MediaTek package"
        default n
        help
        It support different gyroscope sensor.
        If this option is set,
	  	it will support
         ITG1010 gyroscope.
```

## drivers/misc/mediatek/keys/Kconfig
```kconfig
config CUSTOM_KERNEL_MUTE_SWITCH
	bool "CUSTOM_KERNEL_MUTE_SWITCH"
	help
	  null.
```

## drivers/misc/mediatek/smartpa/Kconfig
```kconfig
config MTK_SMARTPA_SOUND
    bool "MTK_SOUND"
    default n
    help
        If you say Y, enable MTK_SPUND_I2C_DRIVER.
```
